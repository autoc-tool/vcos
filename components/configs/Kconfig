## components/configs/Kconfig
```kconfig
config MODULE_ETHIF
    bool "module EthIf support"
    default n
    ---help---
        Enable the module EthIf

config MODULE_TCPIP
    bool "module TcpIp support"
    default n
    ---help---
        Enable the module TcpIp

config MODULE_COM
    bool "net rtcom support"
    default n
    ---help---
        Enable the NET_RTCOM

config MODULE_PDUR
    bool "net pdurouter support"
    default n
    ---help---
        Enable the NET_PDUROUTER

config MODULE_CANIF
    bool "can canif support"
    default n
    ---help---
        Enable the CAN_CANIF

config MODULE_COMM
    bool "net comm support"
    default n
    ---help---
        Enable the CAN_CANIF

config MODULE_CANSM
    bool "can cansm support"
    default n
    ---help---
        Enable the CAN_CANSM

config MODULE_NM
    bool "net manager nm support"
    default n
    ---help---
        Enable the MODULE_NM

config MODULE_CANNM
    bool "net manager cannm support"
    default n
    ---help---
        Enable the MODULE_CANNM

config MODULE_CANTRCV1145
    bool "net manager trcv1145 support"
    default n
    ---help---
        Enable the MODULE_CANTRCV1145

config MODULE_NVM
    bool "mem nvm support"
    default n
    ---help---
        Enable the MEM_NVM

config MODULE_MEMIF
    bool "mem memif support"
    default n
    ---help---
        Enable the MEM_MEMIF

config MODULE_RT_FRAMEWORK
    bool "autosar cp support"
    default n
    ---help---
        Enable the autosar os module

config MODULE_CANTSYN
    bool "module cantsyn support"
    default n
    ---help---
        Enable the MODULE_CANTSYN

config MODULE_ETHTSYN
    bool "module ethtsyn support"
    default n
    ---help---
        Enable the MODULE_ETHTSYN

config MODULE_STBM
    bool "module stbm support"
    default n
    ---help---
        Enable the MODULE_STBM

config MODULE_ECUM
    bool "servm ecum support"
    default n
    ---help---
        Enable the SERVM_ECUM

config MODULE_BSWM
    bool "servm bswm support"
    default n
    ---help---
        Enable the SERVM_BSWM

config MODULE_RTE
    bool "MOUDLE RTE support"
    default n
    ---help---
        Enable the MODULE_RTE

config MODULE_DEM
    bool "diagnostics dem support"
    default n
	---help---
		Enable the MODULE_DEM

config MODULE_DCM
    bool "diagnostics dcm support"
    default n
	---help---
		Enable the MODULE_DCM

config MODULE_CANTP
    bool "diagnostics cantp support"
    default n
	---help---
		Enable the MODULE_CANTP
```

## components/maintaining/det/Kconfig
```kconfig
config MODULE_DET
    bool "det support"
    default n
	---help---
		Enable the MODULE_DET
```

## components/maintaining/traced/Kconfig
```kconfig
menuconfig TRACED
    bool "vcos traced support"
    select SCHED_INSTRUMENTATION
    select SCHED_INSTRUMENTATION_ABNORMAL
    select SCHED_INSTRUMENTATION_FILTER
    select SCHED_INSTRUMENTATION_IRQHANDLER
    select SCHED_INSTRUMENTATION_SWITCH
    select SCHED_INSTRUMENTATION_WAKEUP
    select DRIVERS_NOTE
    select DRIVERS_NOTECTL
    depends on !DISABLE_DRIVERS
    default n
	---help---
		Enable the vcos traced module
if TRACED
    config TRACE_READ_TIMES_MAX
        int "Trace read max times"
        range 1 300
        default 100
        ---help---
            Set the traced read note data max times per cycle.
            Valid range: 1-300 (default: 150)
            Note: This value affects the execution time of the runnable

    config TRACE_VAR_SECTION
        string "Trace section"
        ---help---
            Enable section information.

    menu "Trace Network Settings"
    config TRACE_SERVER_PORT
        int "Trace server port"
        range 1 65535
        default 18888
        ---help---
            Set the UDP port number for the trace server.
            Valid range: 1-65535 (default: 18888).
            Note: This option requires UDP protocol support

    config TRACE_SERVER_IP
        string "Trace server IP address"
        default "192.168.10.254"
        ---help---
            Set the IPv4 address of the trace server.
            Valid range: depends on the IP addr (default: 192.168.10.254).
            Note: This option requires UDP protocol support
    endmenu
endif
```

## components/security/crc/Kconfig
```kconfig
config SECURITY_CRC
    bool "security crc support"
    default n
	---help---
		Enable the SECURITY_CRC
```

## components/security/e2e/Kconfig
```kconfig
config MODULE_E2E
    bool "e2e support"
    default n
	---help---
		Enable the MODULE_E2E
```

## components/system_services/service_management/Kconfig
```kconfig
config SERVM_ECUM
    bool "servm ecum support"
    default n
    ---help---
        Enable the SERVM_ECUM

config SERVM_BSWM
    bool "servm bswm support"
    default n
    ---help---
        Enable the SERVM_BSWM
```

## tests/testcases/units/group_demo/Kconfig
```kconfig
config UNIT_GROUP_YOUR_GROUP
	bool "unit group your group"
	default n
	---help---
		Enable the UNIT_GROUP_YOUR_GROUP.
```

## vendor/autoc/boards/mcm7/Kconfig
```kconfig
if ARCH_BOARD_CUSTOM

config ARCH_BOARD_MCM7
	bool
	default y
	depends on ARCH_CHIP_AUTOC_MCM7

endif
```

## vendor/autoc/boards/mcm7/configs/vcos/defconfig
```kconfig
#include "gen_data.config"
CONFIG_APPS_DIR="../apps"
CONFIG_ARCH="arm"
CONFIG_ARCH_ARM=y
CONFIG_ARCH_BOARD_CUSTOM=y
CONFIG_ARCH_BOARD_CUSTOM_DIR="../vendor/autoc/boards/mcm7"
CONFIG_ARCH_BOARD_CUSTOM_DIR_RELPATH=y
CONFIG_ARCH_BOARD_CUSTOM_NAME="mcm7"
CONFIG_ARCH_CHIP_ARM_CUSTOM=y
CONFIG_ARCH_CHIP_CUSTOM=y
CONFIG_ARCH_CHIP_CUSTOM_DIR="../vendor/autoc/chips/mcm7"
CONFIG_ARCH_CHIP_CUSTOM_DIR_RELPATH=y
CONFIG_ARCH_CHIP_CUSTOM_NAME=""
CONFIG_ARCH_CHIP_AUTOC_MCM7=y
CONFIG_ARCH_FPU=y
CONFIG_ARM_TOOLCHAIN_GNU_EABI=y
CONFIG_ARMV7M_SYSTICK=y
CONFIG_TIMER=y
CONFIG_BMP=y
CONFIG_BMP_NCPUS=4
CONFIG_SYS_CLOCK_HW_CYCLES_PER_SEC=160000000
CONFIG_ARCH_INTERRUPTSTACK=4096
CONFIG_ARCH_SETJMP_H=y
CONFIG_RAM_START=0x20000000
CONFIG_RAM_SIZE=2097152
CONFIG_INIT_ENTRYPOINT="autoc_init_main"
CONFIG_BOARD_EARLY_INITIALIZE=y
CONFIG_BOARD_LATE_INITIALIZE=y
CONFIG_USEC_PER_TICK=1000
CONFIG_IDLETHREAD_STACKSIZE=4096
CONFIG_BUILTIN=y
CONFIG_DEBUG_FEATURES=y
CONFIG_DEBUG_SYMBOLS=y
CONFIG_EXPERIMENTAL=y
CONFIG_RAW_BINARY=y
CONFIG_SCHED_EVENTS=y
CONFIG_STACK_COLORATION=y
CONFIG_SYSTEM_NSH=y
CONFIG_SYSTEM_NSH_STACKSIZE=8192
CONFIG_NSH_READLINE=y
CONFIG_NSH_DISABLE_MKRD=y
CONFIG_NSH_DISABLESCRIPT=y
CONFIG_FS_PROCFS=y
CONFIG_NSH_BUILTIN_APPS=y
CONFIG_NSH_BUILTIN_AS_COMMAND=y
CONFIG_SYSTEM_TRACE=y
CONFIG_SERIAL_RTT0=y
CONFIG_SERIAL_RTT_CONSOLE=y
CONFIG_SEGGER_RTT_BUFFER_SIZE_UP=1024
CONFIG_SEGGER_RTT_BUFFER_SIZE_DOWN=256
```

## vendor/autoc/boards/scm7/Kconfig
```kconfig
if ARCH_BOARD_CUSTOM

config ARCH_BOARD_SCM7
	bool
	default y
	depends on ARCH_CHIP_AUTOC_SCM7

endif
```

## vendor/autoc/chips/mcm7/Kconfig
```kconfig
if ARCH_CHIP_CUSTOM

config ARCH_CHIP_AUTOC
	bool

config ARCH_CHIP_AUTOC_MCM7
	bool "autoc mcm7"
	select ARCH_CHIP_AUTOC
	select ARCH_CORTEXM7
	select ARCH_HAVE_MULTICPU

config SYS_CLOCK_HW_CYCLES_PER_SEC
	int
	default 160000000

endif
```

## vendor/autoc/chips/scm7/Kconfig
```kconfig
if ARCH_CHIP_CUSTOM

config ARCH_CHIP_AUTOC
	bool

config ARCH_CHIP_AUTOC_SCM7
	bool "autoc scm7"
	select ARCH_CHIP_AUTOC
	select ARCH_CORTEXM7

config SYS_CLOCK_HW_CYCLES_PER_SEC
	int
	default 160000000

endif
```
