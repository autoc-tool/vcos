AUTOSAR XML (schema 00044)
package /TS_T01D20M1I4R0
  ecuc definition collection myEcuParameterDefinition: module=Can
  module definition Can [1..*]: post-build-variant-support=true, refined-module-def=Can, variants post-build/pre-compile  # This container holds the configuration of a single CAN Driver.
    container CanConfigSet  # This container contains the configuration parameters and sub containers of the AUTOSAR Can module.
      container CanController [1..24]  # This container contains the configuration parameters of the CAN controller(s).
        boolean CanControllerActivation: set at pre-compile  # Defines if a CAN controller is used in the configuration.
        integer CanControllerId: 0..255, scope=ECU, set at pre-compile, symbolic-name-value=true  # This parameter provides the controller ID which is unique in a given CAN Driver. The value for this parameter starts with 0 and continue without any gaps.
        integer CanControllerBaseAddress: 0..4294967295, set at pre-compile  # Specifies the CAN controller base address.
        enumeration CanRxProcessing: {INTERRUPT, MIXED, POLLING}, set at pre-compile  # Enables / disables API Can_MainFunction_Read() for handling PDU reception events in polling mode.
        enumeration CanTxProcessing: {INTERRUPT, MIXED, POLLING}, set at pre-compile  # Enables / disables API Can_MainFunction_Write() for handling PDU transmission events in polling mode.
        enumeration CanBusoffProcessing: {INTERRUPT, POLLING}, set at pre-compile  # Enables / disables API Can_MainFunction_BusOff() for handling busoff events in polling mode.
        boolean CanWakeupFunctionalityAPI: set at pre-compile, default-value=false  # Adds / removes the service Can_CheckWakeup() from the code.
        enumeration CanWakeupProcessing: {INTERRUPT, POLLING}, set at pre-compile  # Enables / disables API Can_MainFunction_Wakeup() for handling wakeup events in polling mode.
        boolean CanWakeupSupport: set at pre-compile  # CAN driver support for wakeup over CAN Bus.
        boolean CanLoopBackEnable: origin=SemiDrive, set at pre-compile, default-value=false  # Enable loop-back mode.
        boolean CanListenOnlyEnable: origin=SemiDrive, set at pre-compile, default-value=false  # Enable listen-only mode.
        boolean CanSelfWakeupEnable: origin=SemiDrive, set at pre-compile, default-value=false  # Enable self wake-up.
        boolean CanClockFromOscillator: origin=SemiDrive, set at pre-compile, default-value=false  # Specify whether CAN protocol engine clock is from oscillator or not.
        boolean CanIndividualRxMaskEnable: origin=SemiDrive, set at pre-compile, default-value=true  # Enable individual Rx mask.
        boolean CanDozeModeEnable: origin=SemiDrive, set at pre-compile, default-value=true  # Enable doze mode.
        boolean CanLowestNumberMBFirst: origin=SemiDrive, set at pre-compile, default-value=false  # Specify whether lowest number MB is transmitted first or MB with highest priority is transmitted first.
        reference CanControllerDefaultBaudrate: post-build-variant-value=true, set at post-build in variant post-build / pre-compile in variant pre-compile, destination=CanControllerBaudrateConfig  # Reference to baudrate configuration container configured for the Can Controller.
        reference CanCpuClockRef: set at pre-compile, destination=McuClockReferencePoint  # Reference to the CPU clock configuration, which is set in the MCU driver configuration
        symbolic name reference CanWakeupSourceRef [0..1]: multiplicity set at pre-compile, set at pre-compile, destination=EcuMWakeupSource  # This parameter contains a reference to the Wakeup Source for this controller as defined in the ECU State Manager.
        container CanControllerBaudrateConfig [1..*]  # This container contains bit timing related configuration parameters of the CAN controller(s).
          integer CanControllerBaudRate: 0..2000, post-build-variant-value=true, set at post-build in variant post-build / pre-compile in variant pre-compile  # Specifies the baudrate of the controller in kbps.
          integer CanControllerBaudRateConfigID: scope=ECU, post-build-variant-value=true, set at post-build in variant post-build / pre-compile in variant pre-compile  # Uniquely identifies a specific baud rate configuration. This ID is used by SetBaudrate API.
          integer CanControllerPropSeg: 0..255, post-build-variant-value=true, set at post-build in variant post-build / pre-compile in variant pre-compile  # Specifies propagation delay in time quantas.
          integer CanControllerSeg1: 0..255, post-build-variant-value=true, set at post-build in variant post-build / pre-compile in variant pre-compile  # Specifies phase segment 1 in time quantas.
          integer CanControllerSeg2: 0..255, post-build-variant-value=true, set at post-build in variant post-build / pre-compile in variant pre-compile  # Specifies phase segment 2 in time quantas.
          integer CanControllerSyncJumpWidth: 0..255, post-build-variant-value=true, set at post-build in variant post-build / pre-compile in variant pre-compile  # Specifies the synchronization jump width for the controller in time quantas.
          container CanControllerFdBaudrateConfig [0..1]  # This optional container contains bit timing related configuration parameters of the CAN controller(s) for payload and CRC of a CAN FD frame. If this container exists the controller supports CAN FD frames.
            integer CanControllerFdBaudRate: 0..16000, post-build-variant-value=true, set at post-build in variant post-build / pre-compile in variant pre-compile  # Specifies the data segment baud rate of the controller in kbps.
            integer CanControllerPropSeg: 0..255, post-build-variant-value=true, set at post-build in variant post-build / pre-compile in variant pre-compile  # Specifies propagation delay in time quantas.
            integer CanControllerSeg1: 0..255, post-build-variant-value=true, set at post-build in variant post-build / pre-compile in variant pre-compile  # Specifies phase segment 1 in time quantas.
            integer CanControllerSeg2: 0..255, post-build-variant-value=true, set at post-build in variant post-build / pre-compile in variant pre-compile  # Specifies phase segment 2 in time quantas.
            integer CanControllerSyncJumpWidth: 0..255, post-build-variant-value=true, set at post-build in variant post-build / pre-compile in variant pre-compile  # Specifies the synchronization jump width for the controller in time quantas.
            integer CanControllerTrcvDelayCompensationOffset [0..1]: 1..31, multiplicity set at post-build in variant post-build / pre-compile in variant pre-compile, post-build-variant-multiplicity=true, post-build-variant-value=true, set at post-build in variant post-build / pre-compile in variant pre-compile  # Specifies the Transceiver Delay Compensation Offset in ns, the allowed range is 1-31 and CompensationOffset = TDCOFF * 1 /(PE clock). If not specified Transceiver Delay Compensation is disabled.
            boolean CanControllerTxBitRateSwitch: post-build-variant-value=true, set at post-build in variant post-build / pre-compile in variant pre-compile, default-value=true  # Specifies if the bit rate switching shall be used for transmissions.
            boolean CanControllerISOCANFD: origin=SemiDrive, set at post-build in variant post-build / pre-compile in variant pre-compile, default-value=true  # Specifies if selecting ISO CAN FD feature.
        container CanMessageBufferRegionConfig [0..*]  # can mailbox divide two message buffer, determind the message size, in one region the message may be different.
          enumeration CanMessageBufferRegionName: {CAN_MB_REGION_0, CAN_MB_REGION_1, CAN_MB_REGION_2, CAN_MB_REGION_3}, origin=SemiDrive, set at post-build in variant post-build / pre-compile in variant pre-compile, default-value=CAN_MB_REGION_0  # message buffer region name.
          enumeration CanMessageBufferRegionSize: {CAN_MB_8_BYTES_PAYLOAD, CAN_MB_16_BYTES_PAYLOAD, CAN_MB_32_BYTES_PAYLOAD, CAN_MB_64_BYTES_PAYLOAD}, origin=SemiDrive, set at post-build in variant post-build / pre-compile in variant pre-compile, default-value=CAN_MB_8_BYTES_PAYLOAD  # Specify Message Buffer Data Size for each RAM block
        container CanRxFIFOFilterTableConfig [0..1]  # rx fifo table config
          enumeration CanRxFIFOFilterTableFormat [0..0]: {RX_FIFO_FILTER_TYPE_A, RX_FIFO_FILTER_TYPE_B, RX_FIFO_FILTER_TYPE_C, RX_FIFO_FILTER_TYPE_D}, origin=SemiDrive, set at post-build in variant post-build / pre-compile in variant pre-compile, default-value=RX_FIFO_FILTER_TYPE_A  # Specify the format of the Rx FIFO ID filter table elements.
          boolean CanRxFIFOHighPriority: origin=SemiDrive, set at post-build in variant post-build / pre-compile in variant pre-compile, default-value=false  # Specify whether matching starts from mailboxes or Rx FIFO.
          enumeration CanRxEnhancedFIFOFilterScheme [0..1]: {RX_FIFO_MASK_FILTER_SCHEME, RX_FIFO_RANGE_FILTER_SCHEME, RX_FIFO_TWO_FILTER_SCHEME}, origin=SemiDrive, set at post-build in variant post-build / pre-compile in variant pre-compile, default-value=RX_FIFO_MASK_FILTER_SCHEME  # Specify the format of the Enhanced Rx FIFO ID filter table elements.
          integer CanEnhancedFIFOWatermarkLevel [0..1]: 0.., origin=SemiDrive, set at post-build in variant post-build / pre-compile in variant pre-compile, default-value=0  # Enhanced Rx FIFO Watermarl Indication Interrupt Enable.
          boolean CanRxEnhancedFIFOWithDpeEnable: origin=SEMIDRIVE, set at pre-compile, default-value=false  # Defines if CanRxEnhancedFIFO deliver to dpe
        container CanTTController [0..1]  # CanTTController is specified in the SWS TTCAN and contains the configuration parameters of the TTCAN controller(s) (which are needed in addition to the configuration parameters of the CAN controller(s)).
          integer CanTTControllerApplWatchdogLimit: 0..255, scope=ECU, post-build-variant-value=true, set at post-build in variant post-build / pre-compile in variant pre-compile  # Defines the maximum time period (unit is 256 times NTU) after which the application has to serve the watchdog.
          integer CanTTControllerCycleCountMax: 0..63, scope=ECU, post-build-variant-value=true, set at post-build in variant post-build / pre-compile in variant pre-compile  # Defines the value for cycle_count_max.
          integer CanTTControllerExpectedTxTrigger: 0..255, post-build-variant-value=true, set at post-build in variant post-build / pre-compile in variant pre-compile  # Number of expected_tx_trigger.
          boolean CanTTControllerExternalClockSynchronisation: scope=ECU, post-build-variant-value=true, set at post-build in variant post-build / pre-compile in variant pre-compile  # Enables/disables the external clock synchronization.
          boolean CanTTControllerGlobalTimeFiltering: post-build-variant-value=true, set at post-build in variant post-build / pre-compile in variant pre-compile  # Enables/disables the global time filtering.
          integer CanTTControllerInitialRefOffset: 0..127, scope=ECU, post-build-variant-value=true, set at post-build in variant post-build / pre-compile in variant pre-compile  # Defines the initial value for ref trigger offset.
          integer CanTTControllerInterruptEnable: 0..1023, post-build-variant-value=true, set at post-build in variant post-build / pre-compile in variant pre-compile  # Enables/disables the respective interrupts.
          boolean CanTTControllerLevel2: post-build-variant-value=true, set at post-build in variant post-build / pre-compile in variant pre-compile  # Defines whether Level 2 or Level 1 is used.
          float CanTTControllerNTUConfig: 0.0..100.0, scope=ECU, post-build-variant-value=true, set at post-build in variant post-build / pre-compile in variant pre-compile  # Defines the config value for NTU (network time unit).
          enumeration CanTTControllerOperationMode: {CAN_TT_EVENT_SYNC_TIME_TRIGGERED, CAN_TT_EVENT_TRIGGERED, CAN_TT_TIME_TRIGGERED}, scope=ECU, post-build-variant-value=true, set at post-build in variant post-build / pre-compile in variant pre-compile  # Defines the operation mode.
          float CanTTControllerSyncDeviation: 0.0..100.0, post-build-variant-value=true, set at post-build in variant post-build / pre-compile in variant pre-compile  # Defines the maximum synchronization deviation:
          boolean CanTTControllerTimeMaster: scope=ECU, post-build-variant-value=true, set at post-build in variant post-build / pre-compile in variant pre-compile  # Defines whether the controller acts as a potential time master.
          integer CanTTControllerTimeMasterPriority: 0..7, scope=ECU, post-build-variant-value=true, set at post-build in variant post-build / pre-compile in variant pre-compile  # Defines the time master priority.
          boolean CanTTControllerTURRestore: post-build-variant-value=true, set at post-build in variant post-build / pre-compile in variant pre-compile  # Enables/disables the TUR restore.
          integer CanTTControllerTxEnableWindowLength: 1..16, scope=ECU, post-build-variant-value=true, set at post-build in variant post-build / pre-compile in variant pre-compile  # Length of the tx enable window given in CAN bit times.
          integer CanTTControllerWatchTriggerGapTimeMark: 0..65535, post-build-variant-value=true, set at post-build in variant post-build / pre-compile in variant pre-compile  # watch trigger time mark after a gap
          integer CanTTControllerWatchTriggerTimeMark: 0..65535, post-build-variant-value=true, set at post-build in variant post-build / pre-compile in variant pre-compile  # watch trigger time mark
          enumeration CanTTIRQProcessing: {INTERRUPT, POLLING}, scope=ECU, post-build-variant-value=true, set at post-build in variant post-build / pre-compile in variant pre-compile  # Enables / disables API Can_MainFunction_BusOff() for handling busoff events in polling mode.
      container VCanController [0..16]  # This container contains the configuration parameters of the CAN controller(s).
        boolean VCanControllerActivation: origin=SEMIDRIVE, set at pre-compile, default-value=false  # Defines if a VCAN controller is used in the configuration.
        integer VCanControllerId: 0..255, scope=ECU, origin=SEMIDRIVE, set at pre-compile, symbolic-name-value=true  # This parameter provides the vcan controller ID which is unique in a given VCAN Driver. The value for this parameter starts with 0 and continue without any gaps.
        enumeration VCanRxProcessing: {INTERRUPT, POLLING}, origin=SEMIDRIVE, set at pre-compile  # Enables / disables API Can_MainFunction_Read() for handling PDU reception events in polling mode.
        enumeration VCanTxProcessing: {INTERRUPT, MIXED, POLLING}, origin=SEMIDRIVE, set at pre-compile  # Enables / disables API Can_MainFunction_Write() for handling PDU transmission events in polling mode.
        integer VCanPayLoadSize: origin=SEMIDRIVE, set at pre-compile, default-value=8  # Vcan payloadsize configuration
        boolean VCanWakeupFunctionalityAPI: origin=SEMIDRIVE, set at pre-compile, default-value=false  # Adds / removes the service Can_CheckWakeup() from the code.
        boolean VCanWakeupSupport: origin=SEMIDRIVE, set at pre-compile, default-value=false  # VCAN driver support for wakeup over CAN Bus.
        boolean VCanPacketDropEnable: origin=SEMIDRIVE, set at pre-compile, default-value=false  # Defines if a VCAN controller could drop packet.
        boolean VCanReceiveDoneIntEnable: origin=SEMIDRIVE, set at pre-compile, default-value=false  # Defines if a VCAN controller could generate interrupt when receive a packet
        boolean VCanReceiveDropIntEnable: origin=SEMIDRIVE, set at pre-compile, default-value=false  # Defines if a VCAN controller could generate interrupt when receive packet is dropped
        boolean VCanSendDoneIntEnable: origin=SEMIDRIVE, set at pre-compile, default-value=false  # Defines if a VCAN controller could generate interrupt when send packet done
        boolean VCanSendTimeoutIntEnable: origin=SEMIDRIVE, set at pre-compile, default-value=false  # Defines if a VCAN controller could generate interrupt when send packet timeout
        boolean VCanSendDropIntEnable: origin=SEMIDRIVE, set at pre-compile, default-value=false  # Defines if a VCAN controller could generate interrupt when send packet is dropped
      container CanHardwareObject [1..*]  # This container contains the configuration (parameters) of CAN Hardware Objects.
        integer CanFdPaddingValue [0..1]: 0..255, scope=ECU, multiplicity set at pre-compile, post-build-variant-value=true, set at pre-compile, default-value=0  # Specifies the value which is used to pad unspecified data in CAN FD frames > 8 bytes for transmission. This is necessary due to the discrete possible values of the DLC if > 8 bytes.
        enumeration CanHandleType: {BASIC, FULL}, scope=ECU, post-build-variant-value=true, set at post-build in variant post-build / pre-compile in variant pre-compile  # Specifies the type (Full-CAN or Basic-CAN) of a hardware object.
        boolean CanHardwareObjectUsesPolling [0..1]: default-value=false  # Enables polling of this hardware object.
        integer CanHwObjectCount: 1..65535, scope=ECU, post-build-variant-value=true, set at post-build in variant post-build / pre-compile in variant pre-compile, default-value=1  # Number of hardware objects used to implement one HOH. In case of a HRH this parameter defines the number of elements in the hardware FIFO or the number of shadow buffers, in case of a HTH it defines the number of hardware objects used for multiplexed transmission or for a hardware FIFO used by a FullCAN HTH.
        enumeration CanIdType: {EXTENDED, MIXED, STANDARD}, scope=ECU, post-build-variant-value=true, set at post-build in variant post-build / pre-compile in variant pre-compile  # Specifies whether the IdValue is of type
        integer CanObjectId: 0..65535, scope=ECU, set at pre-compile, symbolic-name-value=true  # Holds the handle ID of HRH or HTH. The value of this parameter is unique in a given CAN Driver, and it should start with 0 and continue without any gaps.
        enumeration CanObjectType: {RECEIVE, TRANSMIT}, scope=ECU, post-build-variant-value=true, set at post-build in variant post-build / pre-compile in variant pre-compile  # Specifies if the HardwareObject is used as Transmit or as Receive object
        boolean CanTriggerTransmitEnable [0..1]: scope=ECU, set at pre-compile, default-value=false  # This parameter defines if or if not Can supports the trigger-transmit API for this handle.
        choice reference CanControllerRef: post-build-variant-value=true, set at post-build in variant post-build / pre-compile in variant pre-compile, destination=[CanController, VCanController]  # Reference to CAN Controller to which the HOH is associated to.
        reference CanMessageBufferRegionRef [0..1]: multiplicity set at pre-compile, origin=SemiDrive, post-build-variant-value=true, set at pre-compile, destination=CanMessageBufferRegionConfig  # Reference to CAN Message Buffer region to which the HOH is associated to.
        reference CanMainFunctionRWPeriodRef [0..1]: multiplicity set at pre-compile, post-build-variant-value=true, set at pre-compile, destination=CanMainFunctionRWPeriods  # Reference to CanMainFunctionPeriod
        container CanHwFilter [0..*]  # This container is only valid for HRHs and contains the configuration (parameters) of one hardware filter.
          integer CanHwFilterCode: 0..4294967295, post-build-variant-value=true, set at post-build in variant post-build / pre-compile in variant pre-compile  # Specifies (together with the filter mask) the identifiers range that passes the hardware filter.
          integer CanHwFilterMask: 0..4294967295, post-build-variant-value=true, set at post-build in variant post-build / pre-compile in variant pre-compile  # Describes a mask for hardware-based filtering of CAN identifiers. The CAN identifiers of incoming messages are masked with the appropriate CanFilterMaskValue. Bits holding a 0 mean don't care, i.e. do not compare the message's identifier in the respective bit position.
        container CanTTHardwareObjectTrigger [0..0]  # CanTTHardwareObjectTrigger is specified in the SWS TTCAN and contains the configuration (parameters) of TTCAN triggers for Hardware Objects, which are additional to the configuration (parameters) of CAN Hardware Objects.
          integer CanTTHardwareObjectBaseCycle: 0..63, scope=ECU, post-build-variant-value=true, set at post-build in variant post-build / pre-compile in variant pre-compile  # Defines the cycle_offset.
          integer CanTTHardwareObjectCycleRepetition: 1..64, scope=ECU, post-build-variant-value=true, set at post-build in variant post-build / pre-compile in variant pre-compile  # Defines the repeat_factor.
          integer CanTTHardwareObjectTimeMark: 0..65535, post-build-variant-value=true, set at post-build in variant post-build / pre-compile in variant pre-compile  # Defines the point in time, when the trigger will be activated.
          integer CanTTHardwareObjectTriggerId: 0..63, set at pre-compile, symbolic-name-value=true  # Sequential number which allows separation of different TTCAN triggers configured for one and the same hardware object.
          enumeration CanTTHardwareObjectTriggerType: {CAN_TT_RX_TRIGGER, CAN_TT_TX_REF_TRIGGER, CAN_TT_TX_REF_TRIGGER_GAP, CAN_TT_TX_TRIGGER_EXCLUSIVE, CAN_TT_TX_TRIGGER_MERGED, CAN_TT_TX_TRIGGER_SINGLE}, post-build-variant-value=true, set at post-build in variant post-build / pre-compile in variant pre-compile  # Defines the type of the trigger associated with the hardware object. This parameter depends on plain CAN parameter CAN_OBJECT_TYPE.
      container CanIcom [0..0]  # This container contains the parameters for configuring pretended networking
        container CanIcomConfig [1..*]  # This container contains the configuration parameters of the ICOM Configuration.
          integer CanIcomConfigId: 1..255, scope=ECU, set at pre-compile  # This parameter identifies the ID of the ICOM configuration.
          boolean CanIcomWakeOnBusOff: scope=ECU, set at pre-compile, default-value=true  # This parameter defines that the MCU shall wake if the bus off is detected or not.
          container CanIcomWakeupCauses  # This container contains the configuration parameters of the wakeup causes to leave the power saving mode.
            container CanIcomRxMessage [1..*]  # This container contains the configuration parameters for the wakeup causes for matching received messages. It has to be configured as often as received messages are defined as wakeup cause.
              integer CanIcomCounterValue [0..1]: 1..65536, scope=ECU, multiplicity set at pre-compile, set at pre-compile  # This parameter defines that the MCU shall wake if the message with the ID is received n times on the communication channel.
              integer CanIcomMessageId: 0..536870912, scope=ECU, set at pre-compile  # This parameter defines the message ID the wakeup causes of this CanIcomRxMessage are configured for. In addition a mask (CanIcomMessageIdMask) can be defined, in that case it is possible to define a range of rx messages, which can create a wakeup condition.
              integer CanIcomMessageIdMask [0..1]: 0..536870912, scope=ECU, multiplicity set at pre-compile, set at pre-compile  # Describes a mask for filtering of CAN identifiers. The CAN identifiers of incoming messages are masked with this CanIcomMessageIdMask. If the masked identifier matches the masked value of CanIcomMessageId, it can create a wakeup condition for this CanIcomRxMessage. Bits holding a 0 mean don't care, i.e. do not compare the message's identifier in the respective bit position. The mask shall be build by filling with leading 0.
              float CanIcomMissingMessageTimerValue [0..1]: scope=ECU, multiplicity set at pre-compile, set at pre-compile  # This parameter defines that the MCU shall wake if the message with the ID is not received for a specific time in s on the
              boolean CanIcomPayloadLengthError: scope=ECU, set at pre-compile, default-value=false  # This parameter defines that the MCU shall wake if a payload error occurs
              container CanIcomRxMessageSignalConfig [0..*]  # This container contains the configuration parameters for the wakeup causes for matching signals.
                integer CanIcomSignalMask: 0..9223372036854775807, set at pre-compile  # This parameter shall be used to mask a signal in the payload of a CAN message.
                enumeration CanIcomSignalOperation: {AND, EQUAL, GREATER, SMALLER, XOR}, scope=ECU, set at pre-compile  # This parameter defines the operation, which shall be used to verify the signal value creates a wakeup condition.
                integer CanIcomSignalValue: 0..9223372036854775807, set at pre-compile  # This parameter shall be used to define a signal value which shall be compared (CanIcomSignalOperation) with the masked CanIcomSignalMask value of the received signal (CanIcomSignalRef).
                reference CanIcomSignalRef [0..1]: scope=ECU, multiplicity set at pre-compile, set at pre-compile, destination=ComSignal  # This parameter defines a reference to the signal which shall be checked additional to the message id (CanIcomMessageId).
    container CanGeneral  # This container contains the parameters related each CAN Driver Unit.
      enumeration CanVersion: {AUTOSAR_VERSION_431, AUTOSAR_VERSION_421, AUTOSAR_VERSION_403}, origin=Semidrive, set at pre-compile, default-value=AUTOSAR_VERSION_431  # specific the AUTOSAR CAN driver version.
      boolean VirtualCanEnable: origin=SemiDrive, set at pre-compile, default-value=false  # Enable or disable virtual can, The can message will be routing by SDPE(semidriver package engine) if enable, otherwise the can message transmit or receive by native can driver.
      boolean CanDevErrorDetect: set at pre-compile, default-value=false  # Switches the development error detection and notification on or off.
      integer CanIndex: 0..255, set at pre-compile  # Specifies the InstanceId of this module instance. If only one instance is present it shall have the Id 0.
      function name CanLPduReceiveCalloutFunction [0..1]: multiplicity set at pre-compile, set at pre-compile, default-value=NULL_PTR  # This parameter defines the existence and the name of a callout function that is called after a successful
      float CanMainFunctionBusoffPeriod [0..1]: 0.0..INF, multiplicity set at pre-compile, set at pre-compile  # This parameter describes the period for cyclic call to Can_MainFunction_Busoff. Unit is seconds.
      float CanMainFunctionModePeriod: 0.0..INF, set at pre-compile  # This parameter describes the period for cyclic call to Can_MainFunction_Mode. Unit is seconds.
      float CanMainFunctionWakeupPeriod [0..1]: 0.0..INF, multiplicity set at pre-compile, set at pre-compile  # This parameter describes the period for cyclic call to Can_MainFunction_Wakeup. Unit is seconds.
      boolean CanMultiplexedTransmission: scope=ECU, set at pre-compile  # Specifies if multiplexed transmission shall be supported.ON or OFF
      boolean CanPublicIcomSupport: scope=ECU, set at pre-compile, default-value=false  # Selects support of Pretended Network features in Can driver.
      boolean CanSetBaudrateApi [0..1]: scope=ECU, multiplicity set at pre-compile, set at pre-compile, default-value=false  # The support of the Can_SetBaudrate API is optional.
      float CanTimeoutDuration: 1.0E-6..65.535, set at pre-compile  # Specifies the maximum time for blocking function until a timeout is detected. Unit is seconds.
      boolean CanVersionInfoApi: set at pre-compile, default-value=false  # Switches the Can_GetVersionInfo() API ON or OFF.
      integer VCanControllerBaseAddress: 0..4294967295, origin=SEMIDRIVE, set at pre-compile, default-value=0  # Specifies the VCAN controller base address.(equal to DPE base address)
      integer CanTimeoutCnt: 0..4294967295, origin=SEMIDRIVE, set at pre-compile, default-value=1000000  # Can timeout counter value
      reference CanOsCounterRef [0..1]: multiplicity set at pre-compile, set at pre-compile, destination=OsCounter  # This parameter contains a reference to the OsCounter, which is used by the CAN driver.
      reference CanSupportTTCANRef [0..1]: scope=ECU, set at pre-compile, destination=CanIfPrivateCfg  # The parameter refers to CanIfSupportTTCAN parameter in the CAN Interface Module configuration.
      container CanIcomGeneral [0..1]  # This container contains the general configuration parameters of the ICOM Configuration.
        enumeration CanIcomLevel: {CAN_ICOM_LEVEL_ONE, CAN_ICOM_LEVEL_TWO}, scope=ECU, set at pre-compile, default-value=CAN_ICOM_LEVEL_ONE  # Defines the level of Pretended Networking.
        enumeration CanIcomVariant: {CAN_ICOM_VARIANT_HW, CAN_ICOM_VARIANT_NONE, CAN_ICOM_VARIANT_SW}, scope=ECU, set at pre-compile, default-value=CAN_ICOM_VARIANT_NONE  # Defines the variant, which is supported by this CanController
      container CanMainFunctionRWPeriods [0..*]  # This container contains the parameter for configuring the period for cyclic call to Can_MainFunction_Read or Can_MainFunction_Write depending on the referring item.
        float CanMainFunctionPeriod: 0.0..INF, set at pre-compile  # This parameter describes the period for cyclic call to Can_MainFunction_Read or Can_MainFunction_Write depending on the referring item. Unit is seconds. Different poll-cycles will be configurable if more than one CanMainFunctionPeriod is configured. In this case multiple Can_MainFunction_Read() or Can_MainFunction_Write() will be provided by the CAN Driver module.
