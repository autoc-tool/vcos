AUTOSAR XML (schema 00044)
package /TS_T01D20M1I4R0
  module definition ResourceManager [0..1]: post-build-variant-support=true, variants post-build/pre-compile  # .
    container ChipInfo  # Display the chip's main feature.
      string PartNum: origin=SEMIDRIVE  # Current chip part num.
      string CpuMaxFrequency: origin=SEMIDRIVE  # Cpu maximum frequency.
      container CoreList  # Display the core matrix.
        boolean Core{0..3} [0..1]: default-value=true  # Display if the Core{0..3} core exist.
    container ResMMcalCore [0..4]: multiplicity set at pre-compile  # General container to allocate Mcal resources to cores
      enumeration ResMCoreID: {Core0, Core1, Core2, Core3}, origin=SEMIDRIVE, set at pre-compile, default-value=Core0  # Select Master core.
      container ResMAllocation [1..*]: multiplicity set at pre-compile  # Container to allocate module resources.
        enumeration ResMModuleName: {ADC, PWM, ICU, GPT, CAN, SPI}, origin=SEMIDRIVE, set at pre-compile, default-value=ADC  # Module name.
        choice reference ResMResourceRef: scope=ECU, origin=SEMIDRIVE, set at pre-compile, destination=[PwmController, IcuChannel, GptChannelConfiguration, AdcHwUnit, EthCtrlConfig, WdgSettingsConfig, EthTrcvConfig, SpiHwUnit, SpiSlaveHwUnit, DmaHwUnit, SentConfigSet, LinChannel, I2cChannel, UartChannel, CanController, VCanController]  # This parameter contains reference to resource
