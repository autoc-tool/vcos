AUTOSAR XML (schema 00049)
package /FC7300FXXX
  module definition Can [0..*]: post-build-variant-support=true, refined-module-def=Can, variants post-build/pre-compile  # ECUC_Can_00489: This container holds the configuration of a single CAN Driver. VARIANT-POST-BUILD, VARIANT-PRE-COMPILE
    container CanGeneral  # ECUC_Can_00328: This container holds the parameters related each CAN Driver Unit.
      boolean CanDemSupport: origin=Flagchip, set at pre-compile, default-value=true  # for Dem.h include support
      boolean CanDevErrorDetect: set at pre-compile, default-value=false  # ECUC_Can_00064: Switches the development error detection and notification on or off. * true: enabled (on). * false: disabled (off).
      boolean CanEnableSecurityEventReporting: scope=ECU, set at pre-compile, default-value=false  # Switches the reporting of security events to the IdsM: Tags: atp.Status=draft
      integer CanIndex: 0..255, set at pre-compile, default-value=0  # ECUC_Can_00320: Specifies the InstanceId of this module instance. If only one instance is present it shall have the Id 0.
      function name CanLPduReceiveCalloutFunction [0..1]: multiplicity set at pre-compile, set at pre-compile, default-value=NULL_PTR  # ECUC_Can_00434: This parameter defines the existence and the name of a callout function that is called after a successful reception of a received CAN Rx L-PDU. If this parameter is omitted no callout shall take place.
      float CanMainFunctionBusoffPeriod [0..1]: 0.001..65.535, multiplicity set at pre-compile, set at pre-compile, default-value=0.001  # ECUC_Can_00355: This parameter describes the period for cyclic call to Can_MainFunction_Busoff. Unit is seconds.
      float CanMainFunctionModePeriod [0..1]: 0.001..65.535, multiplicity set at pre-compile, set at pre-compile, default-value=0.001  # ECUC_Can_00376: This parameter describes the period for cyclic call to Can_MainFunction_Mode. Unit in seconds.
      float CanMainFunctionWakeupPeriod [0..1]: 0.001..65.535, multiplicity set at pre-compile, set at pre-compile, default-value=0.001  # ECUC_Can_00357: This parameter describes the period for cyclic call to Can_MainFunction_Wakeup. Unit is seconds. when Can->CanConfigSet->CanController->CanWakeupSupport is 'true', editable. wakeup is not supported in FC7300
      boolean CanMultiplexedTransmission: scope=ECU, set at pre-compile, default-value=true  # ECUC_Can_00095: Specifies if Multiplexed Transmission shall be supported: ON or OFF. Multiplex transmission means to search for a free MB, that has the same ObjectId with the one transmitted to Can_Write, if current Hth MB is busy. dependency: CAN Hardware Unit supports multiplexed transmission
      float CanTimeoutDuration: 0.001..65.535, set at pre-compile, default-value=0.1  # ECUC_Can_00113: Specifies the maximum time for blocking function until a timeout is detected. Unit is seconds. This Timeout is used to detect the Hardware Errors/ Production Errors. When Hardware registers like Controller Register (CTRL) or Module Control Register(MCR) are configured, the Hardware take some time to take effect of these new settings CANuested. Once timeout has been occured and if hardware could not take effect of the CANu settings, then Error is reported. So this timeout is used to allow hardware to take effect of the Hardware settings.
      enumeration CanVersion: {AUTOSAR_VERSION_421, AUTOSAR_VERSION_431, AUTOSAR_VERSION_403}, set at pre-compile, default-value=AUTOSAR_VERSION_421
      boolean CanSetBaudrateApi [0..1]: scope=ECU, multiplicity set at pre-compile, set at pre-compile, default-value=false  # ECUC_Can_00482: If the parameter is set to true the Can_SetBaudrate Api shall be supported.
      boolean CanApiEnableMbAbort: origin=Flagchip, set at pre-compile, default-value=false  # Enables an additional API, to write an ABORT code (b1001) to the MBCB filed of the MB to abort a message transmission. Based on this value a define will be generated with STD_ON or STD_OFF value: CAN_API_ENABLE_ABORT_MB. It is editable only if "CanHardwareCancellation" = true.
      boolean CanAbortOnlyOneMB: origin=Flagchip, set at pre-compile, default-value=false  # When this parameter is true only one MB will be aborted by Can_AbortMb() When this parameter is false all the associated mailboxes will be aborted when multiplex transmission is enabled Note : This parameter is enabled only if CanMultiplexedTransmission=STD_ON
      boolean CanVersionInfoApi: set at pre-compile, default-value=true  # ECUC_Can_00106: Switches the Can_GetVersionInfo() API: ON or OFF. When this option is ON driver supports API for getting Version information for the Driver.
      boolean CanMulticoreSupport: origin=FLAGCHIP, set at pre-compile, default-value=false  # Switches multicore support on or off: False: For all variants, no EcucPartition shall be referenced in CanEcucPartitionRef. True: For all variants, at least one EcucPartition needs to be referenced in CanEcucPartitionRef.
      boolean CanAllowLoopAsCycle: origin=Flagchip, set at pre-compile, default-value=false  # If Os counter cannot be get, could set here to use SW timer to calculate. OsCounter provided by the system service for timeout detection in case the hardware does not react in the expected time (hardware malfunction) to prevent endless loops.
      integer CanNumberOfTimeOutLoop: 1..65535, origin=Flagchip, set at pre-compile, default-value=1  # Specifies the maximum time for blocking function until a timeout is detected. Unit is number of while(1). like:while(1){Counter++;} This Timeout is used to detect the Hardware Errors/ Production Errors. When Hardware registers like Controller Register (CTRL) or Module Control Register(MCR) are configured, the Hardware take some time to take effect of these new settings CANuested. Once timeout has been occured and if hardware could not take effect of the CANu settings, then Error is reported. So this timeout is used to allow hardware to take effect of the Hardware settings.
      boolean CanExtendedIDSupport: origin=Flagchip, set at pre-compile, default-value=true  # Enables support of Extended/Mixed mode (permit to use IDs of 29 bits length). Note Implementation specific Parameter. Not AutoSar Required.
      boolean CanMBCountExtensionSupport: origin=Flagchip, set at pre-compile, default-value=false  # Enables support of more than 255 Can Hardware Objects. Some platforms have a bigger number of Can controllers and the sum of total MBS for all controllers is bigger than uint8 size (as HTH/HRH is specified in Autosar). This option should not be enabled for platforms that have a number of MBs smaller than 256 (summing all Can controllers from the platform). Note Implementation Specific parameter.
      reference CanOsCounterRef [0..1]: multiplicity set at pre-compile, set at pre-compile, destination=OsCounter  # ECUC_Can_00431: This parameter contains a reference to the counter, which is used by the CAN driver. Reference to [ OsCounter ]
      reference CanSupportTTCANRef: scope=ECU, set at pre-compile, destination=CanIfPrivateCfg  # ECUC_Can_00430: Reference to CAN Hardware Object which shall be polled with the configured CanMainFunctionWritePeriod. This reference shall only be configurable if more than one period is configured via CanMainFunctionWritePeriod.
      reference CanEcucPartitionRef [0..*]: scope=ECU, multiplicity set at pre-compile, post-build-variant-multiplicity=true, post-build-variant-value=true, set at pre-compile, destination=EcucPartition  # Maps the Ethernet driver to zero or multiple ECUC partitions to make the module's API available in this partition. The Ethernet driver will operate as an independent instance in each of the partitions.
      container CanMainFunctionRWPeriods [0..*]: multiplicity set at pre-compile  # ECUC_Can_00437. This container contains the parameter for configuring the period for cyclic call to Can_MainFunction_Read or Can_MainFunction_Write depending on the referring item.
        float CanMainFunctionPeriod: 0.001..65.535, set at pre-compile, default-value=0.001  # ECUC_Can_00484. This parameter describes the period for cyclic call to Can_MainFunction_Read or Can_MainFunction_Write depending on the referring item. Unit is seconds. Different poll-cycles will be configurable if more than one CanMainFunctionPeriod is configured. In this case multiple Can_MainFunction_Read() or Can_MainFunction_Write() will be provided by the CAN Driver module.
    container CanConfigSet  # ECUC_Can_00434: This is the multiple configuration set container for CAN Driver.
      container CanController [1..*]: multiplicity set at pre-compile  # ECUC_Can_00354: This container contains the configuration parameters of the CAN controller(s).
        enumeration CanHwChannel: {FlexCAN_0, FlexCAN_1, FlexCAN_2, FlexCAN_3, FlexCAN_4, FlexCAN_5, FlexCAN_6, FlexCAN_7, FlexCAN_8, FlexCAN_9, FlexCAN_10, FlexCAN_11, FlexCAN_12, FlexCAN_13}, origin=Flagchip, set at pre-compile  # Specifies which one of the on-chip FlexCAN interfaces is associated with this controller ID. Note Implementation Specific parameter. Not AutoSar Required.
        enumeration CanBusoffProcessing: {INTERRUPT, POLLING}, set at pre-compile, derivation=informal-formula=verbatim=l-5=Mode of event triggering: INTERRUPT or POLLING., default-value=POLLING  # ECUC_Can_00314: Enables/Disables API Can_MainFunction_BusOff() for handling busoff events in POLLING mode.
        boolean CanControllerActivation: set at pre-compile, default-value=true  # ECUC_Can_00315: Defines if a CAN controller is used in the configuration. Deactivation of a particular CAN controller is equivalent to a CAN controller not used in the configuration.
        integer CanControllerBaseAddress: 0..4294967295, set at pre-compile, default-value=0  # ECUC_Can_00382: Specifies the CAN controller base address.
        integer CanControllerId: 0..255, scope=ECU, set at pre-compile, symbolic-name-value=true  # ECUC_Can_00316: This parameter provides the controller ID which is unique in a given CAN Driver. The value for this parameter starts with 0 and continue without any gaps.
        enumeration CanRxProcessing: {INTERRUPT, MIXED, POLLING}, set at pre-compile, derivation=informal-formula=verbatim=l-5=Mode of event triggering: INTERRUPT or POLLING., default-value=POLLING  # ECUC_Can_00317: Enables/Disables API Can_MainFunction_Read() for handling PDU reception events in POLLING mode.
        enumeration CanTxProcessing: {INTERRUPT, MIXED, POLLING}, set at pre-compile, derivation=informal-formula=verbatim=l-5=Mode of event triggering: INTERRUPT or POLLING., default-value=POLLING  # ECUC_Can_00318: Enables/Disables API Can_MainFunction_Write() for handling PDU transmission events in POLLING mode
        boolean CanWakeupFunctionalityAPI: set at pre-compile, default-value=false  # ECUC_Can_00466: Adds / removes the service Can_CheckWakeup() from the code. True: Can_CheckWakeup can be used. False: Can_CheckWakeup cannot be used.
        enumeration CanWakeupProcessing: {INTERRUPT, POLLING}, set at pre-compile, derivation=informal-formula=verbatim=l-5=Mode of event triggering: INTERRUPT or POLLING., default-value=POLLING  # ECUC_Can_00319: Enables/Disables API Can_MainFunction_Wakeup() for handling wakeup events in POLLING mode. Note This option is enabled only if global parameter is 'true'.
        boolean CanWakeupSupport: set at pre-compile, default-value=false  # ECUC_Can_00330: CAN driver support for wakeup over CAN Bus. Every WakeUp process will be ignore if this checkbox is not set to ON. This parameter enables Internal Wakeup (using controller registers) and External Wakeup (using WKUP module). This is enabled only if internal Wakeup is supported by the platform.
        boolean CanBccSupport: origin=Flagchip, set at pre-compile, default-value=false  # Defines if Backwards Compatibility Configuration (BCC) feature of CAN controller is used in the configuration. If BCC feature of CAN controller is enabled, Individual Rx masking and queue feature are disabled. If BCC feature of CAN controller is disabled, Individual Rx masking and queue feature are enabled. Note Implementation Specific parameter.
        boolean CanListenOnlyMode: origin=Flagchip, set at pre-compile in variant pre-compile / post-build in variant post-build, default-value=false  # Enables the Listen Only Mode (CTRL[LOM] bit). In this mode, transmission is disabled, all error counters are frozen and the module operates in a CAN Error Passive mode. Note Implementation specific Parameter. Not AutoSar Required.
        boolean CanLoopBackMode: origin=Flagchip, set at pre-compile in variant pre-compile / post-build in variant post-build, default-value=false  # CTRL[LPB]: Enables CAN to operate in Loop Back Mode. The bit stream output of the transmitter is fed back internally to the receiver input. The Rx CAN input pin is ignored and the Tx CAN output goes to the recessive state (logic "1"). Note Implementation specific Parameter. Not AutoSar Required.
        boolean CanSoftwareBusOffRecovery: origin=Flagchip, set at pre-compile in variant pre-compile / post-build in variant post-build, default-value=false  # Enables Software Bus Off recovery when automatic recovering from BusOff state is disabled for CAN controller. Note Implementation specific Parameter. This parameter is enabled when CanAutoBusOffRecovery is set to false.
        boolean CanAutoBusOffRecovery: origin=Flagchip, set at pre-compile in variant pre-compile / post-build in variant post-build, default-value=false  # Enable/Disable automatic BusOff recovery (CTRL[BOFF_REC] bit). 0(Checked) = Automatic recovering from Bus Off state occurs according to the CAN Specification 2.0B. 1(Unchecked) = Automatic recovering from Bus Off is disabled and the module remains in Bus Off state until the bit is negated(zero) by the user. Note Implementation specific Parameter. Not AutoSar Required.
        boolean CanTrippleSamplingEnable: origin=Flagchip, set at pre-compile in variant pre-compile / post-build in variant post-build, default-value=false  # CTRL[SMP]: This bit defines the sampling mode of CAN bits at the Rx input. 1 - Enables acquisition of 3 samples and majority voting for the value of received bit. 0 - Just one sample is used to determine the bit value. Note Implementation specific Parameter. Not AutoSar Required.
        boolean CanWakeUpSourceFilter: origin=Flagchip, set at pre-compile in variant pre-compile / post-build in variant post-build, default-value=false  # Defines whether the integrated low-pass filter is applied to protect the Rx CAN input from spurious wake up. 1 = FlexCAN uses the filtered Rx input to detect recessive to dominant edges on the CAN bus. 0 = FlexCAN uses the unfiltered Rx input to detect recessive to dominant edges on the CAN bus. This option will provide the setting for init the controller with MCR[WAK_SRC] bit set. Note Implementation specific Parameter. Not AutoSar Required.
        boolean CanLowestBuffTransmitFirst: origin=Flagchip, set at pre-compile in variant pre-compile / post-build in variant post-build, default-value=true  # CTRL[LBUF]. This bit defines the ordering mechanism for Message Buffer transmission. When asserted, the MCR[LPRIO_EN] bit doesn't affect the priority arbitration. Note Implementation specific Parameter. Not AutoSar Required.
        boolean CanLocalPriorityEn: origin=Flagchip, set at pre-compile in variant pre-compile / post-build in variant post-build, default-value=false  # MCR[LPRIO_EN]. This bit controls whether the local priority feature is enabled or not. Note Implementation specific Parameter. Not AutoSar Required.
        boolean CanClockFromBus: origin=Flagchip, set at pre-compile, default-value=false  # Switches the source clock for the module to the system bus (rather than crystal). 1 = The CAN engine clock source is the interface clock.(from MCU) 0 = The CAN engine clock source is the oscillator clock. Note Implementation specific Parameter. Not AutoSar Required.
        boolean CanErrorControllerNotifEn: origin=Flagchip, set at pre-compile in variant pre-compile / post-build in variant post-build, default-value=true  # Enables/Disables the Error Controller Notification. If Disabled, no error INTERRUPT or notification shall take place. Note Implementation Specific parameter. Not AutoSar Required.
        function name CanErrorControllerNotification: origin=Flagchip, set at pre-compile in variant pre-compile / post-build in variant post-build, default-value=NULL_PTR  # Set here the name of the Error INTERRUPT controller notification function. Note Implementation Specific parameter
        function name CanErrorFDControllerNotification: origin=Flagchip, set at pre-compile in variant pre-compile / post-build in variant post-build, default-value=NULL_PTR  # Set here the name of the Error INTERRUPT controller notification function for errors detected in the Data Phase of CAN FD frames with the BRS bit set only. Note Implementation Specific parameter
        reference CanControllerDefaultBaudrate: post-build-variant-value=true, set at pre-compile in variant pre-compile / post-build in variant post-build, destination=CanControllerBaudrateConfig  # ECUC_Can_00435: Reference to baudrate configuration container configured for the Can Controller.
        reference CanControllerEcucPartitionRef [0..1]: scope=ECU, multiplicity set at pre-compile, post-build-variant-multiplicity=true, post-build-variant-value=true, set at pre-compile, destination=EcucPartition  # Maps the Can controller to zero or one ECUC partition. The ECUC partition referenced is a subset of the ECUC partitions where the Can driver is mapped to.
        reference CanCpuClockRef: set at pre-compile, destination=McuClockReferencePoint  # ECUC_Can_00313: Reference to the CPU Module clock configuration
        reference CanCpuFunctionClockRef: origin=Flagchip, set at pre-compile, destination=McuClockReferencePoint  # ECUC_Can_00313: Reference to the CPU function clock configuration, which is set in the MCU driver configuration
        reference CanWakeupSourceRef [0..1]: multiplicity set at pre-compile, set at pre-compile, requires-symbolic-name-value=true, destination=EcuMWakeupSource  # ECUC_Can_00359: This parameter contains a reference to the Wakeup Source for this controller as defined in the ECU State Manager. Type: reference to EcuM_WakeupSourceType EcuM plugin need to be added and then give the reference to it.
        container CanControllerBaudrateConfig [1..*]: multiplicity set at pre-compile  # ECUC_Can_00387: This container contains bit timing related configuration parameters of the CAN controller(s).
          integer CanModuleClock: -9223372036854775808..9223372036854775807, origin=Flagchip, post-build-variant-value=true, set at pre-compile in variant pre-compile / post-build in variant post-build  # Can baudrate source clock, if CLK_SRC set 1, is from Module clock, or is from function clock ( Divided from OSC by PCC )
          float CanControllerBaudRate: 0..2000, post-build-variant-value=true, set at pre-compile in variant pre-compile / post-build in variant post-build, default-value=500  # ECUC_Can_00005: Specifies the buadrate of the controller in kbps. CAN maximum speed is 1Mbps.
          integer CanControllerBaudRateConfigID: 0..65535, scope=ECU, post-build-variant-value=true, set at pre-compile in variant pre-compile / post-build in variant post-build  # ECUC_Can_00471: Uniquely identifies a specific baud rate configuration. This ID is used by SetBaudrate API
          integer CanControllerPrescaller: -9223372036854775808..9223372036854775807, origin=Flagchip, post-build-variant-value=true, set at pre-compile in variant pre-compile / post-build in variant post-build, default-value=3  # Specifies the prescaller for the controller . The calculation of the resulting CanControllerTimeQuanta value depending on module clocking and prescaller shall be done offline. Prescaler = FreqCanClk / FreqTq; FreqTq = 1 / CanControllerTimeQuanta .
          integer CanNeedTqs: -9223372036854775808..9223372036854775807, origin=Flagchip, post-build-variant-value=true, set at pre-compile in variant pre-compile / post-build in variant post-build  # Total Can Baud Tq num, and may set it in range 8-383 generally
          integer CanControllerSyncSeg: 1..1, origin=Flagchip, set at pre-compile in variant pre-compile / post-build in variant post-build, default-value=1  # The Synchronization Segment or SYNC_SEG time interval is used to synchronize all the nodes across the network. The SYNC_SEG time interval has a fixed period of one Time Quantum (TQ).
          integer CanControllerPropSeg: 0..255, post-build-variant-value=true, set at pre-compile in variant pre-compile / post-build in variant post-build, default-value=7  # ECUC_Can_00073: It is used to compensate the physical delay within the CAN network (CTRL[PROPSEG] - 0..7).
          integer CanControllerSeg1: 0..255, post-build-variant-value=true, set at pre-compile in variant pre-compile / post-build in variant post-build, default-value=4  # ECUC_Can_00074: Specifies the Phase Segment 1 in time quantas (ENCBT[NTSEG1] = 0..255). CanControllerSeg1 = (PSEG1 + 1) * Tq . The CanControllerSeg1 valid values are 1-256 Tq.
          integer CanControllerSeg2: 0..255, post-build-variant-value=true, set at pre-compile in variant pre-compile / post-build in variant post-build, default-value=4  # ECUC_Can_00075: Specifies the Phase Segment 1 in time quantas (ENCBT[NTSEG2] = 1..127). CanControllerSeg2 = (PSEG2 + 1) * Tq . The CanControllerSeg2 valid values are 2-128 Tq.
          integer CanControllerSyncJumpWidth: 0..255, post-build-variant-value=true, set at pre-compile in variant pre-compile / post-build in variant post-build, default-value=4  # ECUC_Can_00383: Specifies the synchronization jump width for the controller in time quantas.
          float CanSamplePoint: 0.0..100.0, origin=Flagchip, post-build-variant-value=true, set at pre-compile in variant pre-compile / post-build in variant post-build  # CAN sample point: (1+TSEG1) / (1+TSEG1+TSEG2)
          integer CanTxArbitrationStartDelay: 0..63, origin=Flagchip, post-build-variant-value=true, set at pre-compile in variant pre-compile / post-build in variant post-build, default-value=20  # This 5-bit field indicates how many CAN bits the Tx arbitration process start point can be delayed from the first bit of CRC field on CAN bus. See Reference Manual to have a calculation method for the optimal TASD value.
          container CanControllerFdBaudrateConfig [0..1]: multiplicity set at pre-compile  # ECUC_Can_00473: This optional container contains bit timing related configuration parameters of the CAN controller(s) for payload and CRC of a CAN FD frame. If this container exists the controller supports CAN FD frames.
            float CanControllerFdBaudRate: 0.., post-build-variant-value=true, set at pre-compile in variant pre-compile / post-build in variant post-build, default-value=1000  # ECUC_Can_00481.Specifies the data segment baud rate of the controller in kbps.
            integer CanControllerFdPrescaller: 1..1024, origin=Flagchip, post-build-variant-value=true, set at pre-compile in variant pre-compile / post-build in variant post-build, default-value=3  # Specifies the fd prescaller for the controller . The calculation of the resulting CanControllerFdTimeQuanta value depending on module clocking and prescaller shall be done offline. Prescaler = FreqCanClk / FreqTq; FreqTq = 1 / CanControllerTimeQuanta .
            integer CanFdNeedTqs: -9223372036854775808..9223372036854775807, origin=Flagchip, post-build-variant-value=true, set at pre-compile in variant pre-compile / post-build in variant post-build  # Total Can Data Baud Tq num, and may set it in range 8-114 generally.
            integer CanControllerFdSyncSeg: 1..1, origin=Flagchip, set at pre-compile in variant pre-compile / post-build in variant post-build, default-value=1  # The Synchronization Segment or SYNC_SEG time interval is used to synchronize all the nodes across the network. The SYNC_SEG time interval has a fixed period of one Time Quantum (TQ).
            integer CanControllerPropSeg: 0..255, post-build-variant-value=true, set at pre-compile in variant pre-compile / post-build in variant post-build, default-value=3  # ECUC_Can_00476: Specifies propagation delay in time quantas.
            integer CanControllerSeg1: 0..255, post-build-variant-value=true, set at pre-compile in variant pre-compile / post-build in variant post-build, default-value=2  # ECUC_Can_00477: Specifies phase segment 1 in time quantas.
            integer CanControllerSeg2: 0..255, post-build-variant-value=true, set at pre-compile in variant pre-compile / post-build in variant post-build, default-value=2  # ECUC_Can_00478: Specifies phase segment 2 in time quantas.
            integer CanControllerSyncJumpWidth: 0..255, post-build-variant-value=true, set at pre-compile in variant pre-compile / post-build in variant post-build, default-value=3  # ECUC_Can_00479: Specifies the synchronization jump width for the controller in time quantas.
            float CanFdSamplePoint: -INF..INF, origin=Flagchip, post-build-variant-value=true, set at pre-compile in variant pre-compile / post-build in variant post-build  # If BRS is enable, CAN high speed sample point: (1+TSEG1) / (1+TSEG1+TSEG2)
            integer CanControllerSspOffset [0..1]: 0..31, multiplicity set at pre-compile in variant pre-compile / post-build in variant post-build, post-build-variant-multiplicity=true, post-build-variant-value=true, set at pre-compile in variant pre-compile / post-build in variant post-build  # Specifies the Transmitter Delay Compensation Offset in minimum time quanta (see [17]). Transmitter Delay Compensation Offset is used to adjust the position of the Secondary Sample Point (SSP), relative to the beginning of the received bit. If this parameter is configured, the Transmitter Delay Compensation is done by measurement of the CAN controller. If not specified, Transmitter Delay Compensation is disabled. Note: MTQ == Minimum Time Quanta in seconds == 1/(frequency of the CAN controller clock) Secondary Sample Point Offset in seconds = CanControllerSspOffset * MTQ Example: CAN controller clock frequency = 20MHz => MTQ = 1/20 * 10^(-6) s = 0,05 us = 50ns Baud rate = 1MBit/s => BitTime = 1/(1 * 10^6) s/Bit = 1 * 10^(-6) = 1us/Bit SSP = 75% => SSP in seconds = 0,75 * 1us = 750 ns CanControllerSspOffset in MTQ = 750ns / 50ns = 15 Note: Please consider the minimum range (0..63) stated in [17] and the range definition (0..127) used as per [19].
            boolean CanControllerTxBitRateSwitch: post-build-variant-value=true, set at post-build in variant post-build / pre-compile in variant pre-compile, default-value=true  # Specifies if the bit rate switching shall be used for transmissions.
            boolean CanControllerFdIsoCANFD: origin=Flagchip, set at post-build in variant post-build / pre-compile in variant pre-compile, default-value=true  # Add support for selecting ISO or non ISO for CAN FD feature.
            boolean CanControllerFdPrExcEn: origin=Flagchip, post-build-variant-value=true, set at post-build in variant post-build / pre-compile in variant pre-compile, default-value=false  # This bit enables the Protocol Exception feature.
            boolean CanControllerFdEdgeFilterDis: origin=Flagchip, post-build-variant-value=true, set at post-build in variant post-build / pre-compile in variant pre-compile, default-value=false  # This bit disables the Edge Filter.
        container CanTTController [0..1]: multiplicity set at pre-compile  # This container is only included and valid if TTCAN SWS is used and TTCAN is enabled.
          integer CanTTControllerApplWatchdogLimit: 0..255, scope=ECU, post-build-variant-value=true, set at post-build in variant post-build / pre-compile in variant pre-compile, default-value=0  # Defines the maximum time period (unit is 256 times NTU) after which the application has to serve the watchdog.
          integer CanTTControllerCycleCountMax: 0..63, scope=ECU, post-build-variant-value=true, set at post-build in variant post-build / pre-compile in variant pre-compile, default-value=0  # Defines the value for cycle_count_max.
          integer CanTTControllerExpectedTxTrigger: 0..255, post-build-variant-value=true, set at post-build in variant post-build / pre-compile in variant pre-compile, default-value=0  # Number of expected_tx_trigger.
          boolean CanTTControllerExternalClockSynchronisation: scope=ECU, post-build-variant-value=true, set at post-build in variant post-build / pre-compile in variant pre-compile, default-value=false  # Enables/disables the external clock synchronization.
          boolean CanTTControllerGlobalTimeFiltering: post-build-variant-value=true, set at post-build in variant post-build / pre-compile in variant pre-compile, default-value=false  # Enables/disables the global time filtering.
          integer CanTTControllerInitialRefOffset: 0..127, scope=ECU, post-build-variant-value=true, set at post-build in variant post-build / pre-compile in variant pre-compile, default-value=0  # Defines the initial value for ref trigger offset.
          integer CanTTControllerInterruptEnable: 0..1023, post-build-variant-value=true, set at post-build in variant post-build / pre-compile in variant pre-compile, default-value=0  # Enables/disables the respective interrupts.
          boolean CanTTControllerLevel2: post-build-variant-value=true, set at post-build in variant post-build / pre-compile in variant pre-compile, default-value=false  # Defines whether Level 2 or Level 1 is used.
          float CanTTControllerNTUConfig: 0.0..100.0, scope=ECU, post-build-variant-value=true, set at post-build in variant post-build / pre-compile in variant pre-compile, default-value=0.0  # Defines the config value for NTU (network time unit).
          enumeration CanTTControllerOperationMode: {CAN_TT_EVENT_SYNC_TIME_TRIGGERED, CAN_TT_EVENT_TRIGGERED, CAN_TT_TIME_TRIGGERED}, scope=ECU, post-build-variant-value=true, set at post-build in variant post-build / pre-compile in variant pre-compile, default-value=CAN_TT_EVENT_SYNC_TIME_TRIGGERED  # Defines the operation mode.
          float CanTTControllerSyncDeviation: 0.0..100.0, post-build-variant-value=true, set at post-build in variant post-build / pre-compile in variant pre-compile, default-value=0.0  # Defines the maximum synchronization deviation:
          boolean CanTTControllerTURRestore: post-build-variant-value=true, set at post-build in variant post-build / pre-compile in variant pre-compile, default-value=false  # Enables/disables the TUR restore.
          boolean CanTTControllerTimeMaster: scope=ECU, post-build-variant-value=true, set at post-build in variant post-build / pre-compile in variant pre-compile, default-value=false  # Defines whether the controller acts as a potential time master.
          integer CanTTControllerTimeMasterPriority: 0..7, scope=ECU, post-build-variant-value=true, set at post-build in variant post-build / pre-compile in variant pre-compile, default-value=0  # Defines the time master priority.
          integer CanTTControllerTxEnableWindowLength: 1..16, scope=ECU, post-build-variant-value=true, set at post-build in variant post-build / pre-compile in variant pre-compile, default-value=1  # Length of the tx enable window given in CAN bit times.
          integer CanTTControllerWatchTriggerGapTimeMark: 0..65535, post-build-variant-value=true, set at post-build in variant post-build / pre-compile in variant pre-compile, default-value=0  # watch trigger time mark after a gap
          integer CanTTControllerWatchTriggerTimeMark: 0..65535, post-build-variant-value=true, set at post-build in variant post-build / pre-compile in variant pre-compile, default-value=0  # watch trigger time mark
          enumeration CanTTIRQProcessing: {INTERRUPT, POLLING}, scope=ECU, post-build-variant-value=true, set at post-build in variant post-build / pre-compile in variant pre-compile, default-value=POLLING  # Enables / disables API Can_MainFunction_BusOff() for handling busoff events in POLLING mode.
          reference CanTTControllerEcucPartitionRef [0..1]: scope=ECU, multiplicity set at pre-compile, post-build-variant-value=true, set at pre-compile, destination=EcucPartition  # ECUC_Can_00493. Maps the Time triggered CAN controller to zero or one ECUC partitions. The ECUC partition referenced is a subset of the ECUC partitions where the CAN driver is mapped to.
        container CanFDSupport  # This container contains the configuration (parameters) of the CAN Legacy RX FIFO. Note This container is ENABLED only when CanControllerLegacyRxFifoEnable is TRUE and CanControllerLegacyRxFifoEnable is FALSE.
          boolean CanControllerFdEnable: origin=Flagchip, set at pre-compile, default-value=false  # Enable CAN FD.
          enumeration CanControllerFdType: {ISO_CAN_FD, BOSCH_CAN_FD}, origin=Flagchip, set at pre-compile in variant pre-compile / post-build in variant post-build, default-value=ISO_CAN_FD  # ISO_CAN_FD BOSCH_CAN_FD
          enumeration CanLegacyMessageBufferDataBlockSize: {CAN_8_BYTES_PAYLOAD, CAN_16_BYTES_PAYLOAD, CAN_32_BYTES_PAYLOAD, CAN_64_BYTES_PAYLOAD}, origin=Flagchip, set at pre-compile, default-value=CAN_8_BYTES_PAYLOAD  # Selects maximum payload of MB's for region 0
          integer CanLegacyMaxMessageBuffersCnt: 0..96, origin=Flagchip, set at pre-compile  # This parameter describes the maximum Message Buffer Number of CAN Legacy MB for region 0
          enumeration CanLegacyMessageBufferDataBlockSize_1: {CAN_8_BYTES_PAYLOAD, CAN_16_BYTES_PAYLOAD, CAN_32_BYTES_PAYLOAD, CAN_64_BYTES_PAYLOAD}, origin=Flagchip, set at pre-compile, default-value=CAN_8_BYTES_PAYLOAD  # Selects maximum payload of MB's for region 1
          integer CanLegacyMaxMessageBuffersCnt_1: 0..96, origin=Flagchip, set at pre-compile  # This parameter describes the maximum Message Buffer Number of CAN Legacy MB for region 1
          enumeration CanLegacyMessageBufferDataBlockSize_2: {CAN_8_BYTES_PAYLOAD, CAN_16_BYTES_PAYLOAD, CAN_32_BYTES_PAYLOAD, CAN_64_BYTES_PAYLOAD}, origin=Flagchip, set at pre-compile, default-value=CAN_8_BYTES_PAYLOAD  # Selects maximum payload of MB's for region 2
          integer CanLegacyMaxMessageBuffersCnt_2: 0..96, origin=Flagchip, set at pre-compile  # This parameter describes the maximum Message Buffer Number of CAN Legacy MB for region 2
        container CanLegacyRxFifo  # This container contains the configuration (parameters) of the CAN Legacy RX FIFO. Note This container is ENABLED only when CanControllerLegacyRxFifoEnable is TRUE and CanControllerLegacyRxFifoEnable is FALSE.
          boolean CanControllerLegacyRxFifoEnable: origin=Flagchip, set at pre-compile, default-value=false  # Defines if RX FIFO feature of CAN controller is used in the configuration. If FIFO feature of CAN controller is enabled and can fd is disabled, Legacy MB First 8 Message Buffers will be used by FIFO engine. If FIFO feature of CAN controller is enabled and can fd is enabled, Enhanced FIFO will be used by FIFO engine.
          boolean CanHardwareObjectUsesPolling [0..1]: multiplicity set at pre-compile in variant pre-compile / post-build in variant post-build, origin=Flagchip, set at pre-compile in variant pre-compile / post-build in variant post-build, default-value=false  # Enables polling of this fifo hardware object. This node shall exist if CanRxProcessing is set to MIXED.
          enumeration CanControllerLegacyIDAcceptanceMode: {A, B, C, D}, origin=Flagchip, set at pre-compile in variant pre-compile / post-build in variant post-build, default-value=A  # This 2-bit field identifies the format of the elements of the Legacy Rx FIFO filter table. Note Implementation Specific parameter. Format Explanation A : One full ID (standard or extended) per filter element. B : Two full standard IDs or two partial 14-bit extended IDs per filter element. C : Four partial 8-bit IDs (standard or extended) per filter element. D : All frames rejected. Note: The TableID and Filter Mask values don't care for this option.
          enumeration CanLegacyRxFifoFiltersNumber: {FILTERS_NUMBER_8, FILTERS_NUMBER_16, FILTERS_NUMBER_24, FILTERS_NUMBER_32, FILTERS_NUMBER_40, FILTERS_NUMBER_48, FILTERS_NUMBER_56, FILTERS_NUMBER_64, FILTERS_NUMBER_72, FILTERS_NUMBER_80, FILTERS_NUMBER_88, FILTERS_NUMBER_96, FILTERS_NUMBER_104, FILTERS_NUMBER_112, FILTERS_NUMBER_120, FILTERS_NUMBER_128}, origin=Flagchip, set at pre-compile in variant pre-compile / post-build in variant post-build, default-value=FILTERS_NUMBER_8  # This field defines the number of Rx FIFO filters. Note Implementation Specific parameter. Values Explanation Number of Rx FIFO filters Rx FIFO ID Filter Table Elements Affected by Rx Individual Masks Rx FIFO ID Filter Table Elements Affected by Rx FIFO Global Mask FILTERS_NUMBER_8 Elements 0-7 none FILTERS_NUMBER_16 Elements 0-9 Elements 10-15 FILTERS_NUMBER_24 Elements 0-11 Elements 12-23 FILTERS_NUMBER_32 Elements 0-13 Elements 14-31 FILTERS_NUMBER_40 Elements 0-15 Elements 16-39 FILTERS_NUMBER_48 Elements 0-17 Elements 18-47 FILTERS_NUMBER_56 Elements 0-19 Elements 20-55 FILTERS_NUMBER_64 Elements 0-21 Elements 22-63 FILTERS_NUMBER_72 Elements 0-23 Elements 24-71 FILTERS_NUMBER_80 Elements 0-25 Elements 26-79 FILTERS_NUMBER_88 Elements 0-27 Elements 28-87 FILTERS_NUMBER_96 Elements 0-29 Elements 30-95 FILTERS_NUMBER_104 Elements 0-31 Elements 32-103 FILTERS_NUMBER_112 Elements 0-31 Elements 32-111 FILTERS_NUMBER_120 Elements 0-31 Elements 32-119 FILTERS_NUMBER_128 Elements 0-31 Elements 32-127
          integer CanLegacyRxFifoGlobalMaskValue: 0..4294967295, origin=Flagchip, set at pre-compile in variant pre-compile / post-build in variant post-build, default-value=2047  # Specifies Rx Fifo Global Filter Mask value to be used as acceptance criteria for the Rx Fifo filter IDs which are not covered by individual masks. Note Implementation Specific parameter. Value for this parameter should be entered based on the CanControllerLegacyIDAcceptanceMode selected as explained below. A :Filtermask value for One full standard or Extended ID based on the CanTableIDType selected. bit31=RTR,bit30=IDE,standard bit19-29=std id mask, extended bit1-29=ext id mask B : Filtermask value for CanIDValue0(bit field: 3-13 for standard ID type and 0-13 for extended ID type, and bit14=IDE,bit15=RTR) and CanIDValue1 (bit field: 19-29 for standard ID type and 16-29 for extended ID type, and bit30=IDE,bit31=RTR). C : Filtermask value for CanIDValue0(bit field: 0-7), CanIDValue1(bit field: 8-15), CanIDValue2(bit field: 16-23) and CanIDValue3(bit field: 24-31). It shall be distinguished between: - Standard identifier mask - Extended identifier mask 0 - the corresponding bit in the filter is "don't care". 1 - the corresponding bit in the filter is used during the matching process.
          boolean CanLegacyFifoSplitHrh: origin=Flagchip, set at pre-compile in variant pre-compile / post-build in variant post-build, default-value=false  # if this is checked, every legacy rx fifo filter element has one hardware object id
          function name CanRxFifoWarningNotification: origin=Flagchip, set at pre-compile in variant pre-compile / post-build in variant post-build, default-value=NULL_PTR  # Set here the name of the handler for RxFifo Warning notification function. Note Implementation Specific parameter
          function name CanRxFifoOverflowNotification: origin=Flagchip, set at pre-compile in variant pre-compile / post-build in variant post-build, default-value=NULL_PTR  # Set here the name of the handler for RxFifo Overflow notification function. Note Implementation Specific parameter
          reference CanMainFunctionRWPeriodRef [0..1]: multiplicity set at pre-compile in variant pre-compile / post-build in variant post-build, origin=Flagchip, post-build-variant-value=true, set at pre-compile in variant pre-compile / post-build in variant post-build, destination=CanMainFunctionRWPeriods  # ECUC_Can_00438 :Reference to CAN Controller to which the HOH is associated to.
          container CanLegacyRxFifoTable [0..*]: multiplicity set at pre-compile  # This container contains a multiple entry ID table information required to configure RX FIFO. The number of entries shall be equal to the number of RxFifo filters configured using CanLegacyRxFifoFiltersNumber parameter. Note This container is ENABLED only when CanControllerLegacyRxFifoEnable is TRUE. Explanation regarding the individual mask usage Number of Rx FIFO filters Rx FIFO ID Filter Table Elements Affected by Rx Individual Masks Rx FIFO ID Filter Table Elements Affected by Rx FIFO Global Mask FILTERS_NUMBER_8 Elements 0-7 none FILTERS_NUMBER_16 Elements 0-9 Elements 10-15 FILTERS_NUMBER_24 Elements 0-11 Elements 12-23 FILTERS_NUMBER_32 Elements 0-13 Elements 14-31 FILTERS_NUMBER_40 Elements 0-15 Elements 16-39 FILTERS_NUMBER_48 Elements 0-17 Elements 18-47 FILTERS_NUMBER_56 Elements 0-19 Elements 20-55 FILTERS_NUMBER_64 Elements 0-21 Elements 22-63 FILTERS_NUMBER_72 Elements 0-23 Elements 24-71 FILTERS_NUMBER_80 Elements 0-25 Elements 26-79 FILTERS_NUMBER_88 Elements 0-27 Elements 28-87 FILTERS_NUMBER_96 Elements 0-29 Elements 30-95 FILTERS_NUMBER_104 Elements 0-31 Elements 32-103 FILTERS_NUMBER_112 Elements 0-31 Elements 32-111 FILTERS_NUMBER_120 Elements 0-31 Elements 32-119 FILTERS_NUMBER_128 Elements 0-31 Elements 32-127
            integer CanIDValue0: 0..536870911, origin=Flagchip, set at pre-compile in variant pre-compile / post-build in variant post-build, default-value=255  # Specifies an ID to be used as acceptance criteria for the ID Table 0. Note Implementation Specific parameter. Value for this parameter should be enterd based on the CanControllerLegacyIDAcceptanceMode selected as explained below. A : One full ID (standard or extended) per filter element. B : One full standard ID if the CanTableIDType is Standard or one 14 most significant bit value of Extended ID if the CanTableIDType is Extended. C : One 8 most significant bit value of Standard or Extended ID.
            integer CanIDValue1: 0..536870911, origin=Flagchip, set at pre-compile in variant pre-compile / post-build in variant post-build, default-value=255  # Specifies an ID to be used as acceptance criteria for the ID Table. Note Implementation Specific parameter. Value for this parameter should be enterd based on the CanControllerLegacyIDAcceptanceMode selected as explained below. B : One full standard ID if the CanTableIDType is Standard or one 14 most significant bit value of Extended ID if the CanTableIDType is Extended. C : One 8 most significant bit value of Standard or Extended ID.
            integer CanIDValue2: 0..536870911, origin=Flagchip, set at pre-compile in variant pre-compile / post-build in variant post-build, default-value=255  # Specifies an ID to be used as acceptance criteria for the ID Table. Note Implementation Specific parameter. Value for this parameter should be enterd based on the CanControllerLegacyIDAcceptanceMode selected as explained below. C : One 8 most significant bit value of Standard or Extended ID.
            integer CanIDValue3: 0..536870911, origin=Flagchip, set at pre-compile in variant pre-compile / post-build in variant post-build, default-value=255  # Specifies an ID to be used as acceptance criteria for the ID Table. Note Implementation Specific parameter. Value for this parameter should be enterd based on the CanControllerLegacyIDAcceptanceMode selected as explained below. C : One 8 most significant bit value of Standard or Extended ID.
            enumeration CanTableIDType: {Standard, Extended}, origin=Flagchip, set at pre-compile in variant pre-compile / post-build in variant post-build, default-value=Standard  # Specifies whether extended or standard frames are accepted into the FIFO. Note Implementation Specific parameter.
            integer CanMBFilterMaskValue: 0..4294967295, origin=Flagchip, set at pre-compile in variant pre-compile / post-build in variant post-build, default-value=2047  # Specifies Filetr Mask value to be used as acceptance criteria for the ID Table. Note Implementation Specific parameter. Value for this parameter should be entered based on the CanControllerLegacyIDAcceptanceMode selected as explained below. A : Filtermask value for One full standard or Extended ID based on the CanTableIDType selected. B : Filtermask value for CanIDValue0(bit field: 0-10 for standard ID type and 0-13 for extended ID type) and CanIDValue1 (bit field: 11-21 for standard ID type and 14-27 for extended ID type). C : Filtermask value for CanIDValue0(bit field: 0-8), CanIDValue1(bit field: 9-16), CanIDValue2(bit field: 17-24) and CanIDValue3(bit field: 25-32).
        container CanEnhancedRxFifo  # This container contains the configuration (parameters) of the CAN Enhanced RX FIFO. Note This container is ENABLED only when CAN FD is enabled.
          boolean CanControllerEnhancedRxFifoEnable: origin=Flagchip, set at pre-compile, default-value=false  # Defines if Enhanced FIFO feature of CAN controller is used in the configuration. Only used in CAN FD Mode.
          boolean CanHardwareObjectUsesPolling [0..1]: multiplicity set at pre-compile in variant pre-compile / post-build in variant post-build, origin=Flagchip, set at pre-compile in variant pre-compile / post-build in variant post-build, default-value=false  # Enables polling of this fifo hardware object. This node shall exist if CanRxProcessing is set to MIXED.
          integer CanStandardIDFilterNumber: 0..65535, origin=Flagchip, set at pre-compile in variant pre-compile / post-build in variant post-build, default-value=2  # CAN Enhanced Rx FIFO standard ID filter Number NOTICE: standard ID filter Number + 2 * Extended ID filter Number <= 32 (the vales is 72 in FC73008MDQ)
          integer CanExtendedIdFilterNumber: 0..65535, origin=Flagchip, set at pre-compile in variant pre-compile / post-build in variant post-build, default-value=0  # CAN Enhanced Rx FIFO Extended ID filter Number NOTICE: standard ID filter Number + 2 * Extended ID filter Number <= 32
          integer CanFifoWatermark: -9223372036854775808..9223372036854775807, origin=Flagchip, set at pre-compile in variant pre-compile / post-build in variant post-build, default-value=1  # This field defines the minimum number of CAN messages stored in the Enhanced RX FIFO. When that number is reached, then Interrupt or DMA request would be generated if the interrupt or DMA is enabled.
          boolean CanEnhancedRxFifoSplitHrh: origin=Flagchip, set at pre-compile in variant pre-compile / post-build in variant post-build, default-value=false  # if this is checked, every enhanced rx fifo filter element has one hardware object id
          function name CanRxFifoWarningNotification: origin=Flagchip, set at pre-compile in variant pre-compile / post-build in variant post-build, default-value=NULL_PTR  # Set here the name of the handler for RxFifo Warning notification function. Note Implementation Specific parameter
          function name CanRxFifoOverflowNotification: origin=Flagchip, set at pre-compile in variant pre-compile / post-build in variant post-build, default-value=NULL_PTR  # Set here the name of the handler for RxFifo Overflow notification function. Note Implementation Specific parameter
          reference CanMainFunctionRWPeriodRef [0..1]: multiplicity set at pre-compile in variant pre-compile / post-build in variant post-build, origin=Flagchip, post-build-variant-value=true, set at pre-compile in variant pre-compile / post-build in variant post-build, destination=CanMainFunctionRWPeriods  # ECUC_Can_00438 :Reference to CAN Controller to which the HOH is associated to.
          container CanEnhancedRxFifoTable [0..*]: multiplicity set at pre-compile  # CAN Enhanced Rx FIFO ID Filter Table
            integer FilterId: 0..32, scope=ECU, origin=Flagchip, set at pre-compile in variant pre-compile / post-build in variant post-build, symbolic-name-value=true  # Holds the handle ID of filter.
            enumeration CANEnhancedFifoFilterIdType: {Standard, Extended}, origin=Flagchip, set at pre-compile, default-value=Standard  # Select the CANID type. Standard or Extended.
            enumeration StandardString: {Standard}, origin=Flagchip, set at pre-compile, default-value=Standard  # Used for Standard compare.
            enumeration ExtendedString: {Extended}, origin=Flagchip, set at pre-compile, default-value=Extended  # Used for Extended compare.
            enumeration CANEnhancedFifoFilterType: {Mask, Range, TwoMatch}, origin=Flagchip, set at pre-compile, default-value=Mask  # Select the Fifo Filter Type. Mask or Range or TwoMatch.
            integer CanRtrFilter1: origin=Flagchip, set at pre-compile in variant pre-compile / post-build in variant post-build, default-value=0  # Can RTR filter 1.
            integer CanRtrFilter2: origin=Flagchip, set at pre-compile in variant pre-compile / post-build in variant post-build, default-value=0  # Can RTR filter 2.
            integer CanRtrFilterMask1: origin=Flagchip, set at pre-compile in variant pre-compile / post-build in variant post-build, default-value=0  # Can RTR Mask.
            integer CanIDFilter1: origin=Flagchip, set at pre-compile in variant pre-compile / post-build in variant post-build, default-value=0  # Can ID filter 1.
            integer CanIDFilter2: origin=Flagchip, set at pre-compile in variant pre-compile / post-build in variant post-build, default-value=0  # Can ID filter 2.
            integer CanIDMask1: origin=Flagchip, set at pre-compile in variant pre-compile / post-build in variant post-build, default-value=0  # Can ID mask.
      container CanHardwareObject [1..*]: multiplicity set at pre-compile  # ECUC_Can_00324: This container contains the configuration (parameters) of CAN Hardware Objects. This configuration element is used as information for the CAN Interface only. The relevant CAN driver configuration is done with the filter mask and identifier.
        integer CanFdPaddingValue [0..1]: 0..255, scope=ECU, multiplicity set at pre-compile in variant pre-compile / post-build in variant post-build, post-build-variant-multiplicity=true, post-build-variant-value=true, set at pre-compile in variant pre-compile / post-build in variant post-build, default-value=0  # ECUC_Can_00485: Specifies the value which is used to pad unspecified data in CAN FD frames > 8 bytes for transmission. This is necessary due to the discrete possible values of the DLC if > 8 bytes. If the length of a PDU which was requested to be sent does not match the allowed DLC values, the remaining bytes up to the next possible value shall be padded with this value. MBCS[PRIO]: This value it is the padding value when FD it is used.
        enumeration CanHandleType: {BASIC, FULL}, scope=ECU, post-build-variant-value=true, set at pre-compile in variant pre-compile / post-build in variant post-build, default-value=BASIC  # ECUC_Can_00323: Specifies the type (Full-CAN or Basic-CAN) of a hardware object. Note All controllers which the Fifo is enabled shall define at least 1 RECEIVE hardware object. First RECEIVE hardware object defined for a controller which have the Fifo enabled is configured by CONVENTION to receive data from Fifo.
        boolean CanFifoHRH: origin=Flagchip, set at pre-compile in variant pre-compile / post-build in variant post-build, default-value=false  # select if the hardware object is for Fifo feature
        boolean CanHardwareObjectUsesPolling [0..1]: multiplicity set at pre-compile in variant pre-compile / post-build in variant post-build, set at pre-compile in variant pre-compile / post-build in variant post-build, default-value=false  # Enables polling of this hardware object. This node shall exist if CanRxProcessing/CanTxProcessing is set to MIXED.
        integer CanHwObjectCount: 1..65535, post-build-variant-value=true, set at pre-compile in variant pre-compile / post-build in variant post-build, default-value=1  # ECUC_Can_00467: Number of hardware objects used to implement one HOH. In case of a HRH this parameter defines the number of elements in the hardware FIFO or the number of shadow buffers, in case of a HTH it defines the number of hardware objects used for multiplexed transmission or for a hardware FIFO used by a FullCAN HTH
        enumeration CanIdType: {EXTENDED, MIXED, STANDARD}, post-build-variant-value=true, set at pre-compile in variant pre-compile / post-build in variant post-build, default-value=STANDARD  # ECUC_Can_00065: Specifies whether the IdValue is of type - standard identifier (ID - 11 bits length) - extended identifier (ID - 29 bits length) - mixed mode (standard or extended) Note MBs configred as MIXED standard and RECEIVE type will be treated as EXTENDED.
        integer CanMBPrio: 0..7, origin=Flagchip, post-build-variant-value=true, set at pre-compile in variant pre-compile / post-build in variant post-build, default-value=0  # MBCS[PRIO]: Local priority. This 3-bit field is used when MCR[LPRIO_EN] is set and makes sense only for TX buffers. If CTRL[LBUF] is set this field is not used. These bits are not transmitted. They are appended to the regular ID to define the transmission priority. Note Implementation specific Parameter. Not AutoSar Required.
        integer CanObjectId: 0..65535, scope=ECU, set at pre-compile, symbolic-name-value=true  # ECUC_Can_00326: Holds the handle ID of HRH or HTH. The value of this parameter is unique in a given CAN Driver, and it should start with 0 and continue without any gaps. The HRH and HTH Ids are defined under two different name-spaces. Example: HRH0-0, HRH1-1, HTH0-2, HTH1-3 NOTICE: The rx fifo buffer would use the last ID, 65535 - controllerID, cannot be set again. for example: ccan controller 0 FIFO use 65535 object ID. can controller 1 FIFO use 65534 object ID.
        string CanMbTransmitLimit: scope=ECU, origin=Flagchip, set at pre-compile  # CAN Mailbox transmit limitation for FlexCAN Errata 001 when Enhanced Rx FIFO enabled, click auto calculated
        integer CanMbIdex: 0..96, scope=ECU, origin=Flagchip, set at pre-compile, default-value=8  # CAN Mailbox Index for current controller
        enumeration CanObjectPayloadLength [0..1]: {CAN_OBJECT_PL_12, CAN_OBJECT_PL_16, CAN_OBJECT_PL_20, CAN_OBJECT_PL_24, CAN_OBJECT_PL_32, CAN_OBJECT_PL_48, CAN_OBJECT_PL_64, CAN_OBJECT_PL_8}, multiplicity set at pre-compile in variant pre-compile / post-build in variant post-build, post-build-variant-value=true, set at pre-compile in variant pre-compile / post-build in variant post-build, default-value=CAN_OBJECT_PL_8  # ECUC_Can_00065: Specifies the maximum L-PDU payload length in bytes the hardware object can store. If the parameter is not provided, Can driver configuration generators have to assume the maximum length of the underlying CAN derivate, e.g. 8 bytes for CAN, 64 bytes for CAN-FD.
        enumeration CanObjectType: {RECEIVE, TRANSMIT}, scope=ECU, post-build-variant-value=true, set at pre-compile in variant pre-compile / post-build in variant post-build, default-value=RECEIVE  # ECUC_Can_00327: Specifies if the HardwareObject is used as Transmit or as Receive object. Note MBs configred as MIXED standard and RECEIVE type will be treated as EXTENDED.
        boolean CanTriggerTransmitEnable [0..1]: scope=ECU, multiplicity set at pre-compile, set at pre-compile, default-value=false  # This parameter defines if or if not Can supports the trigger-transmit API for this handle.
        reference CanControllerRef: post-build-variant-value=true, set at pre-compile in variant pre-compile / post-build in variant post-build, destination=CanController  # ECUC_Can_00322: Reference to CAN Controller to which the HOH is associated to.
        reference CanMainFunctionRWPeriodRef [0..1]: multiplicity set at pre-compile in variant pre-compile / post-build in variant post-build, post-build-variant-value=true, set at pre-compile in variant pre-compile / post-build in variant post-build, destination=CanMainFunctionRWPeriods  # ECUC_Can_00438 :Reference to CAN Controller to which the HOH is associated to.
        container CanHwFilter [0..1]: multiplicity set at pre-compile  # ECUC_Can_00468: This container is only valid for HRHs and contains the configuration (parameters) of one hardware filter.
          integer CanHwFilterCode: post-build-variant-value=true, set at pre-compile in variant pre-compile / post-build in variant post-build, default-value=0  # ECUC_Can_00469: Specifies (together with the filter mask)- the identifiers range that passes the hardware filter for of RX objects. Parameter ranges from 0 to 2047 (11 bits) for Standard IDs and 0 to 536870911 (29 bits) for Extended IDs. User can assign any code to this parameter, but must to respect the above rule related to Standard/Extended IDs.
          integer CanHwFilterMask: post-build-variant-value=true, set at pre-compile in variant pre-compile / post-build in variant post-build, default-value=0  # ECUC_Can_00470: Specifies (together with the filter mask) the identifiers range that passes the hardware filter. EN: Different CanHardwareObjects with different CanIdTypes (STANDARD, MIXED, EXTENDED) can share the same CanFilterMask (i.e., the CanFilterMaskRef parameters of these CanHardwareObjects reference the very same CanFilterMask container). This shall be allowed and must be supported by the configuration generators. The CanFilterMaskRef is omitted for 1) CanHardwareObjects with CanObjectType set to TRANSMIT 2) CanHardwareObjects with CanObjectType set to RECEIVE if only a single Can ID shall be received via this CanHardwareObjects(i.e. exact match with CanIdValue requested when CanHandleType is configured as FULL) ECUC_Can_00321: Reference to the filter mask that is used for hardware filtering together with the CAN_ID_VALUE. This value is used as acceptance masks for ID filtering in RX MBs and the FIFO.
        container CanTTHardwareObjectTrigger [0..*]: multiplicity set at pre-compile  # This container is only included and valid if TTCAN SWS is used and TTCAN is enabled.
          integer CanTTHardwareObjectBaseCycle: 0..63, scope=ECU, post-build-variant-value=true, set at post-build in variant post-build / pre-compile in variant pre-compile, default-value=0  # Defines the cycle_offset.
          integer CanTTHardwareObjectCycleRepetition: 1..64, scope=ECU, post-build-variant-value=true, set at post-build in variant post-build / pre-compile in variant pre-compile, default-value=1  # Defines the repeat_factor.
          integer CanTTHardwareObjectTimeMark: 0..65535, post-build-variant-value=true, set at post-build in variant post-build / pre-compile in variant pre-compile, default-value=0  # Defines the point in time, when the trigger will be activated.
          integer CanTTHardwareObjectTriggerId: 0..63, set at pre-compile, symbolic-name-value=true, default-value=0  # Sequential number which allows separation of different TTCAN triggers configured for one and the same hardware object.
          enumeration CanTTHardwareObjectTriggerType: {CAN_TT_RX_TRIGGER, CAN_TT_TX_REF_TRIGGER, CAN_TT_TX_REF_TRIGGER_GAP, CAN_TT_TX_TRIGGER_EXCLUSIVE, CAN_TT_TX_TRIGGER_MERGED, CAN_TT_TX_TRIGGER_SINGLE}, post-build-variant-value=true, set at post-build in variant post-build / pre-compile in variant pre-compile, default-value=CAN_TT_RX_TRIGGER  # Defines the type of the trigger associated with the hardware object. This parameter depends on plain CAN parameter CAN_OBJECT_TYPE.
    container CommonPublishedInformation  # Common container, aggregated by all modules. It contains published information about vendor and versions.
      integer ArReleaseMajorVersion: 4..4, origin=Flagchip, set at published-information, default-value=4  # Major version number of AUTOSAR specification on which the appropriate implementation is based on.
      integer ArReleaseMinorVersion: 6..6, origin=Flagchip, set at published-information, default-value=6  # Minor version number of AUTOSAR specification on which the appropriate implementation is based on.
      integer ArReleaseRevisionVersion: 0..0, origin=Flagchip, set at published-information, default-value=0  # Revision version number of AUTOSAR specification on which the appropriate implementation is based on.
      integer SwMajorVersion: 1..1, origin=Flagchip, set at published-information, default-value=1  # Major version number of the vendor specific implementation of the module. The numbering is vendor specific. Note: Implementation Specific Parameter
      integer SwMinorVersion: 4..4, origin=Flagchip, set at published-information, default-value=4  # Minor version number of the vendor specific implementation of the module. The numbering is vendor specific. Note: Implementation Specific Parameter
      integer SwPatchVersion: 1..1, origin=Flagchip, set at published-information, default-value=1  # Patch level version number of the vendor specific implementation of the module. The numbering is vendor specific. Note: Implementation Specific Parameter
      integer ModuleId: 80..80, origin=Flagchip, set at published-information, default-value=80  # Module ID of this module from Module List. Note: Implementation Specific Parameter
      integer VendorId: 174..174, origin=Flagchip, set at published-information, default-value=174  # Vendor ID of the dedicated implementation of this module according to the AUTOSAR vendor list. Note: Implementation Specific Parameter
    container AutosarExt  # Autosar Extension API settings.
      boolean CanSupportLegacyCanIfApi: origin=Flagchip, set at pre-compile, default-value=false  # Implements the support for CanIf APIs before AutoSAR 4.2.2. When enabled, the CanIf indication functions will follow the AutoSAR version 4.2.2 for forward compatbility. Otherwise, the API standard will follow AutoSAR R20-11.
      boolean CanUseShortCanIdType: origin=Flagchip, set at pre-compile, default-value=false  # Implements the support for Can_IdType before AutoSAR 4.2.2. When it is enabled and CanExtendedIDSupport is disabled, the Can_IdType will be considered as uint16. Otherwise, it will be considered as uint32.
      boolean CanSupportLegacyPduInfoType: origin=Flagchip, set at pre-compile, default-value=false  # Implements the support for PduInfoType before AutoSAR 4.2.2. When it is enabled, the PduInfoType will be considered as AutoSAR 4.2.2 defined. Otherwise, it will be considered as AutoSAR 4.3.1 defined.
