AUTOSAR XML (schema 00048)
package /FC7300FXXX/EcucDefs/Can_ib_bswmd/BswModuleDescriptions
  bsw module description Can
    bsw internal behavior CanBehavior
      19 x exclusive area:
        Can_CheckWakeup
        Can_DisableControllerInterrupts
        Can_EnableControllerInterrupts
        Can_GetVersionInfo
        Can_Init
        Can_DeInit
        Can_GetControllerErrorState
        Can_GetControllerMode
        Can_MainFunction_BusOff
        Can_MainFunction_Mode
        Can_MainFunction_Read
        Can_MainFunction_Wakeup
        Can_MainFunction_Write
        Can_SetBaudrate
        Can_SetControllerMode
        Can_Write
        Can_TransmitAbort
        Can_GetControllerRxErrorCounter
        Can_GetControllerTxErrorCounter
