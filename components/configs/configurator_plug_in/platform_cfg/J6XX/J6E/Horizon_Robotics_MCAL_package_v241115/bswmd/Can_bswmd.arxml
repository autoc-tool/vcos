AUTOSAR XML (schema 00046)
package /Hobot_Can
  ecuc definition collection Can_EcuParameterDefinition: module=Can
  module definition Can [1..*]: post-build-variant-support=true, refined-module-def=Can, variants post-build/pre-compile  # It stores the configuration details of a CAN driver.
    container CanGeneral [0..1]  # It contains the parameter information required by each CAN driver unit.
      boolean CanDevErrorDetect: set at pre-compile, default-value=false  # Enable or disable development error detection and notification: On or Off. Disabling it can reduce code size, but error detection will not be available.
      boolean CanMulticoreSupport: origin=Horizon, set at pre-compile, default-value=false  # Can drivers can be mapped to multiple EcuC partitions to use the API of the module in this partition. The Can driver will run as a separate instance in each partition.
      boolean CanVersionInfoApi: set at pre-compile, default-value=false  # Enable or disable support for the Can_GetVersionInfo() API. When enabled, the driver supports the API to retrieve version information.
      boolean CanSetBaudrateApi [0..1]: scope=ECU, multiplicity set at pre-compile, set at pre-compile, default-value=false  # If set to true, Can_SetBaudrate will be available.
      boolean CanMultiplexedTransmission: scope=ECU, set at pre-compile, default-value=true  # Define whether multiplexing transmission is supported: on or off. Multiplexing transmission means that when the current Hth MB is busy, find a free MB with the same ObjectId for Can_Write operation.
      boolean CanListenOnlyModeApi [0..1]: multiplicity set at pre-compile, origin=Horizon, set at pre-compile, default-value=false  # If this parameter is activated (set to true), it needs to support Can_ListenOnlyMode, which is a vendor specific function.
      integer CanIndex: 0..255, set at pre-compile, default-value=0  # Indicates the InstanceId of this module instance. If there is only one instance, its Id should be 0.
      float CanMainFunctionModePeriod: 0.0..65.535, set at pre-compile, default-value=0.001  # Describes the cycle of periodic calls to Can_MainFunction_Mode. The unit is in seconds.
      float CanMainFunctionBusoffPeriod [0..1]: 0.0..65.535, multiplicity set at pre-compile, set at pre-compile, default-value=0.001  # The cycle of Can_MainFunction_Busoff() cyclic call is described here, in seconds.
      float CanMainFunctionWakeupPeriod [0..1]: 0.0..65.535, multiplicity set at pre-compile, set at pre-compile, default-value=0.001  # Describes the cycle of periodic calls to Can_MainFunction_Wakeup. The unit is seconds. If CanConfigSet/CanController/CanWakeupSupport is' true ', this field can be edited.
      function name CanLPduReceiveCalloutFunction [0..1]: multiplicity set at pre-compile, set at pre-compile, default-value=NULL_PTR  # ECUC_Can_00434: Specified by this parameter is both the presence and the designation of a callout function, which is invoked following the successful receipt of a CAN Rx L-PDU. Should this parameter be excluded, no callout is to occur.
      function name CanVersion [0..1]: multiplicity set at pre-compile, set at pre-compile  # can version
      enumeration CanTimeoutMethod: {OSHAL_PLACEHOLDER, OSHAL_HORIZON, OSHAL_EXTERNAL}, origin=Horizon, set at pre-compile, default-value=OSHAL_PLACEHOLDER  # Configure the timeout method. Based on this selection, OsIf's specific timeout method will be used in the driver. Note: If SystemTimer or CustomTimer is selected, ensure that the corresponding timer is enabled in the OsIf general configuration. Note: This is an implementation specific parameter.
      float CanTimeoutDuration: 1.0E-6..65.535, set at pre-compile, default-value=1.0  # Define the maximum time of blocking function until timeout is detected, in seconds. This timeout is used to detect hardware errors/production errors. When configuring hardware registers, such as controller register (CTRL) or module control register (MCR), the hardware needs a period of time to take effect of these newly set CAN requests. Once timeout occurs, if the hardware fails to take effect of CAN settings, an error will be reported. Therefore, this timeout is used to allow the hardware settings to take effect. For the OSIF_COUNTER_DUMMY method, CanTimeoutDuration may not be accurately reflected in seconds (but expressed in cycles, 1 microsecond: 1 cycle).
      boolean CanPublicIcomSupport: scope=ECU, set at pre-compile, default-value=false  # Select the Can driver to support the fake network feature. True: Enable False: Disable
      reference CanEcucPartitionRef [0..*]: scope=ECU, multiplicity set at pre-compile, post-build-variant-multiplicity=true, post-build-variant-value=true, set at pre-compile, destination=EcucPartition  # In order to make the API of the module available in a specific partition, the CAN driver is configured to map to zero or several ECUC partitions. In each partition, the CAN driver will operate as an independent instance.
      reference CanOsCounterRef [0..1]: multiplicity set at pre-compile, set at pre-compile, destination=OsCounter  # The reference to the counter is used by the CAN driver. Note: This configuration is not used.
      reference CanSupportTTCANRef_ [0..1]: multiplicity set at pre-compile, set at pre-compile, destination=CanIfPrivateCfg  # Indicates CanIfSupportTTCAN parameter in CAN interface module configuration. CanIfSupportTTCAN parameter defines whether TTCAN is supported
      container CanTimeStamp [0..1]: multiplicity set at pre-compile  # It contains parameters for configuring the timestamp function.
        boolean CanEnableHRCounter: origin=Horizon, set at pre-compile, default-value=true  # Activate the High Resolution Real Time Counter (RTC) function for time stamping.
        function name CanRxTimestampNotification: origin=Horizon, set at pre-compile in variant pre-compile / post-build in variant post-build, default-value=NULL_PTR  # Specify the name of the receive message buffer notification handler here. Note: This is an implementation specific parameter.
        function name CanTxTimestampNotification: origin=Horizon, set at pre-compile in variant pre-compile / post-build in variant post-build, default-value=NULL_PTR  # Specify the name of the sending message buffer notification handler here. Note: This is an implementation specific parameter.
      container CanMainFunctionRWPeriods [0..*]: multiplicity set at pre-compile, requires-index=true  # It contains parameters used to configure the cycle of calling Can_MainFunction_Read or Can_MainFunction_Write circularly according to the reference item.
        float CanMainFunctionPeriod: 0.001..65.535, set at pre-compile, default-value=0.001  # It describes the cycle of periodic calls to Can_MainFunction_Read or Can_MainFunction_Write, depending on the reference item. The unit is seconds. If multiple CanMainFunctionPeriods are configured, you can configure different polling cycles. In this case, the CAN driver module will provide multiple Can_MainFunction_Read() or Can_MainFunction_Write().
      container CanIcomGeneral [0..1]: multiplicity set at pre-compile  # It contains the basic parameter settings for ICOM configuration.
        enumeration CanIcomLevel [0..1]: {CAN_ICOM_LEVEL_ONE, CAN_ICOM_LEVEL_TWO}, scope=ECU, multiplicity set at pre-compile, set at pre-compile, default-value=CAN_ICOM_LEVEL_ONE  # The level of Pretended Networking is defined here. This parameter is reserved for future implementation (Reserved Networking Level 2).
        enumeration CanIcomVariant: {CAN_ICOM_VARIANT_HW, CAN_ICOM_VARIANT_NONE, CAN_ICOM_VARIANT_SW}, scope=ECU, set at pre-compile, default-value=CAN_ICOM_VARIANT_NONE  # Define variants supported by CanController.
    container CanConfigSet [0..1]  # It is a multi configuration set container of CAN driver.
      container CanController [1..*]: multiplicity set at pre-compile  # It contains the configuration parameters of the CAN controller.
        integer CanControllerId: 0..255, scope=ECU, set at pre-compile, symbolic-name-value=true, default-value=1  # It is the unique controller ID in the given CAN driver. The value of this parameter starts from 0 and is continuous.
        enumeration CanHwChannel: {FLEXCAN_0, FLEXCAN_1, FLEXCAN_2, FLEXCAN_3, FLEXCAN_4, FLEXCAN_5, FLEXCAN_6, FLEXCAN_7, FLEXCAN_8, FLEXCAN_9}, origin=Horizon, set at pre-compile, default-value=FLEXCAN_0  # Identify which on-chip FlexCAN interface is associated with this controller ID. Note: This is an implementation specific parameter, not required by AutoSar.
        boolean CanControllerActivation: set at pre-compile, default-value=true  # Determine whether the CAN controller is used in the configuration. Disabling a specific CAN controller is equivalent to not using a CAN controller in the configuration.
        integer CanControllerBaseAddress: 0..4294967295, set at pre-compile, default-value=0x23580000  # Define the base address of the CAN controller.
        enumeration CanRxProcessing: {INTERRUPT, POLLING, MIXED}, set at pre-compile, derivation=informal-formula=verbatim=l-5=Mode of event triggering: INTERRUPT or POLLING., default-value=POLLING  # Process PDU receiving events in POLLING mode by enabling/disabling API Can_MainFunction_Read().
        enumeration CanTxProcessing: {INTERRUPT, POLLING, MIXED}, set at pre-compile, derivation=informal-formula=verbatim=l-5=Mode of event triggering: INTERRUPT or POLLING., default-value=POLLING  # Process PDU transmission events in POLLING mode by enabling/disabling API Can_MainFunction_Write().
        enumeration CanBusoffProcessing: {INTERRUPT, POLLING}, set at pre-compile, derivation=informal-formula=verbatim=l-5=Mode of event triggering: INTERRUPT or POLLING., default-value=POLLING  # Process the bus shutdown event in POLLING mode by enabling/disabling API Can_MainFunction_BusOff().
        enumeration CanWakeupProcessing: {INTERRUPT, POLLING}, set at pre-compile, derivation=informal-formula=verbatim=l-5=Mode of event triggering: INTERRUPT or POLLING., default-value=POLLING  # When the global parameter is' true ', enable or disable the API Can_MainFunction_Wakeup() to process wake-up events in the POLLING mode. Note: Available only when this option is activated.
        boolean CanWakeupSupport: set at pre-compile, default-value=false  # Support CAN driver for wake-up via CAN bus. If this check box is not set to ON, each wake-up process is ignored. This parameter enables internal wake-up (using controller registers) and external wake-up (using WKUP module). Enabled only if the platform supports internal wake-up.
        boolean CanWakeupFunctionalityAPI: set at pre-compile, default-value=false  # Enable or disable the Can_CheckWakeup() service in the code.
        boolean CanLoopBackMode: origin=Horizon, set at pre-compile in variant pre-compile / post-build in variant post-build, default-value=false  # Allow CAN to operate in loopback mode.
        boolean CanAutoBusOffRecovery: origin=Horizon, set at pre-compile in variant pre-compile / post-build in variant post-build, default-value=false  # Enable or disable automatic BusOff recovery (CTRL [BOFF_REC] bit). 0 (selected)=Automatically recover from Bus Off state according to CAN specification 2.0B. 1 (unchecked)=Automatic recovery from Bus Off is disabled, and the module will remain in the Bus Off state until the user negates it by clearing the bit.
        boolean CanControllerPrExcEn: origin=Horizon, post-build-variant-value=true, set at post-build in variant post-build / pre-compile in variant pre-compile, default-value=false  # This setting controls the protocol exception feature, as detailed in the CAN Protocol standard's Protocol exception event section (ISO 11898-1). - True: Activates the feature. - False: Deactivates the feature.
        boolean CanControllerEdgeFilter: origin=Horizon, post-build-variant-value=true, set at post-build in variant post-build / pre-compile in variant pre-compile, default-value=false  # This option pertains to the Edge Filter functionality, as described in the Bus Integration state section of the CAN Protocol standard (ISO 11898-1).- True: Turns on the feature.- False: Turns off the feature.
        boolean CanControllerFdISO: origin=Horizon, set at post-build in variant post-build / pre-compile in variant pre-compile, default-value=true  # Specify to operate according to ISO or non ISO Can FD protocol. If it is true, the controller operates using ISO CAN FD protocol (ISO 11898-1); If it is false, the controller operates with non ISO CAN FD protocol.
        boolean CanClockFromBus: origin=Horizon, set at pre-compile, default-value=true  # Used to switch the clock source of the module to the system bus. When the value is 1, the clock source of the CAN engine comes from the bus clock (from MCU); When the value is 0, the clock source of the CAN engine comes from the oscillator clock.
        function name CanErrorNotification [0..1]: multiplicity set at pre-compile in variant pre-compile / post-build in variant post-build, origin=Horizon, set at pre-compile in variant pre-compile / post-build in variant post-build, default-value=NULL_PTR  # Enable error interrupt function. Notifies all frames of detected errors.
        function name CanFDErrorNotification: origin=Horizon, set at pre-compile in variant pre-compile / post-build in variant post-build, default-value=NULL_PTR  # Only the errors detected in the FD frame are notified.
        boolean ManuallyMbIdxCfg: set at pre-compile, default-value=false  # Support manually configure the MailBox id used by Hth when fifo enable. If this check box is not set to ON, keep the default MailBox id automatic calculation method.
        reference CanCpuClockRef: set at pre-compile, destination=McuRfclkSettingConf  # ECUC_Can_00313: This refers to the configuration of the CPU clock,established within the configuration of the MCU driver. To utilize this, the MCU plugin must be included first, followed by providing its reference.
        reference CanControllerDefaultBaudrate: post-build-variant-value=true, set at pre-compile in variant pre-compile / post-build in variant post-build, destination=CanControllerBaudrateConfig  # Provide a reference to the baud rate configuration container configured by the Can controller.
        reference CanControllerEcucPartitionRef [0..1]: scope=ECU, multiplicity set at pre-compile, post-build-variant-multiplicity=true, post-build-variant-value=true, set at pre-compile, destination=EcucPartition  # It is used to map CAN controller to zero or one ECUC partition. The referenced ECUC partition is a subset of the ECUC partition to which the CAN driver is mapped.
        reference CanWakeupSourceRef [0..1]: multiplicity set at pre-compile, set at pre-compile, requires-symbolic-name-value=true, destination=EcuMWakeupSource  # It contains a reference to the wake-up source defined for this controller, as defined in the ECU Status Manager. Type: Reference EcuM_WakeupSourceType. You need to add the EcuM plug-in, and then provide a reference to it.
        container CanControllerBaudrateConfig [1..*]: multiplicity set at pre-compile  # It contains bit timing related configuration parameters of the CAN controller.
          integer CanControllerBaudRateConfigID: 0..65535, scope=ECU, post-build-variant-value=true, set at pre-compile in variant pre-compile / post-build in variant post-build, default-value=0  # The ID that uniquely identifies a specific baud rate configuration. This ID is used by the SetBaudrate API.
          enumeration CanBaudrateTypeSuport: {NORMAL_CBT, ENHANCE_CBT}, origin=Horizon, post-build-variant-value=true, set at pre-compile in variant pre-compile / post-build in variant post-build, default-value=ENHANCE_CBT  # ENHANCE_CBT: provides a higher bit timing resolution and is stored in the ENCBT, EDCBT and EPRS registers.NORMAL_CBT: These values are stored in the CTRL1 or CBT register (default)
          float CanControllerBaudRate: 0.0..2000.0, post-build-variant-value=true, set at pre-compile in variant pre-compile / post-build in variant post-build, default-value=20.0  # The baud rate of the controller is specified in kbps. The maximum speed of CAN is 1Mbps.
          integer CanControllerPrescaller: 1..1024, origin=Horizon, post-build-variant-value=true, set at pre-compile in variant pre-compile / post-build in variant post-build, default-value=10  # Set the prescaler of the controller. The CanControllerTimeQuanta value calculated according to the module clock and prescaler should be completed offline. Prescaler=FreqCanClk/FreqTq; FreqTq=1/CanControllerTimeQuanta.
          integer CanTxArbitrationStartDelay: 0..31, origin=Horizon, post-build-variant-value=true, set at pre-compile in variant pre-compile / post-build in variant post-build, default-value=2  # It indicates how many CAN bits can be delayed by Tx arbitration process starting point from the first bit of CRC field on the CAN bus. Please refer to the reference manual for the calculation method of the optimal TASD value.
          integer CanControllerSyncSeg: 1..1, origin=Horizon, set at pre-compile in variant pre-compile / post-build in variant post-build, default-value=1  # The synchronization segment (SYNC_SEG) interval is used to synchronize all nodes in the network. SYNC_SEG time interval has a fixed one time quantum (TQ) period.
          integer CanControllerPropSeg: 0..255, post-build-variant-value=true, set at pre-compile in variant pre-compile / post-build in variant post-build, default-value=5  # Compensate the physical delay within the CAN network. When the extended CAN bit timing is disabled, the allowable value range of CanControllerPropSeg is 1-8 Tq; When the extended CAN bit timing is enabled, the allowable value range of CanControllerPropSeg is extended to 1-64 Tq.
          integer CanControllerSeg1: 0..255, post-build-variant-value=true, set at pre-compile in variant pre-compile / post-build in variant post-build, default-value=5  # Define the phase segment 1 in the time quantum unit. If the extended CAN bit timing is not enabled, the valid range of CanControllerSeg1 is 1-8 Tq; If the extended CAN bit timing is enabled, its effective value range is extended to 1-32 Tq.
          integer CanControllerSeg2: 0..255, post-build-variant-value=true, set at pre-compile in variant pre-compile / post-build in variant post-build, default-value=6  # Define phase segment 2 in the quantum unit of time. If the extended CAN bit timing is not enabled, the effective value of CanControllerSeg2 is 2-8 Tq; If enabled, the valid range is 2-32 Tq.
          integer CanControllerSyncJumpWidth: 0..255, post-build-variant-value=true, set at pre-compile in variant pre-compile / post-build in variant post-build, default-value=1  # If the extended CAN bit timing is not enabled, the effective value of CanControllerSyncJumpWidth is 1-4 Tq; If the extended CAN bit timing is enabled, the valid value range is extended to 1-32 Tq.
          container CanControllerFdBaudrateConfig [0..1]: multiplicity set at pre-compile  # It contains bit timing related configuration parameters of the CAN controller, and is applicable to the payload and CRC of the CAN FD frame. If the container exists, it indicates that the controller supports CAN FD frames.
            float CanControllerFdBaudRate: 0.0.., post-build-variant-value=true, set at pre-compile in variant pre-compile / post-build in variant post-build, default-value=250.0  # The baud rate of the data section of the controller is in kbps
            integer CanControllerFdPrescaller [0..1]: 1..1024, multiplicity set at pre-compile in variant pre-compile / post-build in variant post-build, origin=Horizon, post-build-variant-multiplicity=true, post-build-variant-value=true, set at pre-compile in variant pre-compile / post-build in variant post-build, default-value=1  # The Fd Prescaler option will overwrite the pre division setting of the Can controller.
            integer CanControllerFdSyncSeg: 1..1, origin=Horizon, set at pre-compile in variant pre-compile / post-build in variant post-build, default-value=1  # All network nodes are synchronized through the SYNC_SEG time period, which is set according to a fixed time quantity cycle (TQ).
            integer CanControllerPropSeg: 0..255, post-build-variant-value=true, set at pre-compile in variant pre-compile / post-build in variant post-build, default-value=1  # Time quantas are used to define the propagation delay.
            integer CanControllerSeg1: 0..255, post-build-variant-value=true, set at pre-compile in variant pre-compile / post-build in variant post-build, default-value=1  # The phase segment 1 is defined in time quantas.
            integer CanControllerSeg2: 0..255, post-build-variant-value=true, set at pre-compile in variant pre-compile / post-build in variant post-build, default-value=2  # Time quantas are used to specify phase segment 2.
            integer CanControllerSyncJumpWidth: 0..255, post-build-variant-value=true, set at pre-compile in variant pre-compile / post-build in variant post-build, default-value=1  # The synchronous jump width of the controller is set according to the time unit.
            integer CanControllerSspOffset [0..1]: 0..255, multiplicity set at pre-compile in variant pre-compile / post-build in variant post-build, post-build-variant-multiplicity=true, post-build-variant-value=true, set at pre-compile in variant pre-compile / post-build in variant post-build, default-value=0  # define the transmit delay compensation offset in the minimum time quantization unit.
            boolean CanControllerTxBitRateSwitch: post-build-variant-value=true, set at post-build in variant post-build / pre-compile in variant pre-compile, default-value=true  # Whether to use bit rate switching for transmission needs to be clearly indicated.
        choice container CanRamBlock [0..1]: multiplicity set at pre-compile  # Define the data capacity of the RAM block.
          container CanRamBlockSpecified [0..1]  # Set the payload length of available RAM blocks.
            enumeration CanBlock0PayloadLength: {CAN_8_BYTES_PAYLOAD, CAN_16_BYTES_PAYLOAD, CAN_32_BYTES_PAYLOAD, CAN_64_BYTES_PAYLOAD}, origin=Horizon, set at pre-compile, default-value=CAN_8_BYTES_PAYLOAD  # Set the data capacity of block 0.
            enumeration CanBlock1PayloadLength: {CAN_8_BYTES_PAYLOAD, CAN_16_BYTES_PAYLOAD, CAN_32_BYTES_PAYLOAD, CAN_64_BYTES_PAYLOAD}, origin=Horizon, set at pre-compile, default-value=CAN_8_BYTES_PAYLOAD  # Set the data capacity of block 1.
            enumeration CanBlock2PayloadLength: {CAN_8_BYTES_PAYLOAD, CAN_16_BYTES_PAYLOAD, CAN_32_BYTES_PAYLOAD, CAN_64_BYTES_PAYLOAD}, origin=Horizon, set at pre-compile, default-value=CAN_8_BYTES_PAYLOAD  # Set the data capacity of block 2.
            enumeration CanBlock3PayloadLength: {CAN_8_BYTES_PAYLOAD, CAN_16_BYTES_PAYLOAD, CAN_32_BYTES_PAYLOAD, CAN_64_BYTES_PAYLOAD}, origin=Horizon, set at pre-compile, default-value=CAN_8_BYTES_PAYLOAD  # Set the data capacity of block 3.
        container CanRxFiFo [0..1]: multiplicity set at pre-compile  # To utilize a traditional FIFO, make sure to deactivate the FD feature. Otherwise, traditional FIFO cannot be utilized unless the CanControllerFdBaudrateConfig optional field is disabled.
          container CanEnhanceFiFo [0..1]  # Configuration for an enhanced RxFiFo should be specified.
            enumeration CanEnhancedSchemeType: {MASK_FILTER_SCHEME, RANGE_FILTER_SCHEME, TWO_FILTER_SCHEME}, origin=Horizon, set at pre-compile in variant pre-compile / post-build in variant post-build, default-value=MASK_FILTER_SCHEME  # The FIFO filtering scheme needs to be defined. For the enhanced RxFilterFo scheme, the type should be either RANGE_FILTER_SCHEME or TWO_FILTER_SCHEME. Two consecutive elements in CanHwFilter are used to configure an enhanced RxFilterFo filter element, where the ID filter1 in the first element is CanHwFilterCode, and the ID filter2 in the second element is also CanHwFilterCode.
            function name CanFiFoOverflowNotif: origin=Horizon, set at pre-compile, default-value=NULL_PTR  # A callback function is employed to notify about enhanced FIFO overflow.
      container CanHardwareObject [1..*]: multiplicity set at pre-compile, requires-index=true  # SWS 324 contains the configuration parameters of CAN hardware objects. This configuration element serves as information for the CAN interface, with the relevant CAN drive configuration completed through the filter mask and identifier.
        integer CanObjectId: 0..65535, scope=ECU, set at pre-compile, symbolic-name-value=true, default-value=0  # The handle ID of HRH or HTH needs to be saved. This parameter should be unique in the given CAN driver and numbered consecutively from 0. HRH and HTH Ids are defined in two different namespaces, for example: HRH0-0, HRH1-1, HTH0-2, HTH1-3.
        enumeration CanObjectType: {RECEIVE, TRANSMIT}, scope=ECU, post-build-variant-value=true, set at pre-compile in variant pre-compile / post-build in variant post-build, default-value=RECEIVE  # Mention whether the hardware object is used for sending or receiving. Note that MB configured as MIXED standard and receive type will be considered as expansion.
        enumeration CanHandleType: {BASIC, FULL}, scope=ECU, post-build-variant-value=true, set at pre-compile in variant pre-compile / post-build in variant post-build, default-value=BASIC  # The type of hardware object (full CAN or basic CAN) should be specified. Note that all Fifo enabled controllers must have at least one receiving hardware object defined, with the first receive hardware object configured conventionally to receive data from FIFO.
        enumeration CanIdType: {EXTENDED, STANDARD}, post-build-variant-value=true, set at pre-compile in variant pre-compile / post-build in variant post-build, default-value=STANDARD  # The type of IdValue should be specified - standard identifier (ID -11 bit length), extended identifier (ID -29 bit length), or mixed mode (standard or extended). Note that MB configured as MIXED standard and receive type will be considered as expansion.
        integer CanFdPaddingValue [0..1]: 0..255, scope=ECU, multiplicity set at pre-compile in variant pre-compile / post-build in variant post-build, post-build-variant-multiplicity=true, post-build-variant-value=true, set at pre-compile in variant pre-compile / post-build in variant post-build, default-value=0  # MBCS [PRIO]: This is the filling value when FD is utilized.
        boolean CanHardwareObjectUsesPolling [0..1]: multiplicity set at pre-compile, set at pre-compile, default-value=false  # Polling should be enabled for this hardware object. If CanRxProcessing/CanTxProcessing is set to MIXED, this node must be present.
        boolean CanTriggerTransmitEnable [0..1]: scope=ECU, multiplicity set at pre-compile, set at pre-compile, default-value=false  # Indicate whether the Can handle supports the trigger-transmit API.
        enumeration CanHwObjectUsesBlock [0..1]: {CAN_RAM_BLOCK_0, CAN_RAM_BLOCK_1, CAN_RAM_BLOCK_2, CAN_RAM_BLOCK_3, CAN_RAM_BLOCK_4, CAN_RAM_BLOCK_5, CAN_RAM_BLOCK_6, CAN_RAM_BLOCK_7}, multiplicity set at pre-compile in variant pre-compile / post-build in variant post-build, origin=Horizon, post-build-variant-value=true, set at pre-compile in variant pre-compile / post-build in variant post-build, default-value=CAN_RAM_BLOCK_0  # Choose the Block to which the Hw Object is assigned. This field does not apply to the first HRH of a controller enabling Enhance FIFO.
        integer CanHwObjectCount: 1..65535, post-build-variant-value=true, set at pre-compile in variant pre-compile / post-build in variant post-build, default-value=1  # Specify the number of hardware objects used to implement a single HOH. For HRH, this parameter indicates the number of elements in the hardware FIFO or shadow buffers. For HTH, it determines the number of hardware objects used for multiplexed transmission or in a hardware FIFO for a FullCAN HTH.
        integer CanHthMBIdx: -9223372036854775808..9223372036854775807, post-build-variant-value=true, set at pre-compile in variant pre-compile / post-build in variant post-build, default-value=255  # Specify the MailBox index of hardware objects used to implement a single HTH when Rx Fifo used.
        boolean CanTimeStampEnable: scope=ECU, origin=Horizon, set at post-build in variant post-build / pre-compile in variant pre-compile, default-value=false  # Activate the Timestamp feature for the HOH.
        reference CanControllerRef: post-build-variant-value=true, set at pre-compile in variant pre-compile / post-build in variant post-build, destination=CanController  # Make a reference to the corresponding CAN Controller for the HOH.
        reference CanMainFunctionRWPeriodRef [0..1]: multiplicity set at pre-compile in variant pre-compile / post-build in variant post-build, post-build-variant-multiplicity=true, post-build-variant-value=true, set at pre-compile in variant pre-compile / post-build in variant post-build, destination=CanMainFunctionRWPeriods  # Establish an association between the HOH and a specific CAN Controller.
        container CanHwFilter [0..*]: multiplicity set at pre-compile, requires-index=true  # ECUC_Can_00468: This container applies solely to HRHs and outlines the configuration (parameters) for a single hardware filter.When utilizing the HRH for Legacy FIFO, the CanHwFilterCode should be interpreted as follows:- Can ID Acceptance Mode:- FORMAT_A:- STANDARD: Uses all 11 bits for frame identification.- EXTENDED: Utilizes all 29 bits for frame identification.- FORMAT_B:- STANDARD: All 11 bits are employed for frame identification.- EXTENDED: The 14 most significant bits out of 29 are used for frame identification.- FORMAT_C:- STANDARD: Only the 8 most significant bits out of 11 are used for frame identification.- EXTENDED: Just the 8 most significant bits out of 29 are used for frame identification.Users are required to supply the full ID. For instance, under FORMAT_C with a STANDARD frame type, users must provide all 11 bits, not just the 8 most significant bits.
          integer CanHwFilterCode: 0..4294967295, post-build-variant-value=true, set at pre-compile in variant pre-compile / post-build in variant post-build, default-value=0  # ECUC_Can_00325: This parameter, in conjunction with the filter mask, defines the range of identifiers that are allowed through the hardware filter for RX objects. The parameter can be set within the range of 0 to 0x7FF (11 bits) for Standard IDs and from 0 to 0x1FFFFFFF (29 bits) for Extended IDs. Users have the flexibility to assign any value to this parameter, provided it adheres to the specified rule for Standard/Extended IDs.
          integer CanHwFilterMask: 0..4294967295, post-build-variant-value=true, set at pre-compile in variant pre-compile / post-build in variant post-build, default-value=0  # Specify the range of identifiers that pass through the hardware filter, in conjunction with the filter mask. This value acts as acceptance masks for ID filtering in RX MBs and the FIFO.
      container CanIcom [0..1]: multiplicity set at pre-compile  # This container encompasses the parameters for the Pretended Network.
        container CanIcomConfig [1..256]: multiplicity set at pre-compile  # This container houses the general configuration parameters for the ICOM Configuration.
          integer CanIcomConfigId: 1..255, set at pre-compile, default-value=1  # Identify the ID of the ICOM configuration. To prevent issues with multiple ICom configurations, configure ConfigIDs sequentially.
          boolean CanIcomWakeOnBusOff: scope=ECU, set at pre-compile, default-value=false  # Determine whether the MCU should wake up upon detecting bus shutdown.
          container CanIcomWakeupCauses [0..1]  # This container comprises the configuration parameters for the wake-up reason when exiting the energy-saving mode.
            container CanIcomRxMessage [1..*]: multiplicity set at pre-compile  # This container includes configuration parameters that correspond to the wake-up reason of the received message. If the received message is defined as the wake-up reason, it must be configured. Note: Ensure no overlap between the message IDs defined in CanIcomMessageId and CanIcomRxMessageIdMask for all CanIcomRxMessage instances.
              integer CanIcomCounterValue [0..1]: 1..255, scope=ECU, multiplicity set at pre-compile, set at pre-compile, default-value=1  # Specify that the MCU should wake up if a message with a specific ID is received a certain number of times on the communication channel. Note: ASR421 requires this field to be 16 bits, but the hardware only supports 8 bits, with a limit value of 256.
              enumeration CanIcomMessageIdType: {EXTENDED, STANDARD}, origin=Horizon, set at pre-compile, default-value=STANDARD  # Define the type of CanIcomMessageIdType - standard identifier (ID -11 bit length) or extended identifier (ID -29 bit length).
              integer CanIcomMessageId: 0..536870911, scope=ECU, set at pre-compile, default-value=0  # Define the message ID for the wake-up triggers of this CanIcomRxMessage. Additionally, a mask (CanIcomMessageIdMask) can be specified to create a range of rx messages that can trigger a wake-up condition. When CanIcomIdOperation is set to INSIDE_RANGE, this node contains the lower limit value.
              enumeration CanIcomIdOperation: {EXACTLY, GREATER_MINNUM, SMALLER_MAXNUM, INSIDE_RANGE}, origin=Horizon, set at pre-compile, default-value=EXACTLY  # This parameter, not part of AUTOSAR, is created to support the selection of ID filter types. The platform offers four options for filtering wake-up messages based on ID: EXACTLY, SMALLER, GREATER, INSIDE_RANGE.
              integer CanIcomMessageIdMask [0..1]: 0..536870911, scope=ECU, multiplicity set at pre-compile, set at pre-compile, default-value=0  # Specify a mask for filtering CAN identifiers. Incoming message CAN identifiers are masked with CanIcomMessageIdMask. By comparing the masked identifier with the masked value of CanIcomMessageId, a wake-up condition for this CanIcomRxMessage can be established. Bits with a value of 0 indicate no comparison at that bit position. The mask should be constructed with leading zeros, and this node includes the upper limit value for ID range detection. This register is used to store the ID mask when precise ID filtering criteria are selected; otherwise, it remains unused.
              float CanIcomMissingMessageTimerValue [0..1]: 0.0..65535.0, scope=ECU, multiplicity set at pre-compile, set at pre-compile, default-value=0.0  # This setting indicates that the MCU is configured to wake up if a message with a specified ID has not been received within a certain time frame, measured in seconds, on the communication channel.NOTE: Assigning a value of '0' signifies that wake-up by timer is deactivated. To turn off the wake-up by timer feature, this object should be disabled.The increment of the internal timer is determined by periodic time ticks, the frequency of which is 64 times the unit of CAN Bit Time. It is necessary to activate CanIcomDefaultBaudrate for the accurate calculation of ticks to be programmed into the hardware.
              boolean CanIcomPayloadLengthError: scope=ECU, set at pre-compile, default-value=false  # Define that the MCU should wake up in the event of a payload error.
              boolean CanPayloadFilter: scope=ECU, origin=Horizon, set at pre-compile, default-value=false  # Specify whether to enable filtering of message payloads in Pretended Networking.
              reference CanIcomDefaultBaudrate [0..1]: multiplicity set at pre-compile, origin=Horizon, set at pre-compile, destination=CanControllerBaudrateConfig  # Refer to the baudrate configuration container set up for the Can Controller to calculate CanIcomMissingMessageTimerValue.
              container CanIcomRxMessageSignalConfig [0..*]: multiplicity set at pre-compile  # This container holds the configuration parameters for the wake-up triggers associated with matching signals. It should be configured for each signal defined as a wake-up trigger. If any signal condition in CanIcomRxMessageSignalConfig evaluates to true or if no conditions are defined, the entire wake-up condition is considered true. All instances of this container reference the same frame/pdu (see CanIcomMessageId).
                integer CanIcomSignalMask: 0..9223372036854775807, set at pre-compile, default-value=0  # Utilize this parameter to apply a mask to a signal within the payload of a CAN message. The mask is combined with the signal payload through a binary AND operation. The resulting value, when combined with operations defined in CanIcomSignalOperation and CanIcomSignalValue, is used for payload filtering. ASR requests a full 64-bit integer type, but the Tresos tool limits integers to 63 bits, resulting in a maximum value of 0x7fffffffffffffff. Ensure all bits are provided for accurate payload filtering.
                enumeration CanIcomSignalOperation: {AND, EQUAL, GREATER, SMALLER, XOR}, scope=ECU, set at pre-compile, default-value=EQUAL  # This parameter dictates the operation used to validate whether the signal value triggers a wake-up condition. Note that hardware does not support the XOR type; if selected, it is converted to a RANGE type supported by the hardware. When the XOR type is chosen as RANGE, CanIcomSignalValue specifies the lower limit, and CanIcomSignalMask specifies the upper limit.
                integer CanIcomSignalValue: 0..9223372036854775807, set at pre-compile, default-value=0  # Use this parameter to define a signal value for comparison with the masked value of the received signal (CanIcomSignalRef) based on CanIcomSignalOperation and CanIcomSignalMask. Provide all bits for precise payload filtering. For example, if the node is 0x0011223344556677, each byte of the incoming message is masked accordingly.
                integer DLCLowValue: 0..8, origin=Horizon, set at pre-compile in variant pre-compile / post-build in variant post-build, default-value=0  # This non-AUTOSAR object configures the minimum value for the 'CAN_FLT_DLC' register, representing the lowest number of data bytes for wake-up messages.
                integer DLCHighValue: 0..8, origin=Horizon, set at pre-compile in variant pre-compile / post-build in variant post-build, default-value=0  # This non-AUTOSAR object configures the maximum value for the 'CAN_FLT_DLC' register, representing the highest number of data bytes for wake-up messages.
                reference CanIcomSignalRef [0..1]: scope=ECU, multiplicity set at pre-compile, set at pre-compile, destination=ComSignal  # Define a reference to the signal to be checked in addition to the message ID (CanIcomMessageId). This reference is used to identify the ComSignal associated with this filter setting, ensuring all signals referenced point to the same PDU.
    container CommonPublishedInformation [0..1]  # This common container, shared by all modules, contains published information about vendors and versions.
      integer ArReleaseMajorVersion: 4..4, origin=Horizon, set at published-information, default-value=4  # The major version number of the AUTOSAR specification on which the implementation is based.
      integer ArReleaseMinorVersion: 4..4, origin=Horizon, set at published-information, default-value=4  # The minor version number of the AUTOSAR specification on which the implementation is based.
      integer ArReleaseRevisionVersion: 0..0, origin=Horizon, set at published-information, default-value=0  # The revision version number of the AUTOSAR specification on which the implementation is based.
      integer ModuleId: 80..80, origin=Horizon, set at published-information, default-value=80  # Retrieve the Module ID from the Module List for this specific module. Note: This parameter is implementation-specific.
      integer VendorId: 189..189, origin=Horizon, set at published-information, default-value=189  # Obtain the Vendor ID of the specific implementation of this module as per the AUTOSAR vendor list. Note: This parameter is implementation-specific.
      integer SwMajorVersion: 1..1, origin=Horizon, set at published-information, default-value=1  # Identify the major version number of the module's vendor-specific implementation. The versioning scheme is defined by the vendor. Note: This parameter is implementation-specific.
      integer SwMinorVersion: 0..0, origin=Horizon, set at published-information, default-value=0  # Determine the minor version number of the module's vendor-specific implementation. The versioning scheme is defined by the vendor. Note: This parameter is implementation-specific.
      integer SwPatchVersion: 0..0, origin=Horizon, set at published-information, default-value=0  # Find the patch level version number of the module's vendor-specific implementation. The versioning scheme is defined by the vendor. Note: This parameter is implementation-specific.
