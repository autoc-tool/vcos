AUTOSAR XML (schema 00046)
package /Hobot_Spi
  ecuc definition collection Spi_AUTOSARParameterDefinition: module=Spi
  ecuc definition collection Spi_EcuParameterDefinition: module=Spi
  module definition Spi: post-build-variant-support=true, refined-module-def=Spi, variants pre-compile  # Set up the SPI (Serial Peripheral Interface) module.
    container CommonPublishedInformation [0..1]  # A universal container that aggregates all modules, including supplier and version release information.
      integer ArReleaseMajorVersion: 4..4, origin=HOBOT, set at link in variant link-time / post-build in variant post-build / pre-compile in variant pre-compile, default-value=4  # Describing the major version numbers of the AUTOSAR specification.
      integer ArReleaseMinorVersion: 4..4, origin=HOBOT, set at link in variant link-time / post-build in variant post-build / pre-compile in variant pre-compile, default-value=4  # Describing the minor version number of the AUTOSAR specification.
      integer ArReleaseRevisionVersion: 0..0, origin=HOBOT, set at link in variant link-time / post-build in variant post-build / pre-compile in variant pre-compile, default-value=0  # Describing the patch level version number of the AUTOSAR specification.
      integer ModuleId: 83..83, origin=HOBOT, set at link in variant link-time / post-build in variant post-build / pre-compile in variant pre-compile, default-value=83  # The unique module ID of the module.
      integer SwMajorVersion: origin=HOBOT, set at link in variant link-time / post-build in variant post-build / pre-compile in variant pre-compile, default-value=1  # The major version number implemented by the supplier for this module is a supplier specific number.
      integer SwMinorVersion: 0..0, origin=HOBOT, set at link in variant link-time / post-build in variant post-build / pre-compile in variant pre-compile, default-value=0  # The minor version number implemented by the supplier for this module, which is a supplier specific number.
      integer SwPatchVersion: 0..0, origin=HOBOT, set at link in variant link-time / post-build in variant post-build / pre-compile in variant pre-compile, default-value=0  # The patch level version number implemented by the supplier for this module is a vendor specific number.
      string VendorApiInfix [0..1]: multiplicity set at link in variant link-time / post-build in variant post-build / pre-compile in variant pre-compile, origin=HOBOT, set at link in variant link-time / post-build in variant post-build / pre-compile in variant pre-compile  # For driver modules that can be instantiated multiple times on a single ECU, BSW00347 requires the API name to be extended to include VendorId and vendor specific names. This parameter is used to define a supplier specific name. The generation of specific names follows a certain format: _ _ . For example, for implementers with VendorId 123 and VendorApiFix selected as 'v11r456', Can_Write will be converted to Can_123_v11r456Write. This parameter is required for all modules with an upper multiplicity greater than 1, but not applicable for modules with an upper multiplicity of 1.
      integer VendorId: 189..189, origin=HOBOT, set at link in variant link-time / post-build in variant post-build / pre-compile in variant pre-compile, default-value=189  # According to the AUTOSAR vendor list, the dedicated implementation supplier ID for this module.
    container SpiDemEventParameterRefs [0..1]: multiplicity set at pre-compile  # This container covers references to DemEventParameter elements, which need to be called through the Dem_SetEventStatus API when corresponding errors occur. Get EventId from the referenced DemEventParameter. Standard errors and errors that can be extended through supplier specific references are listed in this container.
      reference SPI_E_HARDWARE_ERROR [0..1]: multiplicity set at pre-compile, set at pre-compile, destination=DemEventParameter  # For the 'hardware failure' report, a configuration reference for DEM events is provided. If there is no configuration reference, the error will not be reported.
    container SpiDriver [0..1]  # This container integrates the configuration options of the AUTOSAR Spi module and its related sub containers.
      integer SpiMaxChannel [0..1]: 0..255, multiplicity set at link in variant link-time / pre-compile in variant pre-compile / post-build in variant post-build, post-build-variant-multiplicity=true, post-build-variant-value=true, set at link in variant link-time / pre-compile in variant pre-compile / post-build in variant post-build, default-value=0  # During the configuration phase, the tool will collect the number of configured channels. Note: Although this parameter exists, the maximum channel value is actually determined by the number of configured channels.
      integer SpiMaxSequence [0..1]: 0..255, multiplicity set at link in variant link-time / pre-compile in variant pre-compile / post-build in variant post-build, post-build-variant-multiplicity=true, post-build-variant-value=true, set at link in variant link-time / pre-compile in variant pre-compile / post-build in variant post-build, default-value=0  # During the configuration phase, the tool will collect the number of configured sequences. Note: Although this parameter is mentioned, the maximum sequence value is actually determined based on the number of configured sequences.
      integer SpiMaxJob [0..1]: 0..65535, multiplicity set at link in variant link-time / pre-compile in variant pre-compile / post-build in variant post-build, post-build-variant-multiplicity=true, post-build-variant-value=true, set at link in variant link-time / pre-compile in variant pre-compile / post-build in variant post-build, default-value=0  # During the configuration phase, the tool will collect the number of configured tasks. Note: Although this parameter is set, the maximum job value is actually determined based on the configured number of jobs.
      container SpiSequence [1..*]: multiplicity set at pre-compile  # All the data required to configure an SPI sequence is summarized here.
        function name SpiSeqEndNotification [0..1]: multiplicity set at link in variant link-time / pre-compile in variant pre-compile / post-build in variant post-build, post-build-variant-multiplicity=true, post-build-variant-value=true, set at link in variant link-time / pre-compile in variant pre-compile / post-build in variant post-build, default-value=NULL_PTR  # It is a reference to a notification function.
        boolean SpiInterruptibleSequence: post-build-variant-value=true, set at link in variant link-time / pre-compile in variant pre-compile / post-build in variant post-build, default-value=false  # It allows or does not allow the sequence to be suspended by another sequence.
        integer SpiSequenceId: 0..255, scope=ECU, set at pre-compile, symbolic-name-value=true, default-value=0  # The sequence ID of the configured SPI sequence.
        reference SpiJobAssignment [1..*]: multiplicity set at link in variant link-time / pre-compile in variant pre-compile / post-build in variant post-build, post-build-variant-multiplicity=true, post-build-variant-value=true, set at link in variant link-time / pre-compile in variant pre-compile / post-build in variant post-build, destination=SpiJob  # The sequence references multiple jobs during the execution of the communication sequence.
      container SpiExternalDevice [1..*]: multiplicity set at pre-compile  # This describes the communication configuration of external devices closely related to SpiJob.
        enumeration SpiShiftClockIdleLevel: {HIGH, LOW}, post-build-variant-value=true, set at link in variant link-time / pre-compile in variant pre-compile / post-build in variant post-build, default-value=HIGH  # The idle level of the SPI shift clock is defined by this parameter.
        enumeration SpiDataShiftEdge: {LEADING, TRAILING}, post-build-variant-value=true, set at link in variant link-time / pre-compile in variant pre-compile / post-build in variant post-build, default-value=LEADING  # The SPI data shift edge is defined by this parameter.
        string SpiCsIdentifier: set at pre-compile, symbolic-name-value=true, default-value=PCS0  # This parameter represents the iconic name of the chip selection (CS) assigned to a specific job, which is unique to each HwUnit. Specific available chip selection information should be obtained by referring to the manual. If SpienableCs is not activated, the driver code will not utilize the value of this parameter. It is recommended to set it to the default value of PCS0.
        float SpiBaudrate: 10000.0..4.0E7, post-build-variant-value=true, set at link in variant link-time / pre-compile in variant pre-compile / post-build in variant post-build, default-value=100000.0  # From the perspective of configuration tools, this parameter defines the baud rate of communication, with allowable ranges ranging from Hz to MHz. This setting only applies to MASTER mode. In the case of MTFE=0, the optional range of baud rate is 10000 to 40000000 Hz; When MTFE=1, the selectable baud rate range is extended to 100000 to 40000000Hz. It should be noted that the actual achievable baud rate accuracy depends on the configuration of the SPI clock source. If the set value cannot be accurately achieved, the closest value will be used.
        enumeration SpiHwUnit: {CSIB0, CSIB1, CSIB2, CSIB3, CSIB4, CSIB5}, post-build-variant-value=true, set at link in variant link-time / pre-compile in variant pre-compile / post-build in variant post-build, default-value=CSIB0  # It is a symbolic name used to identify the HW SPI hardware microcontroller peripheral devices assigned to the job. CSIBn references the nth logical unit configured in the SpiPyUnit container. For example, CSIB0 references the first logical unit (instead of the first SPI-0 HW unit).
        boolean SpiEnableCs: post-build-variant-value=true, set at link in variant link-time / pre-compile in variant pre-compile / post-build in variant post-build, default-value=false  # This parameter determines whether to enable the chip selection processing function. This parameter is closely related to the assignment. If this parameter is true, assert chip selection; If it is false, keep talking about chip selection.
        enumeration SpiCsPolarity: {LOW}, post-build-variant-value=true, set at link in variant link-time / pre-compile in variant pre-compile / post-build in variant post-build, default-value=LOW  # The effective polarity of chip selection is defined by this parameter.
        enumeration SpiCsSelection [0..1]: {CS_VIA_PERIPHERAL_ENGINE, CS_VIA_GPIO}, multiplicity set at link in variant link-time / pre-compile in variant pre-compile / post-build in variant post-build, post-build-variant-multiplicity=true, post-build-variant-value=true, set at link in variant link-time / pre-compile in variant pre-compile / post-build in variant post-build, default-value=CS_VIA_PERIPHERAL_ENGINE  # When the chip selection processing function is enabled (see SpiEnabling Cs), this parameter determines whether the chip selection is automatically managed by the peripheral hardware engine or controlled through the Spi driver program using a universal input/output interface.
        float SpiTimeClk2Cs: 0.0..1.0E-4, post-build-variant-value=true, set at link in variant link-time / pre-compile in variant pre-compile / post-build in variant post-build, default-value=1.0E-6  # The time interval (tASC) between clock and chip selection is in seconds, and the allowed value range for this parameter is from 0 seconds to 0.0001 seconds. The actual configuration values used in the software BSW-SPI are calculated by the generator tool. If continuous transmission mode is used (PCS signal remains active between transmissions), tASC and tCSC will be inserted between transmissions.
        reference SpiDeviceEcucPartitionRef [0..*]: scope=ECU, multiplicity set at pre-compile, post-build-variant-multiplicity=true, post-build-variant-value=true, set at pre-compile, destination=EcucPartition  # ECUC_Spi_00246 specifies a rule for mapping SPI peripherals to zero or more ECUC partitions to restrict access to that peripheral. The referenced ECUC partition is a subset of the ECUC partition mapped by the SPI driver.
      container SpiChannel [1..*]: multiplicity set at pre-compile  # All the data required to configure a single SPI channel is summarized here.
        integer SpiDefaultData [0..1]: 0..4294967295, multiplicity set at link in variant link-time / pre-compile in variant pre-compile / post-build in variant post-build, post-build-variant-multiplicity=true, post-build-variant-value=true, set at link in variant link-time / pre-compile in variant pre-compile / post-build in variant post-build, default-value=1  # When the pointer passed to Spi_WriteIB (for internal buffer) or Spi_SetupEB (for external buffer) is NULL, default data will be transmitted.
        integer SpiChannelId: 0..255, set at pre-compile, symbolic-name-value=true, default-value=0  # The SPI channel ID used as a parameter for the SPI API function.
        enumeration SpiTransferStart: {MSB}, post-build-variant-value=true, set at link in variant link-time / pre-compile in variant pre-compile / post-build in variant post-build, default-value=MSB  # The first starting bit used for transmission is defined by this parameter.
        integer SpiDataWidth: 4..32, post-build-variant-value=true, set at link in variant link-time / pre-compile in variant pre-compile / post-build in variant post-build, default-value=8  # The width of the transmitted data unit is defined by this parameter. Note: The hardware supports a data width range of 4 to 32 bits. When SpiChannelBuffersAllowed=0, IB should be selected as the SpiChannelType; When SpiChannelBuffersAllowed=1, EB should be selected; When SpiChannelBuffersAuthorized=2, IB or EB can be used as SpiChannelType.
        enumeration SpiChannelType: {EB, IB}, post-build-variant-value=true, set at link in variant link-time / pre-compile in variant pre-compile / post-build in variant post-build, default-value=IB  # This parameter provides instructions on the buffer usage of EB/IB channels. Note: The applicability of this parameter is based on the value of the SpiChannelBuffersAllowed parameter. When SpiChannelBuffersAllowed=0, IB should be selected as the SpiChannelType; When SpiChannelBuffersAllowed=1, EB should be selected; When SpiChannelBuffersAuthorized=2, IB or EB can be used as SpiChannelType.
        integer SpiEbMaxLength: 0..65535, post-build-variant-value=true, set at link in variant link-time / pre-compile in variant pre-compile / post-build in variant post-build, default-value=1  # For the EB channel, this parameter defines the maximum number of data elements that the data buffer can accommodate.
        integer SpiIbNBuffers: 0..65535, post-build-variant-value=true, set at link in variant link-time / pre-compile in variant pre-compile / post-build in variant post-build, default-value=1  # For the EB channel, this parameter indicates the maximum amount of data that the data buffer can accommodate. For channels with SpiDataWidth between 9 and 16 bits, the number of bytes allocated in the buffer must be even; For the range of 17 to 32 bits, the number of allocated bytes must be divisible by 4.
      container SpiJob [1..*]: multiplicity set at pre-compile  # Covers all the necessary data for setting up a single SPI job, including links to specific configurations between internal SPI units and external devices.
        integer SpiJobId: 0..65535, set at pre-compile, symbolic-name-value=true, default-value=0  # The SPI job ID used as a parameter in the SPI API function.
        function name SpiJobEndNotification [0..1]: multiplicity set at link in variant link-time / pre-compile in variant pre-compile / post-build in variant post-build, post-build-variant-multiplicity=true, post-build-variant-value=true, set at link in variant link-time / pre-compile in variant pre-compile / post-build in variant post-build, default-value=NULL_PTR  # It provides a reference to the notification mechanism.
        integer SpiJobPriority: 0..3, post-build-variant-value=true, set at link in variant link-time / pre-compile in variant pre-compile / post-build in variant post-build, default-value=0  # According to SPI093, set priority: 0 represents the lowest and 3 represents the highest.
        reference SpiDeviceAssignment: set at pre-compile, destination=SpiExternalDevice  # Referenced the external devices used in this assignment.
        container SpiChannelList [1..*]: multiplicity set at pre-compile  # Referenced the SPI channels and their order in the assignment.
          integer SpiChannelIndex: 0..255, post-build-variant-value=true, set at link in variant link-time / pre-compile in variant pre-compile / post-build in variant post-build, default-value=0  # This parameter defines the order in which channels are arranged in the job.
          reference SpiChannelAssignment: post-build-variant-value=true, set at link in variant link-time / pre-compile in variant pre-compile / post-build in variant post-build, destination=SpiChannel  # One assignment contains multiple channels.
    container SpiGeneral [0..1]  # The general configuration settings for SPI processors are described here.
      boolean SpiDevErrorDetect: set at pre-compile, default-value=true  # Control the opening or closing of development error detection and notification.
      boolean SpiMulticoreSupport: origin=HOBOT, set at pre-compile, default-value=false  # When the SpiMulticoreEnable parameter is enabled, the SPI driver will adopt multi-core features. This means mapping SPI drivers to multiple ECUC partitions, making module APIs available in these partitions. The SPI driver will run as an independent instance in each partition.
      boolean SpiGlobalDmaEnable: origin=HOBOT, set at pre-compile, default-value=false  # Enabling this option allows the use of DMA modules during data transmission. For each SPI unit, FIFO or DMA can be selected as the transmission method. If not enabled, all SPI units default to FIFO mode for data transmission. This is a parameter that needs to be considered during implementation.
      boolean SpiHwStatusApi: set at pre-compile, default-value=true  # Control the turning on or off of the Spi_GetHWUnitStatus function.
      boolean SpiCancelApi: set at pre-compile, default-value=true  # Control the turning on or off of the Spi_cancel function.
      boolean SpiVersionInfoApi: set at pre-compile, default-value=true  # Control the turning on or off of the Spi_GetVersionInfo function.
      float SpiMainFunctionPeriod [0..1]: 1.0E-7..1.0, multiplicity set at pre-compile, set at pre-compile, default-value=0.01  # This parameter specifies the cycle time (in seconds) of the Spi-MainFunction_Handling function. This parameter, although defined by the driver, is intended for use by the upper layer.
      integer SpiTransmitTimeout: 1..900000, origin=HOBOT, set at pre-compile, default-value=50000  # Set the timeout (in microseconds) for waiting for a frame of data to be transmitted through TX/RX. This timeout value should exceed the time required to transmit one frame of data, and its accuracy is low. It is a parameter in the implementation process. If the transmission cannot be completed within the set timeout, it will result in transmission failure.
      enumeration SpiTimeoutMethod: {OSHAL_PLACEHOLDER, OSHAL_HORIZON, OSHAL_EXTERNAL}, origin=HOBOT, set at pre-compile, default-value=OSIF_COUNTER_DUMMY  # SpiTimeoutMethod is used to select the timeout handling method, which will determine which timeout handling mechanism the driver uses in OsIf. When selecting SystemTimer or CustomimTimer, please confirm that the corresponding timer has been enabled in the OsIf configuration. This is a specific parameter for implementation.
      boolean SpiInterruptibleSeqAllowed: set at pre-compile, default-value=false  # Control the opening or closing of the interruptible sequence processing function.
      boolean SpiSupportConcurrentSyncTransmit: set at pre-compile, default-value=false  # Specify the configurability of concurrent Spi_SyncTransmit() calls on different sequences.
      integer SpiLevelDelivered: 0..2, set at pre-compile, default-value=2  # Determine the level of expandable functionality provided and available by SPI handlers/drivers. Note: Level 0 is limited to simple synchronization behavior only; Level 1 basic asynchronous behavior; Level 2 reinforcement behavior.
      integer SpiChannelBuffersAllowed: 0..2, set at pre-compile, default-value=0  # Determine the channel buffer usage allowed and provided by SPI handlers/drivers. Note: 0- Only internal buffers (IB) are allowed; 1- Only allow external buffer (EB); 2- Allow internal (IB) and external (EB) buffers.
      reference SpiClockRef: origin=HOBOT, post-build-variant-value=true, set at link in variant link-time / pre-compile in variant pre-compile / post-build in variant post-build, destination=McuRfclkSettingConf  # In MCU driver configuration, the setting of the SPI clock source is used to determine the baud rate of the SPI.
      reference SpiKernelEcucPartitionRef [0..1]: scope=ECU, multiplicity set at pre-compile, post-build-variant-multiplicity=true, post-build-variant-value=true, set at pre-compile, destination=EcucPartition  # ECUC_Spi_00245 allows mapping the Spi kernel to a maximum of one ECUC partition, allowing the driver kernel to be assigned to a specific kernel. This is to make the mapping of SPI drivers more flexible in the implementation of multi-core type II.
      reference SpiEcucPartitionRef [0..*]: scope=ECU, multiplicity set at pre-compile, post-build-variant-multiplicity=true, post-build-variant-value=true, set at pre-compile, destination=EcucPartition  # ECUC_Spi_00244 describes the number of ECUC partitions that Spi drivers can be mapped to in order to use driver APIs in specific partitions.
      container SpiPhyUnit [1..*]: multiplicity set at pre-compile  # Implement specific containers for mapping logical SPI buses to physical SPI buses.
        enumeration SpiPhyUnitMapping: {SPI_0, SPI_1, SPI_2, SPI_3, SPI_4, SPI_5}, origin=HOBOT, set at pre-compile, default-value=SPI_0  # Depending on the chip version, map the logical SpiHWunit to the physical SPI_ [0 | 1 | 2 | 3 | 4], depending on the number of units present in the chip. This is a parameter that needs to be considered during implementation.
        enumeration SpiPhyUnitMode: {SPI_MASTER, SPI_SLAVE}, origin=HOBOT, set at pre-compile, default-value=SPI_MASTER  # Provide options for selecting SPI-MASTER mode and SPI-SLAVE mode. SPI dependent mode is only supported when the value of SpiGeneral/SpiLevelDelivered is 1 or 2. This is a specific parameter for implementation.
        boolean SpiPhyUnitAsyncUseDma: origin=HOBOT, post-build-variant-value=true, set at pre-compile, default-value=false  # Provides an option to choose whether to use DMA's asynchronous mechanism. This is a parameter that needs to be considered during implementation.
        integer SpiSamplePoint: 0..255, origin=HOBOT, post-build-variant-value=true, set at link in variant link-time / pre-compile in variant pre-compile / post-build in variant post-build, default-value=0  # Determines the timing for the module master to sample SIN in the altered transfer format. This setting is only applicable if CPHA is set to 0 (SpiExternalDevice/SpiDataShiftEdgeSpiDataShiftEdge is TRAILING).- 0 - No protocol clock cycles delay between the SCK edge and SIN sampling- 1 - A single protocol clock cycle delay between the SCK edge and SIN sampling- n - A delay of n protocol clock cycles between the SCK edge and SIN sampling Note This parameter is specific to the implementation.
        boolean SpiTestModeEnable: origin=HOBOT, post-build-variant-value=true, set at link in variant link-time / pre-compile in variant pre-compile / post-build in variant post-build, default-value=false  # The test mode is for testing purposes only. In this mode, the output of the shift register will be fed back to the input end. This applies to serial targets and controller modes. When DWC_ssi is configured in loopback mode, external ss_in.n and ssi_clk signals must be provided because the target device cannot generate these signals in this mode. This is a parameter that needs to be considered during implementation.
        boolean SpiModifiedTransferFormatEnable: origin=HOBOT, post-build-variant-value=true, set at link in variant link-time / pre-compile in variant pre-compile / post-build in variant post-build, default-value=false  # Indicate whether the hardware unit is dedicated to the Modified SPI Transfer Format mode for communication with peripheral devices that require sampling in the later stages of the SCK cycle. When true, it is dedicated to Modified mode, and when false, it is dedicated to Classic SPI transmission format. This is a parameter that needs to be considered during implementation.
        boolean SpiPhyUnitSync: origin=HOBOT, set at pre-compile, default-value=true  # Specify whether the hardware unit is limited to synchronous transmission. When true, it indicates that only synchronous transmission is supported, while when false, it indicates that only asynchronous transmission is supported. This configuration is based on the value of SpiGeneral/SpiLevelDelivered and is a parameter that needs to be considered during implementation.
    container SpiPublishedInformation [0..1]  # A container that contains all publication information parameters related to SPI.
      integer SpiMaxHwUnit: 0..65535, set at published-information, default-value=0  # Describing the number of different SPI hardware microcontroller peripherals (units/buses) that SPI processors/driver modules can handle.
