AUTOSAR XML (schema 00049)
package /AUTOSAR_Spi/BswModuleDescriptions
  bsw module description Spi: module-id=83
    provided-entrys:
      Spi_AsyncTransmit
      Spi_Cancel
      Spi_DeInit
      Spi_GetHWUnitStatus
      Spi_GetJobResult
      Spi_GetSequenceResult
      Spi_GetStatus
      Spi_GetVersionInfo
      Spi_Init
      Spi_MainFunction_Handling
      Spi_ReadIB
      Spi_SetAsyncMode
      Spi_SetupEB
      Spi_SyncTransmit
      Spi_WriteIB
      Spi_IrqHandler_{0..5}
    bsw internal behavior InternalBehavior_0
      12 x exclusive area:
        ExclusiveZone_{00..11}
      9 x bsw called entity:
        Spi_AsyncTransmit: can-enter-exclusive-area=[ExclusiveZone_00, ExclusiveZone_01, ExclusiveZone_03, ExclusiveZone_09, ExclusiveZone_11], implemented-entry=Spi_AsyncTransmit
        Spi_Cancel: can-enter-exclusive-area=[ExclusiveZone_02, ExclusiveZone_10], implemented-entry=Spi_Cancel
        Spi_DeInit: implemented-entry=Spi_DeInit
        Spi_GetHWUnitStatus: implemented-entry=Spi_GetHWUnitStatus
        Spi_GetJobResult: implemented-entry=Spi_GetJobResult
        Spi_GetSequenceResult: implemented-entry=Spi_GetSequenceResult
        Spi_GetStatus: implemented-entry=Spi_GetStatus
        Spi_GetVersionInfo: implemented-entry=Spi_GetVersionInfo
        Spi_Init: implemented-entry=Spi_Init
      bsw schedulable entity Spi_MainFunction_Handling: implemented-entry=Spi_MainFunction_Handling
      5 x bsw called entity:
        Spi_ReadIB: implemented-entry=Spi_ReadIB
        Spi_SetAsyncMode: implemented-entry=Spi_SetAsyncMode
        Spi_SetupEB: can-enter-exclusive-area=ExclusiveZone_05, implemented-entry=Spi_SetupEB
        Spi_SyncTransmit: can-enter-exclusive-area=[ExclusiveZone_06, ExclusiveZone_07, ExclusiveZone_08], implemented-entry=Spi_SyncTransmit
        Spi_WriteIB: can-enter-exclusive-area=ExclusiveZone_04, implemented-entry=Spi_WriteIB
      6 x bsw interrupt entity, all with can-enter-exclusive-area=ExclusiveZone_02, interrupt-category=CAT-2, interrupt-source=Hardware:
        Spi_IrqHandler_{0..5}: implemented-entry=Spi_IrqHandler_{0..5}
      bsw timing event Spi_TimingEvent_MainFunction_Handling: starts-on-event=Spi_MainFunction_Handling
package /AUTOSAR_Spi/BswModuleEntrys
  21 x bsw module entry, all with sw-service-impl-policy=STANDARD:
    Spi_AsyncTransmit: service-id=0x03, is-reentrant=true, is-synchronous=false, call-type=REGULAR, execution-context=UNSPECIFIED
    Spi_Cancel: service-id=0x0c, is-reentrant=true, is-synchronous=false, call-type=REGULAR, execution-context=UNSPECIFIED
    Spi_DeInit: service-id=0x01, is-reentrant=false, is-synchronous=true, call-type=REGULAR, execution-context=UNSPECIFIED
    Spi_GetHWUnitStatus: service-id=0x0b, is-reentrant=true, is-synchronous=true, call-type=REGULAR, execution-context=UNSPECIFIED
    Spi_GetJobResult: service-id=0x07, is-reentrant=true, is-synchronous=true, call-type=REGULAR, execution-context=UNSPECIFIED
    Spi_GetSequenceResult: service-id=0x08, is-reentrant=true, is-synchronous=true, call-type=REGULAR, execution-context=UNSPECIFIED
    Spi_GetStatus: service-id=0x06, is-reentrant=true, is-synchronous=true, call-type=REGULAR, execution-context=UNSPECIFIED
    Spi_GetVersionInfo: service-id=0x09, is-reentrant=true, is-synchronous=true, call-type=REGULAR, execution-context=UNSPECIFIED
    Spi_Init: service-id=0x00, is-reentrant=false, is-synchronous=true, call-type=REGULAR, execution-context=UNSPECIFIED
    Spi_MainFunction_Handling: service-id=0x10, is-reentrant=false, is-synchronous=true, call-type=SCHEDULED, execution-context=TASK
    Spi_ReadIB: service-id=0x04, is-reentrant=true, is-synchronous=true, call-type=REGULAR, execution-context=UNSPECIFIED
    Spi_SetAsyncMode: service-id=0x0d, is-reentrant=false, is-synchronous=true, call-type=REGULAR, execution-context=UNSPECIFIED
    Spi_SetupEB: service-id=0x05, is-reentrant=true, is-synchronous=true, call-type=REGULAR, execution-context=UNSPECIFIED
    Spi_SyncTransmit: service-id=0x0a, is-reentrant=true, is-synchronous=false, call-type=REGULAR, execution-context=UNSPECIFIED
    Spi_WriteIB: service-id=0x02, is-reentrant=true, is-synchronous=true, call-type=REGULAR, execution-context=UNSPECIFIED
    Spi_IrqHandler_{0..2}: service-id=0, is-reentrant=false, is-synchronous=true, call-type=INTERRUPT, execution-context=INTERRUPT-CAT-2
    Spi_Ip_SPI_3_IRQHandler: service-id=0, is-reentrant=false, is-synchronous=true, call-type=INTERRUPT, execution-context=INTERRUPT-CAT-2
    Spi_IrqHandler_3: service-id=0, is-reentrant=false, is-synchronous=true, call-type=INTERRUPT, execution-context=INTERRUPT-CAT-2
    Spi_IrqHandler_4: service-id=0, is-reentrant=false, is-synchronous=true, call-type=INTERRUPT, execution-context=INTERRUPT-CAT-2
package /Spi/Implementations
  bsw implementation BswImplementation_0: sw-version=1.0.0, vendor-id=189, ar-release-version=4.4.0, behavior=InternalBehavior_0, vendor-specific-module-def=Spi
    resource consumption ResourceConsumption
      7 x memory section, all with alignment=UNSPECIFIED:
        SPI_CODE: sw-addrmethod=CODE, symbol=CODE
        SPI_CONFIG_DATA_UNSPECIFIED: sw-addrmethod=CONFIG_DATA, symbol=CONFIG_DATA_UNSPECIFIED
        SPI_CONST_UNSPECIFIED: sw-addrmethod=CONST, symbol=CONST_UNSPECIFIED
        SPI_VAR_CLEARED_UNSPECIFIED: sw-addrmethod=VAR_CLEARED, symbol=VAR_CLEARED_UNSPECIFIED
        SPI_VAR_CLEARED_UNSPECIFIED_NO_CACHEABLE: sw-addrmethod=VAR_CLEARED, symbol=VAR_CLEARED_UNSPECIFIED_NO_CACHEABLE
        SPI_VAR_INIT_UNSPECIFIED: sw-addrmethod=VAR_INIT, symbol=VAR_INIT_UNSPECIFIED
        SPI_VAR_INIT_UNSPECIFIED_NO_CACHEABLE: sw-addrmethod=VAR_INIT, symbol=VAR_INIT_UNSPECIFIED_NO_CACHEABLE
