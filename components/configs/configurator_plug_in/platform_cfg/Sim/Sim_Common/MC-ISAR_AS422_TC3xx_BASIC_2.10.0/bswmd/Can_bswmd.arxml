AUTOSAR XML (schema 4-2-2)
package /AURIX2G/EcucDefs
  module definition Can [0..1]: post-build-variant-support=true, refined-module-def=Can, variants post-build  # This container holds the configuration of a single CAN Driver.
    container CanConfigSet  # This container contains the configuration parameters and sub containers of the AUTOSAR CAN module.
      container CanController [1..12]: multiplicity set at pre-compile  # This container contains the configuration parameters of the CAN controller(s).
        enumeration CanBusoffProcessing: {INTERRUPT, POLLING}, set at pre-compile, default-value=INTERRUPT  # Enables / disables API Can_MainFunction_BusOff() for handling busoff events in polling mode.
        boolean CanControllerActivation: set at pre-compile, default-value=true  # Defines if a CAN controller is used in the configuration.
        boolean CanControllerLoopbackEnable: origin=INFINEON_AURIX2G, set at pre-compile, default-value=false  # This parameter specifies whether to use CAN internal bus or external bus.If this parameter is enabled, it will use internal bus.
        enumeration CanRxInputSelection: {CANxx_RXDA, CANxx_RXDB, CANxx_RXDC, CANxx_RXDD, CANxx_RXDE, CANxx_RXDF, CANxx_RXDG, CANxx_RXDH}, origin=INFINEON_AURIX2G, set at pre-compile, default-value=CANxx_RXDA  # Provides alternate Pin selection for CAN Node Receive input line.
        integer CanControllerBaseAddress: 0..4294967295, set at pre-compile, default-value=4028662016  # Specifies the CAN controller base address.
        integer CanControllerId: 0..11, scope=ECU, set at pre-compile, symbolic-name-value=true, default-value=0  # This parameter provides the controller ID which is unique in a given CAN Driver. The value for this parameter starts with 0 and continue without any gaps.
        enumeration CanRxProcessing: {INTERRUPT, MIXED, POLLING}, set at pre-compile, default-value=INTERRUPT  # Enables / disables API Can_MainFunction_Read() for handling PDU reception events in polling mode.
        enumeration CanTxProcessing: {INTERRUPT, POLLING, MIXED}, set at pre-compile, default-value=INTERRUPT  # Enables / disables API Can_MainFunction_Write() for handling PDU transmission events in polling mode.
        boolean CanWakeupFunctionalityAPI: set at pre-compile, default-value=false  # Adds / removes the service Can_CheckWakeup() from the code.
        enumeration CanWakeupProcessing: {INTERRUPT, POLLING}, set at pre-compile, default-value=INTERRUPT  # Enables / disables API Can_MainFunction_Wakeup() for handling wakeup events in polling mode.
        boolean CanWakeupSupport: set at pre-compile, default-value=false  # CAN driver support for wakeup over CAN Bus.
        reference CanControllerDefaultBaudrate: post-build-variant-value=true, set at post-build, destination=CanControllerBaudrateConfig  # Reference to baudrate configuration container configured for the CAN Controller.
        reference CanCpuClockRef: set at pre-compile, destination=McuClockReferencePoint  # Reference to the CPU clock configuration, which is set in the MCU driver configuration
        reference CanPeripheralBusClockRef: origin=INFINEON_AURIX2G, set at pre-compile, destination=McuClockReferencePointConfig  # Reference to the CPU peripheral bus clock configuration, which is set in the MCU driver configuration
        symbolic name reference CanWakeupSourceRef [0..1]: multiplicity set at pre-compile, set at pre-compile, destination=EcuMWakeupSource  # This parameter contains a reference to the Wakeup Source for this controller as defined in the ECU State Manager.
        container CanControllerBaudrateConfig [1..65535]: multiplicity set at post-build  # This container contains bit timing related configuration parameters of the CAN controller(s).
          integer CanControllerBaudRate: 40..1000, post-build-variant-value=true, set at post-build, default-value=500  # Specifies the baudrate of the controller in kbps.
          integer CanControllerBaudRateConfigID: 0..65535, scope=ECU, post-build-variant-value=true, set at post-build, default-value=0  # Uniquely identifies a specific baud rate configuration. This ID is used by SetBaudrate API.
          integer CanControllerPropSeg: 1..255, post-build-variant-value=true, set at post-build, default-value=47  # Specifies propagation delay in time quantas.
          integer CanControllerSeg1: 1..255, post-build-variant-value=true, set at post-build, default-value=16  # Specifies phase segment 1 in time quantas.
          integer CanControllerSeg2: 2..128, post-build-variant-value=true, set at post-build, default-value=16  # Specifies phase segment 2 in time quantas.
          integer CanControllerSyncJumpWidth: 1..128, post-build-variant-value=true, set at post-build, default-value=4  # Specifies the synchronization jump width for the controller in time quantas.
          container CanControllerFdBaudrateConfig [0..1]: multiplicity set at post-build  # This optional container contains bit timing related configuration parameters of the CAN controller(s) for payload and CRC of a CAN FD frame. If this container exists the controller supports CAN FD frames.
            integer CanControllerFdBaudRate: 40..5000, post-build-variant-value=true, set at post-build, default-value=2500  # Specifies the data segment baud rate of the controller in kbps.
            integer CanControllerPropSeg: 0..31, post-build-variant-value=true, set at post-build, default-value=1  # Specifies propagation delay in time quantas.
            integer CanControllerSeg1: 1..32, post-build-variant-value=true, set at post-build, default-value=2  # Specifies phase segment 1 in time quantas.
            integer CanControllerSeg2: 1..16, post-build-variant-value=true, set at post-build, default-value=1  # Specifies phase segment 2 in time quantas.
            integer CanControllerSyncJumpWidth: 1..16, post-build-variant-value=true, set at post-build, default-value=1  # Specifies the synchronization jump width for the controller in time quantas.
            integer CanControllerTrcvDelayCompensationOffset [0..1]: 0..65535, multiplicity set at post-build, post-build-variant-multiplicity=true, post-build-variant-value=true, set at post-build, default-value=0  # Specifies the Transceiver Delay Compensation Offset in ns. If not specified Transceiver Delay Compensation is disabled.
            boolean CanControllerTxBitRateSwitch: post-build-variant-value=true, set at post-build, default-value=true  # Specifies if the bit rate switching shall be used for transmissions.
        container CanTTController [0..1]: multiplicity set at pre-compile  # CanTTController is specified in the SWS TTCAN and contains the configuration parameters of the TTCAN controller(s) (which are needed in addition to the configuration parameters of the CAN controller(s)).
          integer CanTTControllerApplWatchdogLimit: 0..255, scope=ECU, post-build-variant-value=true, set at post-build, default-value=0  # Defines the maximum time period (unit is 256 times NTU) after which the application has to serve the watchdog.
          integer CanTTControllerCycleCountMax: 0..63, scope=ECU, post-build-variant-value=true, set at post-build, default-value=0  # Defines the value for cycle_count_max.
          integer CanTTControllerExpectedTxTrigger: 0..255, post-build-variant-value=true, set at post-build, default-value=0  # Number of expected_tx_trigger.
          boolean CanTTControllerExternalClockSynchronisation: scope=ECU, post-build-variant-value=true, set at post-build, default-value=false  # Enables/disables the external clock synchronization.
          boolean CanTTControllerGlobalTimeFiltering: post-build-variant-value=true, set at post-build, default-value=false  # Enables/disables the global time filtering.
          integer CanTTControllerInitialRefOffset: 0..127, scope=ECU, post-build-variant-value=true, set at post-build, default-value=0  # Defines the initial value for ref trigger offset.
          integer CanTTControllerInterruptEnable: 0..1023, post-build-variant-value=true, set at post-build, default-value=0  # Enables/disables the respective interrupts.
          boolean CanTTControllerLevel2: post-build-variant-value=true, set at post-build, default-value=false  # Defines whether Level 2 or Level 1 is used.
          float CanTTControllerNTUConfig: 0.0..100.0, scope=ECU, post-build-variant-value=true, set at post-build, default-value=0.0  # Defines the config value for NTU (network time unit).
          enumeration CanTTControllerOperationMode: {CAN_TT_EVENT_SYNC_TIME_TRIGGERED, CAN_TT_EVENT_TRIGGERED, CAN_TT_TIME_TRIGGERED}, scope=ECU, post-build-variant-value=true, set at post-build, default-value=CAN_TT_TIME_TRIGGERED  # Defines the operation mode.
          float CanTTControllerSyncDeviation: 0.0..100.0, post-build-variant-value=true, set at post-build, default-value=0.0  # Defines the maximum synchronization deviation:
          boolean CanTTControllerTURRestore: post-build-variant-value=true, set at post-build, default-value=false  # Enables/disables the TUR restore.
          boolean CanTTControllerTimeMaster: scope=ECU, post-build-variant-value=true, set at post-build, default-value=false  # Defines whether the controller acts as a potential time master.
          integer CanTTControllerTimeMasterPriority: 0..7, scope=ECU, post-build-variant-value=true, set at post-build, default-value=0  # Defines the time master priority.
          integer CanTTControllerTxEnableWindowLength: 1..16, scope=ECU, post-build-variant-value=true, set at post-build, default-value=1  # Length of the tx enable window given in CAN bit times.
          integer CanTTControllerWatchTriggerGapTimeMark: 0..65535, post-build-variant-value=true, set at post-build, default-value=0  # watch trigger time mark after a gap
          integer CanTTControllerWatchTriggerTimeMark: 0..65535, post-build-variant-value=true, set at post-build, default-value=0  # watch trigger time mark
          enumeration CanTTIRQProcessing: {INTERRUPT, POLLING}, scope=ECU, post-build-variant-value=true, set at post-build, default-value=INTERRUPT  # Enables / disables API Can_MainFunction_BusOff() for handling busoff events in polling mode.
      container CanHardwareObject [1..1176]: multiplicity set at pre-compile  # This container contains the configuration (parameters) of CAN Hardware Objects.
        integer CanFdPaddingValue [0..1]: 0..255, scope=ECU, multiplicity set at post-build, post-build-variant-multiplicity=true, post-build-variant-value=true, set at post-build, default-value=0  # Specifies the value which is used to pad unspecified data in CAN FD frames > 8 bytes for transmission. This is necessary due to the discrete possible values of the DLC if > 8 bytes.
        enumeration CanHandleType: {BASIC, FULL}, scope=ECU, post-build-variant-value=true, set at post-build, default-value=FULL  # Specifies the type (Full-CAN or Basic-CAN) of a hardware object.
        boolean CanHardwareObjectUsesPolling [0..1]: multiplicity set at pre-compile, origin=INFINEON_AURIX2G, set at pre-compile, default-value=false  # Enables polling of this hardware object.
        integer CanHwObjectCount: 1..64, scope=ECU, post-build-variant-value=true, set at post-build, default-value=1  # Number of hardware objects used to implement one HOH. In case of a HRH this parameter defines the number of elements in the hardware FIFO or the number of shadow buffers, in case of a HTH it defines the number of hardware objects used for multiplexed transmission or for a hardware FIFO used by a FullCAN HTH.
        integer CanHwFIFOThreshold: 1..64, scope=ECU, origin=INFINEON_AURIX2G, post-build-variant-value=true, set at post-build, default-value=1  # Specifies the threshold size of Rx FIFO buffer at which interrupt is triggered to copy the data.
        enumeration CanIdType: {EXTENDED, MIXED, STANDARD}, scope=ECU, post-build-variant-value=true, set at post-build, default-value=STANDARD  # Specifies whether the IdValue is of type
        integer CanObjectId: 0..1175, scope=ECU, set at pre-compile, symbolic-name-value=true, default-value=0  # Holds the handle ID of HRH or HTH. The value of this parameter is unique in a given CAN Driver, and it should start with 0 and continue without any gaps.
        enumeration CanObjectType: {RECEIVE, TRANSMIT}, scope=ECU, post-build-variant-value=true, set at post-build, default-value=RECEIVE  # Specifies if the HardwareObject is used as Transmit or as Receive object
        boolean CanTriggerTransmitEnable [0..1]: scope=ECU, multiplicity set at pre-compile, set at pre-compile, default-value=false  # This parameter defines if or if not CAN supports the trigger-transmit API for this handle.
        reference CanControllerRef: post-build-variant-value=true, set at post-build, destination=CanController  # Reference to CAN Controller to which the HOH is associated to.
        reference CanMainFunctionRWPeriodRef [0..1]: multiplicity set at post-build, post-build-variant-multiplicity=true, post-build-variant-value=true, set at post-build, destination=CanMainFunctionRWPeriods  # Reference to CanMainFunctionPeriod
        container CanHwFilter [0..128]: multiplicity set at post-build  # This container is only valid for HRHs and contains the configuration (parameters) of one hardware filter.
          integer CanHwFilterCode: 0..4294967295, post-build-variant-value=true, set at post-build, default-value=2047  # Specifies (together with the filter mask) the identifiers range that passes the hardware filter.
          integer CanHwFilterMask: 0..4294967295, post-build-variant-value=true, set at post-build, default-value=2047  # Describes a mask for hardware-based filtering of CAN identifiers. The CAN identifiers of incoming messages are masked with the appropriate CanFilterMaskValue. Bits holding a 0 mean don't care, i.e. do not compare the message's identifier in the respective bit position. The CanHwFilterMask shall be applicable only in the case of an Rx FiFo being used (i.e. CanHwObjectCount vale greater than 1), in the case of dedicated Rx filter Range filtering is not applicable.
        container CanTTHardwareObjectTrigger [0..*]: multiplicity set at pre-compile  # CanTTHardwareObjectTrigger is specified in the SWS TTCAN and contains the configuration (parameters) of TTCAN triggers for Hardware Objects, which are additional to the configuration (parameters) of CAN Hardware Objects.
          integer CanTTHardwareObjectBaseCycle: 0..63, scope=ECU, post-build-variant-value=true, set at post-build, default-value=0  # Defines the cycle_offset.
          integer CanTTHardwareObjectCycleRepetition: 1..64, scope=ECU, post-build-variant-value=true, set at post-build, default-value=1  # Defines the repeat_factor.
          integer CanTTHardwareObjectTimeMark: 0..65535, post-build-variant-value=true, set at post-build, default-value=0  # Defines the point in time, when the trigger will be activated.
          integer CanTTHardwareObjectTriggerId: 0..63, set at pre-compile, symbolic-name-value=true, default-value=0  # Sequential number which allows separation of different TTCAN triggers configured for one and the same hardware object.
          enumeration CanTTHardwareObjectTriggerType: {CAN_TT_RX_TRIGGER, CAN_TT_TX_REF_TRIGGER, CAN_TT_TX_REF_TRIGGER_GAP, CAN_TT_TX_TRIGGER_EXCLUSIVE, CAN_TT_TX_TRIGGER_MERGED, CAN_TT_TX_TRIGGER_SINGLE}, post-build-variant-value=true, set at post-build, default-value=CAN_TT_RX_TRIGGER  # Defines the type of the trigger associated with the hardware object. This parameter depends on plain CAN parameter CAN_OBJECT_TYPE.
      container CanIcom [0..1]: multiplicity set at pre-compile  # This container contains the parameters for configuring pretended networking
        container CanIcomConfig [1..255]: multiplicity set at pre-compile  # This container contains the configuration parameters of the ICOM Configuration.
          integer CanIcomConfigId: 1..255, scope=ECU, set at pre-compile, default-value=2  # This parameter identifies the ID of the ICOM configuration.
          boolean CanIcomWakeOnBusOff: scope=ECU, set at pre-compile, default-value=true  # This parameter defines that the MCU shall wake if the bus off is detected or not.
          container CanIcomWakeupCauses  # This container contains the configuration parameters of the wakeup causes to leave the power saving mode.
            container CanIcomRxMessage [1..*]: multiplicity set at pre-compile  # This container contains the configuration parameters for the wakeup causes for matching received messages. It has to be configured as often as received messages are defined as wakeup cause.
              integer CanIcomCounterValue [0..1]: 1..65536, scope=ECU, multiplicity set at pre-compile, set at pre-compile, default-value=1  # This parameter defines that the MCU shall wake if the message with the ID is received n times on the communication channel.
              integer CanIcomMessageId: 0..536870912, scope=ECU, set at pre-compile, default-value=0  # This parameter defines the message ID the wakeup causes of this CanIcomRxMessage are configured for. In addition a mask (CanIcomMessageIdMask) can be defined, in that case it is possible to define a range of rx messages, which can create a wakeup condition.
              integer CanIcomMessageIdMask [0..1]: 0..536870912, scope=ECU, multiplicity set at pre-compile, set at pre-compile, default-value=0  # Describes a mask for filtering of CAN identifiers. The CAN identifiers of incoming messages are masked with this CanIcomMessageIdMask. If the masked identifier matches the masked value of CanIcomMessageId, it can create a wakeup condition for this CanIcomRxMessage. Bits holding a 0 mean dont care, i.e. do not compare the message identifier in the respective bit position. The mask shall be build by filling with leading 0.
              float CanIcomMissingMessageTimerValue [0..1]: 1.0E-6..65.535, scope=ECU, multiplicity set at pre-compile, set at pre-compile, default-value=1.0  # This parameter defines that the MCU shall wake if the message with the ID is not received for a specific time in s on the
              integer CanIcomPayloadLength: 1..8, scope=ECU, origin=INFINEON_AURIX2G, set at pre-compile, default-value=1  # Number of hardware objects used to implement one HOH. In case of a HRH this parameter defines the number of elements in the hardware FIFO or the number of shadow buffers, in case of a HTH it defines the number of hardware objects used for multiplexed transmission or for a hardware FIFO used by a FullCAN HTH.
              boolean CanIcomPayloadLengthError: scope=ECU, set at pre-compile, default-value=false  # This parameter defines that the MCU shall wake if a payload error occurs
              container CanIcomRxMessageSignalConfig [0..*]: multiplicity set at pre-compile  # This container contains the configuration parameters for the wakeup causes for matching signals.
                integer CanIcomSignalMask: 0..9223372036854775807, set at pre-compile, default-value=0  # This parameter shall be used to mask a signal in the payload of a CAN message.
                integer CanIcomSignalMaskUpper32bits: 0..4294967295, origin=INFINEON_AURIX2G, set at pre-compile, default-value=4294967295  # This parameter shall be used to configure the upper32 bit value of Autosar parameter CanIcomSignalMask.
                integer CanIcomSignalMaskLower32bits: 0..4294967295, origin=INFINEON_AURIX2G, set at pre-compile, default-value=4294967295  # This parameter shall be used to configure the lower32 bit value of Autosar parameter CanIcomSignalMask.
                enumeration CanIcomSignalOperation: {AND, EQUAL, GREATER, SMALLER, XOR}, scope=ECU, set at pre-compile, default-value=EQUAL  # This parameter defines the operation, which shall be used to verify the signal value creates a wakeup condition.
                integer CanIcomSignalValue: 0..9223372036854775807, set at pre-compile, default-value=0  # This parameter shall be used to define a signal value which shall be compared (CanIcomSignalOperation) with the masked CanIcomSignalMask value of the received signal (CanIcomSignalRef). This parameter shall be checked only till the payload length that is configured. In case of payload length being lesser than the signal value only the payload length number of bytes shall be used for comparison. In case of payload length greater than the signal value the rest of the bytes shall be checked against non- zero value.
                integer CanIcomSignalValueUpper32bits: 0..4294967295, origin=INFINEON_AURIX2G, set at pre-compile, default-value=4294967295  # This parameter shall be used to define the upper 32 bit value of Autosar parameter CanIcomSignalValue which shall be compared (CanIcomSignalOperation) with the masked CanIcomSignalMask value of the received signal (CanIcomSignalRef).This parameter shall be checked only till the payload length that is configured. In case of payload length being lesser than the signal value only the payload length number of bytes shall be used for comparison. In case of payload length greater than the signal value the rest of the bytes shall be checked against non- zero value.
                integer CanIcomSignalValueLower32bits: 0..4294967295, origin=INFINEON_AURIX2G, set at pre-compile, default-value=4294967295  # This parameter shall be used to define the lower 32 bit value of Autosar parameter CanIcomSignalValue which shall be compared (CanIcomSignalOperation) with the masked CanIcomSignalMask value of the received signal (CanIcomSignalRef).This parameter shall be checked only till the payload length that is configured. In case of payload length being lesser than the signal value only the payload length number of bytes shall be used for comparison. In case of payload length greater than the signal value the rest of the bytes shall be checked against non- zero value.
                reference CanIcomSignalRef [0..1]: scope=ECU, multiplicity set at pre-compile, set at pre-compile, destination=ComSignal  # This parameter defines a reference to the signal which shall be checked additional to the message id (CanIcomMessageId).
    container CanGeneral  # This container contains the parameters related each CAN Driver Unit.
      boolean CanDevErrorDetection: set at pre-compile, default-value=false  # Switches the Default Error Tracer (Det) detection and notification ON or OFF.
      enumeration CanInitDeInitApiMode: {CAN_17_MCMCAN_MCAL_USER1, CAN_17_MCMCAN_MCAL_SUPERVISOR}, scope=ECU, origin=INFINEON_AURIX2G, set at pre-compile, default-value=CAN_17_MCMCAN_MCAL_SUPERVISOR  # This configuration parameter defines the mode in which the CAN Init and CAN DeInit API will be used.
      boolean CanMultiCoreErrorDetect: origin=INFINEON_AURIX2G, set at pre-compile, default-value=false  # Switches the Multicore Default Error Tracer (Det) detection and notification ON or OFF.
      integer CanIndex: 0..255, set at pre-compile, default-value=0  # Specifies the InstanceId of this module instance. If only one instance is present it shall have the Id 0.
      function name CanLPduReceiveCalloutFunction [0..1]: multiplicity set at pre-compile, set at pre-compile, default-value=NULL  # This parameter defines the existence and the name of a callout function that is called after a successful
      enumeration CanVersion: {AUTOSAR_VERSION_421, AUTOSAR_VERSION_431, AUTOSAR_VERSION_403}, set at pre-compile, default-value=AUTOSAR_VERSION_421
      float CanMainFunctionBusoffPeriod [0..1]: 0.001..65.535, multiplicity set at pre-compile, set at pre-compile, default-value=0.005  # This parameter describes the period for cyclic call to Can_MainFunction_Busoff. Unit is seconds.
      float CanMainFunctionModePeriod: 0.001..65.535, set at pre-compile, default-value=0.005  # This parameter describes the period for cyclic call to Can_MainFunction_Mode. Unit is seconds.
      float CanMainFunctionWakeupPeriod [0..1]: 0.001..65.535, multiplicity set at pre-compile, set at pre-compile, default-value=0.005  # This parameter describes the period for cyclic call to Can_MainFunction_Wakeup. Unit is seconds.
      boolean CanMultiplexedTransmission: scope=ECU, set at pre-compile, default-value=false  # Specifies if multiplexed transmission shall be supported.ON or OFF
      boolean CanPublicIcomSupport: scope=ECU, set at pre-compile, default-value=false  # Selects support of Pretended Network features in Can driver.
      boolean CanSetBaudrateApi [0..1]: scope=ECU, multiplicity set at pre-compile, set at pre-compile, default-value=false  # The support of the Can_SetBaudrate API is optional.
      float CanTimeoutDuration: 1.0E-6..65.535, set at pre-compile, default-value=0.001  # Specifies the maximum time for blocking function until a timeout is detected. Unit is seconds.
      boolean CanVersionInfoApi: set at pre-compile, default-value=false  # Switches the Can_GetVersionInfo() API ON or OFF.
      boolean CanDeInitApi: origin=INFINEON_AURIX2G, set at pre-compile, default-value=false  # Switches the Can_DeInit() API ON or OFF.
      boolean CanRunTimeErrorDetect: origin=INFINEON_AURIX2G, set at pre-compile, default-value=true  # Switches the Runtime Error detection (RTE) and notification ON or OFF.
      reference CanOsCounterRef [0..1]: multiplicity set at pre-compile, set at pre-compile, destination=OsCounter  # This parameter contains a reference to the OsCounter, which is used by the CAN driver.
      reference CanSupportTTCANRef: scope=ECU, set at pre-compile, destination=CanIfPrivateCfg  # The parameter refers to CanIfSupportTTCAN parameter in the CAN Interface Module configuration.
      container CanIcomGeneral [0..1]: multiplicity set at pre-compile  # This container contains the general configuration parameters of the ICOM Configuration.
        enumeration CanIcomLevel [0..1]: {CAN_ICOM_LEVEL_ONE, CAN_ICOM_LEVEL_TWO}, scope=ECU, multiplicity set at pre-compile, set at pre-compile, default-value=CAN_ICOM_LEVEL_ONE  # Defines the level of Pretended Networking.
        enumeration CanIcomVariant: {CAN_ICOM_VARIANT_HW, CAN_ICOM_VARIANT_NONE, CAN_ICOM_VARIANT_SW}, scope=ECU, set at pre-compile, default-value=CAN_ICOM_VARIANT_SW  # Defines the variant, which is supported by this CAN Controller
      container CanMainFunctionRWPeriods [0..65534]: multiplicity set at pre-compile  # This container contains the parameter for configuring the period for cyclic call to Can_MainFunction_Read or Can_MainFunction_Write depending on the referring item.
        float CanMainFunctionPeriod: 0.001..65.535, set at pre-compile, default-value=0.005  # This parameter describes the period for cyclic call to Can_MainFunction_Read or Can_MainFunction_Write depending on the referring item. Unit is seconds. Different poll-cycles will be configurable if more than one CanMainFunctionPeriod is configured. In this case multiple Can_MainFunction_Read() or Can_MainFunction_Write() will be provided by the CAN Driver module.
    container CommonPublishedInformation  # Common container, aggregated by all modules. It contains published information about vendor and versions.
      integer ArMajorVersion: 0..255, origin=INFINEON_AURIX2G, set at pre-compile, default-value=4  # Major version number of AUTOSAR specification on which the appropriate implementation is based on.
      integer ArMinorVersion: 0..255, origin=INFINEON_AURIX2G, set at pre-compile, default-value=2  # Minor version number of AUTOSAR specification on which the appropriate implementation is based on.
      integer ArPatchVersion: 0..255, origin=INFINEON_AURIX2G, set at pre-compile, default-value=2  # Patch level version number of AUTOSAR specification on which the appropriate implementation is based on.
      integer SwMajorVersion: 0..255, origin=INFINEON_AURIX2G, set at pre-compile, default-value=20  # Major version number of the vendor specific implementation of the module. The numbering is vendor specific.
      integer SwMinorVersion: 0..255, origin=INFINEON_AURIX2G, set at pre-compile, default-value=10  # Minor version number of the vendor specific implementation of the module. The numbering is vendor specific.
      integer SwPatchVersion: 0..255, origin=INFINEON_AURIX2G, set at pre-compile, default-value=0  # Patch level version number of the vendor specific implementation of the module. The numbering is vendor specific.
      integer ModuleId: 0..65535, origin=INFINEON_AURIX2G, set at pre-compile, default-value=80  # Module ID of this module from Module List.
      integer VendorId: 0..65535, origin=INFINEON_AURIX2G, set at pre-compile, default-value=17  # Vendor ID of the dedicated implementation of this module according to the AUTOSAR vendor list.
      string VendorApiInfix: origin=INFINEON_AURIX2G, set at pre-compile, default-value=McmCan  # In driver modules which can be instantiated several times on a single ECU, BSW00347 requires that the name of APIs is extended by the VendorId and a vendor specific name. This parameter is used to specify the vendor specific name. In total, the implementation specific name is generated as follows: <ModuleName>_>VendorId>_<VendorApiInfix><Api name from SWS>. E.g. assuming that the VendorId of the implementer is 123 and the implementer chose a VendorApiInfix of "v11r456" a api name Can_Write defined in the SWS will translate to Can_123_Write. This parameter is mandatory for all modules with upper multiplicity > 1. It shall not be used for modules with upper multiplicity =1..
      string Release: origin=INFINEON_AURIX2G, set at published-information, default-value=_TRICORE_TC389  # Aurix2G derivative used for the implementation
