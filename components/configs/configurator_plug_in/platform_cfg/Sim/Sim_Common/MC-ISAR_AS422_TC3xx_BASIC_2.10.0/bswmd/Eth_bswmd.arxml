AUTOSAR XML (schema 4-2-2)
package /AURIX2G/EcucDefs
  module definition Eth [0..1]: post-build-variant-support=true, refined-module-def=Eth, variants post-build  # Configuration of the Eth (Ethernet Driver) module.
    container EthConfigSet  # This container contains the configuration parameters and sub containers of the AUTOSAR Eth module.
      container EthCtrlConfig: multiplicity set at pre-compile  # Configuration of the individual controller
        integer EthCtrlIdx: 0..0, scope=ECU, set at pre-compile, symbolic-name-value=true, default-value=0  # Specifies the instance ID of the configured controller.
        enumeration EthSpeed: {ETH_10MBPS, ETH_100MBPS, ETH_1000MBPS}, origin=INFINEON_AURIX2G, post-build-variant-value=true, set at post-build, default-value=ETH_100MBPS  # This parameter selects the speed of the Ethernet controller.
        enumeration EthPhyInterface: {RMII, MII, RGMII}, origin=INFINEON_AURIX2G, post-build-variant-value=true, set at post-build, default-value=RMII  # This parameter selects the interface(MII or RMII or RGMII)between the Ethernet controller and PHY(Transceiver).
        enumeration EthOpMode: {HALFDUPLEX, FULLDUPLEX}, origin=INFINEON_AURIX2G, post-build-variant-value=true, set at post-build, default-value=FULLDUPLEX  # This parameter selects Duplex mode (Half or Full Duplex)for Ethernet bus.
        string EthCtrlPhyAddress: post-build-variant-value=true, set at post-build, default-value=00:03:19:00:00:01, max-length=17, min-length=17  # Specifies the unique 48-bit physical address (MAC address) of the controller in network byte order.
        integer EthCtrlRxBufLenByte: 0..1522, set at pre-compile, default-value=1522  # Limits the maximum receive buffer length (frame length) in bytes.
        integer EthCtrlTxBufLenByte: 0..1522, set at pre-compile, default-value=1522  # Limits the maximum transmit buffer length (frame length) in bytes.
        integer EthRxBufTotal: 0..255, set at pre-compile, default-value=4  # Configures the number of receive buffers.
        integer EthTxBufTotal: 0..255, set at pre-compile, default-value=4  # Configures the number of transmit buffers.
        enumeration EthMdioAlternateInput: {ALT0_SELECT_P00_0, ALT2_SELECT_P12_1, ALT3_SELECT_P21_3, ALT1_SELECT_NONE}, origin=INFINEON_AURIX2G, post-build-variant-value=true, set at post-build, default-value=ALT1_SELECT_NONE  # This parameter selects alternate input for MDIO Input Signal.
        enumeration EthRxclkInput: {ALT0_SELECT_P11_12, ALT1_SELECT_P11_4, ALT2_SELECT_P12_0, ALT3_SELECT_NONE}, origin=INFINEON_AURIX2G, post-build-variant-value=true, set at post-build, default-value=ALT3_SELECT_NONE  # This parameter selects alternate input for Receive Clock for MII and RGMII (RGMII can use ALT0 only).
        enumeration EthRxErrMIIInput: {ALT0_SELECT_P11_13, ALT1_SELECT_P21_7, ALT2_SELECT_P10_0, ALT3_SELECT_NONE}, origin=INFINEON_AURIX2G, post-build-variant-value=true, set at post-build, default-value=ALT3_SELECT_NONE  # This parameter selects alternate input for Receive Error for MII.
        enumeration EthCarrierSenseMIIInput: {ALT0_SELECT_P11_14, ALT1_SELECT_P11_11, ALT3_SELECT_NONE}, origin=INFINEON_AURIX2G, post-build-variant-value=true, set at post-build, default-value=ALT3_SELECT_NONE  # This parameter selects alternate input for Carrier Sense for MII.
        enumeration EthRecDataValidMIIInput: {ALT0_SELECT_P11_11, ALT1_SELECT_P11_14, ALT3_SELECT_NONE}, origin=INFINEON_AURIX2G, post-build-variant-value=true, set at post-build, default-value=ALT3_SELECT_NONE  # This parameter selects alternate input for Receive Data valid for MII.
        enumeration EthTxClockMIIInput: {ALT0_SELECT_P11_5, ALT1_SELECT_P11_12, ALT3_SELECT_NONE}, origin=INFINEON_AURIX2G, post-build-variant-value=true, set at post-build, default-value=ALT3_SELECT_NONE  # This parameter selects alternate input for Transmit clock input for MII.
        enumeration EthCollisionMII: {ALT0_SELECT_P11_15, ALT3_SELECT_NONE}, origin=INFINEON_AURIX2G, post-build-variant-value=true, set at post-build, default-value=ALT3_SELECT_NONE  # This parameter selects alternate input for Collision input for MII.
        enumeration EthRefClkRMIIInput: {ALT0_SELECT_P11_12, ALT3_SELECT_NONE}, origin=INFINEON_AURIX2G, post-build-variant-value=true, set at post-build, default-value=ALT3_SELECT_NONE  # This parameter selects alternate input for Reference clock input for RMII(50MHz).
        enumeration EthCRSDVRMIIInput: {ALT0_SELECT_P11_11, ALT1_SELECT_P11_14, ALT3_SELECT_NONE}, origin=INFINEON_AURIX2G, post-build-variant-value=true, set at post-build, default-value=ALT3_SELECT_NONE  # This parameter selects alternate input for Carrier Sense / Data Valid combi-signal for RMII.
        enumeration EthReceiveData0Input: {ALT0_SELECT_P11_10, ALT3_SELECT_NONE}, origin=INFINEON_AURIX2G, post-build-variant-value=true, set at post-build, default-value=ALT3_SELECT_NONE  # This parameter selects alternate input for Receive Data 0 for MII, RMII and RGMII (RGMII can use ALT0 only).
        enumeration EthReceiveData1Input: {ALT0_SELECT_P11_9, ALT3_SELECT_NONE}, origin=INFINEON_AURIX2G, post-build-variant-value=true, set at post-build, default-value=ALT3_SELECT_NONE  # This parameter selects alternate input for Receive Data 1 for MII, RMII and RGMII (RGMII can use ALT0 only).
        enumeration EthReceiveData2Input: {ALT0_SELECT_P11_8, ALT3_SELECT_NONE}, origin=INFINEON_AURIX2G, post-build-variant-value=true, set at post-build, default-value=ALT3_SELECT_NONE  # This parameter selects alternate input for Receive Data 2 for MII and RGMII (RGMII can use ALT0 only).
        enumeration EthReceiveData3Input: {ALT0_SELECT_P11_7, ALT3_SELECT_NONE}, origin=INFINEON_AURIX2G, post-build-variant-value=true, set at post-build, default-value=ALT3_SELECT_NONE  # This parameter selects alternate input for Receive Data 3 for MII and RGMII (RGMII can use ALT0 only).
        boolean EthCtrlEnableMii: set at pre-compile, default-value=false  # Enables / Disables Media Independent Interface (MII) for transceiver access
        boolean EthCtrlEnableRxInterrupt: set at pre-compile, default-value=false  # Enables / Disables receive interrupt
        boolean EthCtrlEnableTxInterrupt: set at pre-compile, default-value=false  # Enables / Disables transmit interrupt
        integer EthSkewTxClockDelay: 0..15, origin=INFINEON_AURIX2G, post-build-variant-value=true, set at post-build, default-value=0  # Specifies the transmit clock delay in RGMII mode for transmit skew timing.
        integer EthSkewRxClockDelay: 0..15, origin=INFINEON_AURIX2G, post-build-variant-value=true, set at post-build, default-value=0  # Specifies the receive clock delay in RGMII mode for receive skew timing.
        boolean EthCtrlEnableCrcStripping: origin=INFINEON_AURIX2G, post-build-variant-value=true, set at post-build, default-value=false  # Include or exclude the length of the checksum in the received frame length reported to upper layer.
        reference EthCoreRef: multiplicity set at pre-compile, set at pre-compile, destination=EcucCoreDefinition  # Reference to the Core Definition in the Ecuc Module where the CoreId is defined. This reference is used to describe to which Core the Eth is bound. / 概述：定义Eth模块Controller的所属核，引用EcuM模块的核定义。 注意：单个controller只允许配置在单核。
        container EthDemEventParameterRefs [0..1]: multiplicity set at pre-compile  # Container for the references to DemEventParameter elements which shall be invoked using the API Dem_ReportErrorStatus in case the corresponding error occurs. The EventId is taken from the referenced DemEventParameter's DemEventId value. The standardized errors are provided in the container and can be extended by vendor specific error references.
          symbolic name reference ETH_E_ACCESS [0..1]: multiplicity set at post-build, post-build-variant-multiplicity=true, post-build-variant-value=true, set at post-build, destination=DemEventParameter  # Reference to the DemEventParameter which shall be issued when the error "Controller access failed" has occured.
          symbolic name reference ETH_E_ALIGNMENT [0..1]: multiplicity set at post-build, post-build-variant-multiplicity=true, post-build-variant-value=true, set at post-build, destination=DemEventParameter  # Reference to the DemEventParameter which shall be issued when the error "Alignment Error" has occured.
          symbolic name reference ETH_E_CRC [0..1]: multiplicity set at post-build, post-build-variant-multiplicity=true, post-build-variant-value=true, set at post-build, destination=DemEventParameter  # Reference to the DemEventParameter which shall be issued when the error "CRC Failure" has occured.
          symbolic name reference ETH_E_LATECOLLISION [0..1]: multiplicity set at post-build, post-build-variant-multiplicity=true, post-build-variant-value=true, set at post-build, destination=DemEventParameter  # Reference to the DemEventParameter which shall be issued when the error "Late Collisions" has occured.
          symbolic name reference ETH_E_MULTIPLECOLLISION [0..1]: multiplicity set at post-build, post-build-variant-multiplicity=true, post-build-variant-value=true, set at post-build, destination=DemEventParameter  # Reference to the DemEventParameter which shall be issued when the error "Multiple Collisions" has occured.
          symbolic name reference ETH_E_OVERSIZEFRAME [0..1]: multiplicity set at post-build, post-build-variant-multiplicity=true, post-build-variant-value=true, set at post-build, destination=DemEventParameter  # Reference to the DemEventParameter which shall be issued when the error "Oversized Frame" has occured.
          symbolic name reference ETH_E_RX_FRAMES_LOST [0..1]: multiplicity set at post-build, post-build-variant-multiplicity=true, post-build-variant-value=true, set at post-build, destination=DemEventParameter  # Reference to the DemEventParameter which shall be issued when the error "receive frames lost" has occured.
          symbolic name reference ETH_E_SINGLECOLLISION [0..1]: multiplicity set at post-build, post-build-variant-multiplicity=true, post-build-variant-value=true, set at post-build, destination=DemEventParameter  # Reference to the DemEventParameter which shall be issued when the error "Single Collisions" has occured.
          symbolic name reference ETH_E_UNDERSIZEFRAME [0..1]: multiplicity set at post-build, post-build-variant-multiplicity=true, post-build-variant-value=true, set at post-build, destination=DemEventParameter  # Reference to the DemEventParameter which shall be issued when the error "Undersized Frame" has occured.
    container EthGeneral  # General configuration of Ethernet Driver module
      boolean EthDevErrorDetect: set at pre-compile, default-value=true  # Switches the Default Error Tracer (Det) detection and notification ON or OFF.
      boolean EthGetDropCountApi: set at pre-compile, default-value=false  # Enables / Disables Eth_GetDropCount API.
      boolean EthGetEtherStatsApi: set at pre-compile, default-value=false  # Enables / Disables Eth_GetEtherStats API.
      boolean EthGlobalTimeSupport: set at pre-compile, default-value=false  # Enables/Disables the GlobalTime APIs used amongst others by Global Time Synchronization over Ethernet.
      integer EthIndex: 0..255, set at pre-compile, default-value=0  # Specifies the InstanceId of this module instance. If only one instance is present it shall have the Id 0.
      float EthMainFunctionPeriod: 0.0..10.0, set at pre-compile, default-value=0.005  # Specifies the period of main function Eth_MainFunction in seconds. Ethernet driver does not require this information but the BSW scheduler.
      integer EthMaxCtrlsSupported: 1..255, set at pre-compile, default-value=1  # Limits the total number of supported controllers.
      boolean EthUpdatePhysAddrFilter: set at pre-compile, default-value=false  # Enables/Disables optional API Eth_UpdatePhysAddrFilter.
      boolean EthVersionInfoApi: set at pre-compile, default-value=false  # Enables / Disables version info API
      boolean EthMultiCoreErrorDetect: origin=INFINEON_AURIX2G, set at pre-compile, default-value=true  # Switches the Multicore error detection and notification ON or OFF.
      enumeration EthRuntimeApiMode: {ETH_MCAL_SUPERVISOR, ETH_MCAL_USER1}, origin=INFINEON_AURIX2G, set at pre-compile, default-value=ETH_MCAL_SUPERVISOR  # This parameter selects the operating modes for Ethernet driver run time
      enumeration EthInitApiMode: {ETH_MCAL_SUPERVISOR, ETH_MCAL_USER1}, origin=INFINEON_AURIX2G, set at pre-compile, default-value=ETH_MCAL_SUPERVISOR  # This parameter selects the operating modes for Ethernet driver initialization
      integer EthTimeoutCount: 100..4294967295, origin=INFINEON_AURIX2G, set at pre-compile, default-value=4294967295  # Specifies the maximum time in nanoseconds to wait for hardware timeout errors(Reported as hardware access error).
      reference EthPeripheralBusClock: origin=INFINEON_AURIX2G, set at pre-compile, destination=McuClockReferencePointConfig  # Reference to a container of MCU Clock settings, to read SPB frequency.
      reference EthOperationFrequency: origin=INFINEON_AURIX2G, set at pre-compile, destination=McuClockReferencePointConfig  # Reference to a container of the MCU Clock settings, to read Ethernet operation frequency.
      container EthCtrlOffloading  # Configuration of hardware offloading features.
        boolean EthCtrlEnableOffloadChecksumICMP: set at pre-compile, default-value=false  # Enables / Disables hardware offloading for ICMP checksums.
        boolean EthCtrlEnableOffloadChecksumIPv4: set at pre-compile, default-value=false  # Enables / Disables hardware offloading for IPv4 checksums.
        boolean EthCtrlEnableOffloadChecksumTCP: set at pre-compile, default-value=false  # Enables / Disables hardware offloading for TCP checksums.
        boolean EthCtrlEnableOffloadChecksumUDP: set at pre-compile, default-value=false  # Enables / Disables hardware offloading for UDP checksums.
    container CommonPublishedInformation  # Common container, aggregated by all modules. It contains published information about vendor and versions.
      integer ArMajorVersion: 0..255, origin=INFINEON_AURIX2G, set at published-information, default-value=4  # Major version number of AUTOSAR specification on which the appropriate implementation is based on.
      integer ArMinorVersion: 0..255, origin=INFINEON_AURIX2G, set at published-information, default-value=2  # Minor version number of AUTOSAR specification on which the appropriate implementation is based on.
      integer ArPatchVersion: 0..255, origin=INFINEON_AURIX2G, set at published-information, default-value=2  # Patch level version number of AUTOSAR specification on which the appropriate implementation is based on.
      integer SwMajorVersion: 0..255, origin=INFINEON_AURIX2G, set at published-information, default-value=10  # Major version number of the vendor specific implementation of the module. The numbering is vendor specific.
      integer SwMinorVersion: 0..255, origin=INFINEON_AURIX2G, set at published-information, default-value=40  # Minor version number of the vendor specific implementation of the module. The numbering is vendor specific.
      integer SwPatchVersion: 0..255, origin=INFINEON_AURIX2G, set at published-information, default-value=1  # Patch level version number of the vendor specific implementation of the module. The numbering is vendor specific.
      integer ModuleId: 0..65535, origin=INFINEON_AURIX2G, set at published-information, default-value=88  # Module ID of this module from Module List
      integer VendorId: 0..65535, origin=INFINEON_AURIX2G, set at published-information, default-value=17  # Vendor ID of the dedicated implementation of this module according to the AUTOSAR vendor list
      string VendorApiInfix: origin=INFINEON_AURIX2G, set at published-information, default-value=GEthMac  # In driver modules which can be instantiated several times on a single ECU, BSW00347 requires that the name of APIs is extended by the VendorId and a vendor specific name. This parameter is used to specify the vendor specific name. In total, the implementation specific name is generated as follows: <ModuleName>_>VendorId>_<VendorApiInfix><Api name from SWS>. E.g. assuming that the VendorId of the implementor is 17 and the implementer chose a VendorApiInfix of "EthMac" a api name Eth_Write defined in the SWS will translate to Eth_17_GEthMac_Write. This parameter is mandatory for all modules with upper multiplicity > 1. It shall not be used for modules with upper multiplicity =1.
      string Release: origin=INFINEON_AURIX2G, set at published-information, default-value=_TRICORE_TC389  # Aurix2G derivative used for the implementation
