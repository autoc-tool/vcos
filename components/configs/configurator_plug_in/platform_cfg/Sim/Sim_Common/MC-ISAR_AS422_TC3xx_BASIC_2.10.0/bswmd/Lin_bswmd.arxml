AUTOSAR XML (schema 4-2-2)
package /AURIX2G/EcucDefs
  module definition Lin [0..*]: post-build-variant-support=true, refined-module-def=Lin, variants post-build  # Configuration of the Lin (LIN driver) module.
    container LinDemEventParameterRefs [0..1]: multiplicity set at pre-compile  # Container for the references to DemEventParameter elements which shall be invoked using the API Dem_ReportErrorStatus API in case the corresponding error occurs. The EventId is taken from the referenced DemEventParameter's DemEventId value. The standardized errors are provided in the container and can be extended by vendor specific error references.
      symbolic name reference LIN_E_TIMEOUT [0..1]: multiplicity set at pre-compile, set at pre-compile, destination=DemEventParameter  # Reference to the DemEventParameter which shall be issued when the error "Timeout caused by hardware error" has occurred. If the reference is not configured the error shall be reported as DEM error.
    container LinGeneral  # This container contains the parameters related to each LIN Driver Unit.
      boolean LinDevErrorDetect: set at pre-compile, default-value=false  # Switches the Default Error Tracer (Det) detection and notification ON or OFF.
      boolean LinMultiCoreErrorDetect: origin=INFINEON_AURIX2G, set at pre-compile, default-value=false  # Switches the Multicore error detection and notification ON or OFF.
      integer LinIndex: 0..255, set at pre-compile, default-value=0  # Specifies the InstanceId of this module instance. If only one instance is present it shall have the Id 0.
      integer LinTimeoutDuration: 200..65535, set at pre-compile, default-value=300  # Specifies the maximum waiting time in nanoseconds for hardware timeout errors.
      boolean LinVersionInfoApi: set at pre-compile, default-value=false  # Switches the Lin_GetVersionInfo function ON or OFF.
      boolean LinHwMcuTrigSleepEnable: origin=INFINEON_AURIX2G, set at pre-compile, default-value=false  # Enable or Disable the ASCLIN module Hardware sleep upon request by setting corresponding CLC register EDIS bit.
      enumeration LinCsrClksel: {ASCLINF, ASCLINS}, origin=INFINEON_AURIX2G, set at pre-compile, default-value=ASCLINF  # This parameter selects the Baud Rate Logic Clock for the Lin Driver.
      enumeration LinInitApiMode: {LIN_MCAL_SUPERVISOR, LIN_MCAL_USER1}, origin=INFINEON_AURIX2G, set at pre-compile, default-value=LIN_MCAL_SUPERVISOR  # This parameter selects the operating modes for LIN initialization, de-initialization APIs
      boolean LinMasterInterruptEnable: origin=INFINEON_AURIX2G, set at pre-compile, default-value=true  # Specify LIN operation in interrupt enabled or interrupt disabled mode.
      reference LinSysClockRef: origin=INFINEON_AURIX2G, set at pre-compile, destination=McuClockReferencePointConfig  # This parameter refers to the system clock configured by MCU driver.This reference is used for BaudRate computation.
    container LinGlobalConfig  # This container contains the global configuration parameter of the Lin driver.
      container LinChannel [1..24]: multiplicity set at pre-compile  # This container contains the configuration (parameters) of the LIN Controller(s).
        integer LinChannelBaudRate: 1000..20000, post-build-variant-value=true, set at post-build, default-value=1000  # Specifies the baud rate of the LIN channel in bps
        integer LinChannelId: 0..65535, set at pre-compile, symbolic-name-value=true, default-value=0  # Parameter defines the numeric ID of the channel, which is the logical ID for the channel.
        boolean LinChannelWakeupSupport: set at pre-compile, default-value=false  # Specifies if the LIN hardware channel supports wake up functionality
        enumeration LinChanAssignedHw: {ASCLIN0, ASCLIN1, ASCLIN2, ASCLIN3, ASCLIN4, ASCLIN5, ASCLIN6, ASCLIN7, ASCLIN8, ASCLIN9, ASCLIN10, ASCLIN11, ASCLIN12, ASCLIN13, ASCLIN14, ASCLIN15, ASCLIN16, ASCLIN17, ASCLIN18, ASCLIN19, ASCLIN20, ASCLIN21, ASCLIN22, ASCLIN23}, origin=INFINEON_AURIX2G, set at pre-compile, default-value=ASCLIN0  # This parameter defines which ASCLIN module is selected by Lin channel
        boolean LinAutoCalcBaudParams: origin=INFINEON_AURIX2G, set at pre-compile, default-value=false  # This parameter enables or disables the automatic Baud rate parameter calculation by the configuration tool.
        integer LinChannelBaudNumerator: 1..4095, origin=INFINEON_AURIX2G, post-build-variant-value=true, set at post-build, default-value=1  # This parameter value is used to configure the BRG register NUMERATOR field.
        integer LinChannelBaudDenominator: 1..4095, origin=INFINEON_AURIX2G, post-build-variant-value=true, set at post-build, default-value=1  # This parameter value is used to configure the BRG register DENUMERATOR field.
        integer LinChannelBaudPreScalar: 0..4095, origin=INFINEON_AURIX2G, post-build-variant-value=true, set at post-build, default-value=0  # This parameter value is used to configure the BITCON register PRESCALAR field.
        integer LinInterByteSpace: 0..4, origin=INFINEON_AURIX2G, post-build-variant-value=true, set at post-build, default-value=0  # This parameter is used to configure the IDLE delay in bit times.
        enumeration LinRxAlternateInputSignal: {SELECT_A_PORT14_PIN1, SELECT_B_PORT15_PIN3, SELECT_C_PORT01_PIN8, SELECT_D_PORT33_PIN10, SELECT_E_PORT13_PIN11, SELECT_A_PORT15_PIN1, SELECT_B_PORT15_PIN5, SELECT_C_PORT20_PIN9, SELECT_D_PORT14_PIN8, SELECT_E_PORT11_PIN10, SELECT_F_PORT33_PIN13, SELECT_G_PORT02_PIN3, SELECT_A_PORT14_PIN3, SELECT_B_PORT02_PIN1, SELECT_C_PORT02_PIN10, SELECT_D_PORT10_PIN6, SELECT_E_PORT33_PIN8, SELECT_F_PORT32_PIN6, SELECT_G_PORT02_PIN0, SELECT_A_PORT15_PIN7, SELECT_B_PORT11_PIN0, SELECT_C_PORT20_PIN3, SELECT_D_PORT32_PIN2, SELECT_E_PORT00_PIN1, SELECT_F_PORT21_PIN6, SELECT_H_PORT13_PIN12, SELECT_A_PORT00_PIN12, SELECT_B_PORT34_PIN2, SELECT_C_PORT22_PIN6, SELECT_D_PORT22_PIN9, SELECT_A_PORT00_PIN6, SELECT_C_PORT22_PIN3, SELECT_D_PORT14_PIN15, SELECT_A_PORT23_PIN3, SELECT_B_PORT01_PIN0, SELECT_C_PORT32_PIN6, SELECT_D_PORT10_PIN9, SELECT_E_PORT22_PIN0, SELECT_F_PORT23_PIN1, SELECT_A_PORT14_PIN15, SELECT_B_PORT01_PIN8, SELECT_C_PORT23_PIN2, SELECT_D_PORT13_PIN11, SELECT_E_PORT22_PIN1, SELECT_F_PORT22_PIN4, SELECT_A_PORT02_PIN9, SELECT_B_PORT02_PIN10, SELECT_C_PORT33_PIN1, SELECT_D_PORT33_PIN6, SELECT_E_PORT34_PIN5, SELECT_A_PORT01_PIN5, SELECT_B_PORT01_PIN7, SELECT_C_PORT14_PIN7, SELECT_D_PORT14_PIN9, SELECT_E_PORT20_PIN6, SELECT_F_PORT20_PIN7, SELECT_A_PORT00_PIN4, SELECT_B_PORT00_PIN8, SELECT_C_PORT13_PIN0, SELECT_D_PORT13_PIN1, SELECT_A_PORT10_PIN0, SELECT_B_PORT10_PIN4, SELECT_C_PORT21_PIN0, SELECT_D_PORT21_PIN1, SELECT_E_PORT21_PIN2, SELECT_F_PORT21_PIN5, SELECT_A_PORT00_PIN3, SELECT_B_PORT00_PIN5, SELECT_A_PORT00_PIN9, SELECT_B_PORT00_PIN11, SELECT_A_PORT33_PIN3, SELECT_B_PORT33_PIN4, SELECT_A_PORT32_PIN4, SELECT_B_PORT32_PIN7, SELECT_A_PORT23_PIN5, SELECT_B_PORT23_PIN7, SELECT_A_PORT22_PIN11, SELECT_B_PORT21_PIN0, SELECT_A_PORT21_PIN1, SELECT_B_PORT21_PIN4, SELECT_A_PORT15_PIN6, SELECT_B_PORT15_PIN7, SELECT_A_PORT14_PIN7, SELECT_B_PORT14_PIN9, SELECT_A_PORT13_PIN0, SELECT_B_PORT13_PIN3, SELECT_A_PORT10_PIN4, SELECT_B_PORT10_PIN5, SELECT_A_PORT10_PIN6, SELECT_B_PORT10_PIN7}, origin=INFINEON_AURIX2G, post-build-variant-value=true, set at post-build, default-value=SELECT_A_PORT14_PIN1  # This parameter selects the alternate input for the RX signal for the given Lin channel
        reference LinClockRef: post-build-variant-value=true, set at post-build, destination=McuClockReferencePoint  # Reference to the LIN clock source configuration, which is set in the MCU driver configuration from the LinSysClockRef parameter.
        symbolic name reference LinChannelEcuMWakeupSource [0..1]: multiplicity set at pre-compile, set at pre-compile, destination=EcuMWakeupSource  # This parameter contains a reference to the Wakeup Source for this controller as defined in the ECU State Manager.
    container CommonPublishedInformation  # Common container, aggregated by all modules. It contains published information about vendor and versions.
      integer ArMajorVersion: 0..255, origin=INFINEON_AURIX2G, set at published-information, default-value=4  # Major version number of AUTOSAR specification on which the appropriate implementation is based on.
      integer ArMinorVersion: 0..255, origin=INFINEON_AURIX2G, set at published-information, default-value=2  # Minor version number of AUTOSAR specification on which the appropriate implementation is based on.
      integer ArPatchVersion: 0..255, origin=INFINEON_AURIX2G, set at published-information, default-value=2  # Patch level version number of AUTOSAR specification on which the appropriate implementation is based on.
      integer SwMajorVersion: 0..255, origin=INFINEON_AURIX2G, set at published-information, default-value=20  # Major version number of the vendor specific implementation of the module. The numbering is vendor specific.
      integer SwMinorVersion: 0..255, origin=INFINEON_AURIX2G, set at published-information, default-value=10  # Minor version number of the vendor specific implementation of the module. The numbering is vendor specific.
      integer SwPatchVersion: 0..255, origin=INFINEON_AURIX2G, set at published-information, default-value=0  # Patch level version number of the vendor specific implementation of the module. The numbering is vendor specific.
      integer ModuleId: 0..65535, origin=INFINEON_AURIX2G, set at published-information, default-value=82  # Module ID of this module from Module List
      integer VendorId: 0..65535, origin=INFINEON_AURIX2G, set at published-information, default-value=17  # Vendor ID of the dedicated implementation of this module according to the AUTOSAR vendor list
      string VendorApiInfix: origin=INFINEON_AURIX2G, set at published-information, default-value=AscLin  # In driver modules which can be instantiated several times on a single ECU, BSW00347 requires that the name of APIs is extended by the VendorId and a vendor specific name. This parameter is used to specify the vendor specific name. In total, the implementation specific name is generated as follows: <ModuleName>_>VendorId>_<VendorApiInfix><Api name from SWS>. E.g. assuming that the VendorId of the implementor is 123 and the implementer chose a VendorApiInfix of "v11r456" a api name Can_Write defined in the SWS will translate to Can_123_v11r456Write. This parameter is mandatory for all modules with upper multiplicity > 1. It shall not be used for modules with upper multiplicity =1.
      string Release: origin=INFINEON_AURIX2G, set at published-information, default-value=_TRICORE_TC389  # Aurix2G derivative used for the implementation
