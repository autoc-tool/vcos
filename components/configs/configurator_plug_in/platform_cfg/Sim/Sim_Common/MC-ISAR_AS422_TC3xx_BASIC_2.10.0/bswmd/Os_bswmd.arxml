AUTOSAR XML (schema 00046)
package /AUTOSAR/EcucDefs
  module definition Os [0..1]: variants pre-compile  # Configuration of the Os (Operating System) module.
    container OsGeneral  # General configuration parameters of the AutosarOs macro.
      boolean show_no_mapping_task: set at pre-compile, default-value=false  # Show no mapping task from UI.
      boolean VCOS_OS_CONFIG_AUTOSAROS_CMD: set at pre-compile, default-value=true  # Enables the generation of the VCOS_OS_CONFIG_AUTOSAROS_CMD.
      boolean VCOS_OS_CONFIG_ROUND_ROBIN_ENABLED: set at pre-compile, default-value=false  # Enables the generation of the VCOS_OS_CONFIG_ROUND_ROBIN_ENABLED.
      boolean VCOS_OS_CONFIG_INTERRUPT_NESTING_ENABLE: set at pre-compile, default-value=false  # Enables the generation of the VCOS_OS_CONFIG_INTERRUPT_NESTING_ENABLE.
      boolean VCOS_OS_CONFIG_ERROR: set at pre-compile, default-value=true  # Enables the generation of the VCOS_OS_CONFIG_ERROR.
      enumeration VCOS_OS_CONFIG_FPU_USAGE: {NONE, ALL, INDIVIDUAL}, set at pre-compile, default-value=NONE  # FPU usage method. NONE means no need to save and restore fpu context during context switch, ALL means all thread will do save and restore fpu context during context switch, INDIVIDUAL means which thread will need to save and restore fpu context is according to user configuration.
    container OsAlarm [0..65535]  # An OsAlarm may be used to asynchronously inform or activate a specific task. It is possible to start alarms automatically at system start-up depending on the application mode.
      reference OsAlarmAccessingApplication [0..31]: multiplicity set at pre-compile, set at pre-compile, destination=OsApplication  # Reference to applications which have an access to this object.
      reference OsAlarmCounterRef: set at pre-compile, destination=OsCounter  # Reference to the assigned counter for that alarm
      choice container OsAlarmAction  # This container defines which type of notification is used when the alarm expires.
        container OsAlarmActivateTask [0..1]  # This container specifies the parameters to activate a task.
          reference OsAlarmActivateTaskRef: set at pre-compile, destination=OsTask  # Reference to the task that will be activated by that alarm action
        container OsAlarmCallback [0..1]  # This container specifies the parameters to call a callback OS alarm action.
          function name OsAlarmCallbackName: set at pre-compile, max-length=63, min-length=1  # Name of the function that is called when this alarm callback is triggered.
        container OsAlarmIncrementCounter [0..1]  # This container specifies the parameters to increment a counter.
          reference OsAlarmIncrementCounterRef: scope=ECU, set at pre-compile, destination=OsCounter  # Reference to the counter that will be incremented by that alarm action
        container OsAlarmSetEvent [0..1]  # This container specifies the parameters to set an event
          reference OsAlarmSetEventRef: set at pre-compile, destination=OsEvent  # Reference to the event that will be set by that alarm action
          reference OsAlarmSetEventTaskRef: set at pre-compile, destination=OsTask  # Reference to the task that will be activated by that event
      container OsAlarmAutostart [0..1]  # If present this container defines if an alarm is started automatically at system start-up depending on the application mode.
        enumeration OsAlarmAutostartType: {ABSOLUTE, RELATIVE}, set at pre-compile, default-value=ABSOLUTE  # This specifies the type of autostart for the alarm..
        integer OsAlarmAlarmTime: 0..4294967295, set at pre-compile  # The relative or absolute tick value when the alarm expires for the first time. Note that for an alarm which is RELATIVE the value must be at bigger than 0.
        integer OsAlarmCycleTime: 0..4294967295, set at pre-compile  # Cycle time of a cyclic alarm in ticks. If the value is 0 than the alarm is not cyclic.
        reference OsAlarmAppModeRef: multiplicity set at pre-compile, set at pre-compile, destination=OsAppMode  # Reference to the application modes for which the AUTOSTART shall be performed
    container OsAppMode [1..*]  # OsAppMode is the object used to define ISO 17356-3 properties for an ISO 17356-3 application mode. | No standard attributes are defined for AppMode. In a CPU, at least one AppMode object has to be defined. [source: ISO 17356-6] An OsAppMode called OSDEFAULTAPPMODE must always be there for ISO 17356 compatibility.
    container OsApplication [1..32]  # An AUTOSAR OS must be capable of supporting a collection of OS objects (tasks, interrupts, alarms, hooks etc.) that form a cohesive functional unit. This collection of objects is termed an OS-Application. | All objects which belong to the same OS-Application have access to each other. Access means to allow to use these objects within API services. Access by other applications can be granted separately.
      integer OsAppMemoryProtectionIdentifier [0..1]: 0..4294967295, multiplicity set at pre-compile, set at pre-compile  # This optional parameter can be used to specify a memory protection identifier for the OS-Application.
      boolean OsTrusted: scope=ECU, set at pre-compile, default-value=false  # Parameter to specify if an OS-Application is trusted or not. | true: OS-Application is trusted false: OS-Application is not trusted (default)
      boolean OsIsPrivileged: scope=ECU, set at pre-compile, default-value=false  # Parameter to specify if an OS-Application is privileged or not.
      boolean OsTrustedApplicationDelayTimingViolationCall: scope=ECU, set at pre-compile, default-value=true  # Parameter to specify if a timing violation which occurs within an trusted OS-Application is raised immediately of if it is delayed until the current task returns to the calling OS-Application (return of CallTrustedFunction) | true: violation / call to ProtectionHook() is delayed false: timing violation cause an immediate call to the ProtectionHook().
      boolean OsTrustedApplicationWithProtection: scope=ECU, set at pre-compile, default-value=false  # Parameter to specify if a trusted OS-Application is executed with memory protection or not. | true: OS-Application runs within a protected environment. This means that write access is limited. false: OS-Application has full write access (default)
      reference OsAppAlarmRef [0..65535]: scope=ECU, multiplicity set at pre-compile, set at pre-compile, destination=OsAlarm  # Specifies the OsAlarms that belong to the OsApplication.
      reference OsAppCounterRef [0..65535]: scope=ECU, multiplicity set at pre-compile, set at pre-compile, destination=OsCounter  # References the OsCounters that belong to the OsApplication.
      reference OsAppEcucPartitionRef [0..1]: multiplicity set at pre-compile, set at pre-compile, destination=EcucPartition  # Denotes which "EcucPartition" is implemented by this "OSApplication".
      reference OsAppIsrRef [0..65535]: scope=ECU, multiplicity set at pre-compile, set at pre-compile, destination=OsIsr  # references which OsIsrs belong to the OsApplication
      reference OsApplicationCoreRef [0..1]: multiplicity set at pre-compile, set at pre-compile, destination=EcucCoreDefinition  # Reference to the Core Definition in the Ecuc Module where the CoreId is defined. This reference is used to describe to which Core the OsApplication is bound.
      reference OsAppScheduleTableRef [0..65535]: scope=ECU, multiplicity set at pre-compile, set at pre-compile, destination=OsScheduleTable  # References the OsScheduleTables that belong to the OsApplication.
      reference OsAppTaskRef [0..65535]: scope=ECU, multiplicity set at pre-compile, set at pre-compile, destination=OsTask  # references which OsTasks belong to the OsApplication
      reference OsRestartTask [0..1]: scope=ECU, multiplicity set at pre-compile, set at pre-compile, destination=OsTask  # Optionally one task of an OS-Application may be defined as Restart Task. | Multiplicity = 1: Restart Task is activated by the Operating System if the protection hook requests it. Multiplicity = 0: No task is automatically started after a protection error happened.
      container OsApplicationHooks  # Container to structure the OS-Application-specific hooks
        boolean OsAppErrorHook: scope=ECU, set at pre-compile  # Select the OS-Application error hook. | true: Hook is called false: Hook is not called
        boolean OsAppShutdownHook: scope=ECU, set at pre-compile  # Select the OS-Application specific shutdown hook for the OS-Application. | true: Hook is called false: Hook is not called
        boolean OsAppStartupHook: scope=ECU, set at pre-compile  # Select the OS-Application specific startup hook for the OS-Application. | true: Hook is called false: Hook is not called
        foreign reference OsMemoryMappingCodeLocationRef [0..1]: scope=ECU, set at pre-compile, destination-type=SW-ADDR-METHOD  # Reference to the memory mapping containing details about the section where the code is placed.
      container OsApplicationTrustedFunction [0..255]  # Container to structure the configuration parameters of trusted functions
        function name OsTrustedFunctionName: scope=ECU, set at pre-compile  # Trusted function (as part of a trusted OS-Application) available to other OS-Applications. This also supersedes the ISO 17356-6 attribute TRUSTED in APPLICATION because the optionality of this parameter is describing that already.
      container OsApplicationNonTrustedFunction [0..255]  # Container to structure the configuration parameters of non-trusted functions
        function name OsNonTrustedFunctionName: scope=ECU, set at pre-compile  # non-trusted function (as part of a non-trusted OS-Application) available to other non-trusted OS-Applications.
        integer OsNonTrustedFunctionStackSize: 0..65535, set at pre-compile, default-value=1024  # The size of non-trusted function's stack.
        container OsNonTrustedFunctionCaller [0..32]  # This Container contains the information who will call the non-trusted function.
          integer OsNonTrustedFunctionAppStackNum: 0..32, set at pre-compile, default-value=1  # The number of non-trusted function's stacks belonging to the app.
          reference OsNonTrustedFunctionAppRef: scope=ECU, multiplicity set at pre-compile, set at pre-compile, requires-symbolic-name-value=true, destination=OsApplication  # Reference to the non-trusted function.
    container OsCounter [0..65535]  # Configuration information for the counters that belong to the OsApplication.
      enumeration OsCounterType: {HARDWARE, SOFTWARE}, scope=ECU, set at pre-compile  # This parameter contains the natural type or unit of the counter.
      float OsSecondsPerTick: 0.00000001..0.001, scope=ECU, multiplicity set at pre-compile, set at pre-compile, default-value=0.001  # Time of one counter tick in seconds.
      integer OsCounterMaxAllowedValue: 0..2147483647, set at pre-compile, default-value=1073741823  # Maximum possible allowed value of the system counter in ticks.
      integer OsCounterMinCycle: 1..2147483647, set at pre-compile, default-value=1  # The MINCYCLE attribute specifies the minimum allowed number of counter ticks for a cyclic alarm linked to the counter.
      integer OsCounterTicksPerBase [0..1]: 1..4294967295, set at pre-compile  # The TICKSPERBASE attribute specifies the number of ticks required to reach a counterspecific unit. The interpretation is implementation-specific.
      reference OsCounterAccessingApplication [0..31]: multiplicity set at pre-compile, set at pre-compile, destination=OsApplication  # Reference to applications which have an access to this object.
      container OsDriver [0..1]  # This Container contains the information who will drive the counter. | This configuration is only valid if the counter has OsCounterType set to HARDWARE. If the container does not exist (multiplicity=0) the timer is managed by the OS internally (OSINTERNAL). If the container exists the OS can use the GPT interface to manage the timer. The user have to supply the GPT channel. If the counter is driven by some other (external to the OS) source (like a TPU for example) this must be described as a vendor specific extension.
        boolean High Resolution: scope=ECU, set at pre-compile, default-value=true  # Parameter to specify whether it is a High resolution timer. | true: High resolution timer (default) false: Periodical interrupt timer
        reference OsGptChannelRef [0..1]: scope=ECU, multiplicity set at pre-compile, set at pre-compile, requires-symbolic-name-value=true, destination=GptChannelConfiguration  # Reference to the GPT channel.
        reference OsIsrRef: scope=ECU, multiplicity set at pre-compile, set at pre-compile, requires-symbolic-name-value=true, destination=OsIsr  # Reference to the ISR.
        reference OsHardwareTimerChannelRef: scope=ECU, multiplicity set at pre-compile, set at pre-compile, requires-symbolic-name-value=true, destination=OsHardWareTimer  # Reference to hardware timer channel.
      container OsTimeConstant [0..*]  # Allows the user to define constants which can be e.g. used to compare time values with timer tick values. | A time value will be converted to a timer tick value during generation and can later on accessed via the OsConstName. The conversation is done by rounding time values to the nearest fitting tick value.
        float OsTimeValue: 0..458129844, scope=ECU, set at pre-compile  # This parameter contains the value of the constant in seconds.
    container OsEvent [0..65535]  # Representation of OS events in the configuration context. Adopted from the ISO 17356-6 specification.
      integer OsEventMask [0..1]: 0..18446744073709551615, multiplicity set at pre-compile, set at pre-compile  # If event mask would be set to AUTO in OIL, this parameter should be omitted here.
      boolean Jitter Statistics: set at pre-compile, default-value=false  # This attribute defines whether the event has jitter statistics.
    container OsIoc [0..1]  # Configuration of the IOC (Inter OS Application Communicator).
      container OsIocCommunication [0..65535]  # Representation of a 1:1 or N:1 or N:M (unqueued only) communication between software parts located in different OS-Applications that are bound to the same or to different cores. | The name shall begin with the name of the sending software service and be followed by a unique identifier delivered by the sending software service. In the case of RTE as user attention shall be paid on the fact that uniqueness for identifier names has to be reached over ports, data elements, object instances and maybe additional identification properties (E.g. Case 1:N mapping to 1:1). Example: - <NameSpace>_UniqueID
        integer OsIocBufferLength [0..1]: 0..255, multiplicity set at pre-compile, set at pre-compile, default-value=0  # This attribute defines the size of the IOC internal queue to be allocated for a queued communication. | This configuration information shall allow the optimization of the needed memory for communications requiring buffers within the RTE and within the IOC.
        container OsIocDataProperties [1..*]  # Data properties of the data to be transferred on the IOC communication channel.
          integer OsIocDataPropertyIndex [0..1]: 0..255, multiplicity set at pre-compile, set at pre-compile  # This parameter is used to define in which order the data is send, e.g. whether IocSendGroup(A,B) or IocSendGroup(B,A) shall be used.
          string OsIocInitValue [0..1]: multiplicity set at pre-compile, set at pre-compile  # Initial Value for the data to be transferred on the IOC communication channel.
          string OsIocDataType [0..1]: multiplicity set at pre-compile, set at pre-compile  # Currently this parameter is used instead of OsIocDataTypeRef to specify the data type.These types are recognised as primitive.All integer and float based types defined by AUTOSAR in StdTypes and PlatformTypes.Additionally, also the public integer based types and enumerations defined in Os_Types.h are recognised.
          foreign reference OsIocDataTypeRef: set at pre-compile, destination-type=IMPLEMENTATION-DATA-TYPE  # This is the type of the data to be transferred on the IOC communication channel. This attribute is necessary to generate the parameter type of the Ioc functions. Additionally this information should be used to compute the data size for necessary data copy operations within the Ioc module. | If more than one attribute is defined, the IOC generator should generate an IocXxxGroup function (Xxx= CHOICE [Send, Receive, Write, Read]). N:1 or N:M communication (Multiplicity of OsIocSenderProperties > 1) is only allowed for multiplicity of OsIocDataTypeRef = 1
        container OsIocReceiverProperties [1..65536]  # Representation of receiver properties for one communication. For each OsIocCommunication one (1:1) or many receivers (N:M) have to be defined. This container should be instantiated within an OsIocCommunication.
          enumeration OsIocFunctionImplementationKind [0..1]: {DO_NOT_CARE, FUNCTION, MACRO}, multiplicity set at pre-compile, set at pre-compile, default-value=DO_NOT_CARE  # This parameter is used to select whether this communication is implemented as a macro or as a function.
          function name OsIocReceiverPullCB [0..1]: multiplicity set at pre-compile, set at pre-compile  # This attribute defines the name of a callback function that the IOC shall call on the receiving core for each data reception. | In case of non existence of this attribute no ReceiverPullCB notification shall be applied by the IOC. The name of the function shall begin with the name of the receiving module, followed with a callback name and followed by the IocId. Example: void RTE_ReceiverPullCB_RTE25 (void). If this attribute does not exist, it means that no ReceiverPullCB shall be called (No notification from IOC is required). If this attribute exists the IOC shall call the callback function on the receiving core.
          reference OsIocReceivingOsApplicationRef: set at pre-compile, destination=OsApplication  # This attribute is a reference to the receiving OsApplication instance defined in the configuration file of the OS. | This information allows for the generator to get additional information necessary for the code generation like: * The protection properties of the communicating OsApplications to find out which protections have to be crossed * The core identifiers to find out if an intra or an inter core communication has to be realized * Interrupt details in case of cross core notification to realize over IRQs
        container OsIocSenderProperties [1..65536]  # Representation of sender properties for one communication. For each OsIocCommunication one (1:1) or many senders (N:1 or N:M) have to be defined. Multiplicity > 1 (N:1 or N:M communication) is only allowed for Multiplicity of OsIocDataTypeRef = 1. | This container should be instantiated within an OsIocCommunication.
          enumeration OsIocFunctionImplementationKind [0..1]: {DO_NOT_CARE, FUNCTION, MACRO}, multiplicity set at pre-compile, set at pre-compile, default-value=DO_NOT_CARE  # This parameter is used to select whether this communication is implemented as a macro or as a function.
          integer OsIocSenderId [0..1]: 0..255, scope=ECU, multiplicity set at pre-compile, set at pre-compile  # Representation of a sender in a N:1 or N:M communication to distinguish between senders. | This parameter does not exist in 1:1 communication.
          reference OsIocSendingOsApplicationRef: set at pre-compile, destination=OsApplication  # This attribute is a reference to the sending OS-Application instance defined in the configuration file of the OS. | This information shall allows the generator to get additional information necessary for the code generation like: * The protection properties of the communicating OS-Applications to find out which protection boundaries have to be crossed. * The core identifiers to find out if an intra or an inter core communication has to be realized * Interrupt details in case of cross core notification to realize over IRQs
    container OsIsr [0..65535]  # The OsIsr container represents an ISO 17356 interrupt service routine.
      boolean OsIsrInitialEnableInterruptSource: set at pre-compile, default-value=false  # Parameter to specify if interrupt source is enable or not.
      enumeration OsIsrCategory: {CATEGORY_1, CATEGORY_2}, set at pre-compile, default-value=CATEGORY_2  # This attribute specifies the category of this ISR.
      integer OsIsrInterruptPriority: 1..255, set at pre-compile  # This attribute specifies the priority of this ISR.
      integer OsIsrInterruptSource: 0..4096, set at pre-compile  # This attribute specifies the interrupt source number of this ISR.
      string OsIsrEntryFunctionName: set at pre-compile, max-length=63, min-length=1  # This attribute specifies the entry function name of this ISR.
      foreign reference OsMemoryMappingCodeLocationRef [0..1]: scope=ECU, set at pre-compile, destination-type=SW-ADDR-METHOD  # Reference to the memory mapping containing details about the section where the code is placed.
      reference OsIsrResourceRef [0..*]: multiplicity set at pre-compile, set at pre-compile, destination=OsResource  # This reference defines the resources accessed by this ISR.
      container OsIsrTimingProtection [0..1]  # This container contains all parameters which are related to timing protection | If the container exists, the timing protection is used for this interrupt. If the container does not exist, the interrupt is not supervised regarding timing violations.
        float OsIsrAllInterruptLockBudget [0..1]: 0..458129844, scope=ECU, multiplicity set at pre-compile, set at pre-compile, default-value=0  # This parameter contains the maximum time for which the ISR is allowed to lock all interrupts (via SuspendAllInterrupts() or DisableAllInterrupts()) (in microsecond).
        float OsIsrExecutionBudget [0..1]: 0..458129844, scope=ECU, multiplicity set at pre-compile, set at pre-compile, default-value=0  # The parameter contains the maximum allowed execution time of the interrupt (in microsecond).
        float OsIsrOsInterruptLockBudget [0..1]: 0..458129844, scope=ECU, multiplicity set at pre-compile, set at pre-compile, default-value=0  # This parameter contains the maximum time for which the ISR is allowed to lock all Category 2 interrupts (via SuspendOSInterrupts()) (in microsecond).
        float OsIsrTimeFrame [0..1]: 0..Inf, scope=ECU, multiplicity set at pre-compile, set at pre-compile, default-value=0  # This parameter contains the minimum inter-arrival time between successive interrupts (in microsecond).
        container OsIsrResourceLock [0..*]  # This container contains a list of times the interrupt uses resources.
          float OsIsrResourceLockBudget: 0..Inf, scope=ECU, set at pre-compile  # This parameter contains the maximum time the interrupt is allowed to hold the given resource (in seconds).
          reference OsIsrResourceLockResourceRef: scope=ECU, set at pre-compile, destination=OsResource  # Reference to the resource the locking time is depending on
    container OsOS  # OS is the object used to define ISO 17356-3 properties for an ISO 17356 application. | Per CPU exactly one OS object has to be defined.
      boolean OsStackMonitoring: scope=ECU, set at pre-compile  # Select stack monitoring of Tasks/Category 2 ISRs | true: Stacks are monitored false: Stacks are not monitored
      boolean OsUseGetServiceId: set at pre-compile  # As defined by ISO 17356
      boolean OsUseParameterAccess: set at pre-compile  # As defined by ISO 17356
      boolean OsUseResScheduler: set at pre-compile, default-value=true  # The OsUseResScheduler attribute defines whether the resource RES_SCHEDULER is used within the application.
      boolean OsShellTaskEnableSharingStack: scope=ECU, set at pre-compile, default-value=false  # true:shell task enable shared stack(only core 0 shell task should be autostart). | false: disable shell task shared stack
      enumeration OsScalabilityClass [0..1]: {SC1, SC2, SC3, SC4}, scope=ECU, set at pre-compile  # A scalability class for each System Object "OS" has to be selected. In order to customize the operating system to the needs of the user and to take full advantage of the processor features the operating system can be scaled according to the scalability classes. | A scalability class for each System Object "OS" has to be selected. In order to customize the operating system to the needs of the user and to take full advantage of the processor features the operating system can be scaled according to the scalability classes. SC1: OSEK compliant with AUTOSAR extensions SC2: Timing Protection SC3: Memory Protection SC4: Memory and Timing Protection If the scalability class is omitted this translates to the OIL AUTO mechanism..
      enumeration OsStatus: {EXTENDED, STANDARD}, set at pre-compile, default-value=EXTENDED  # The Status attribute specifies whether a system with standard or extended status has to be used. Automatic assignment is not supported for this attribute.
      enumeration OsEventJitterStatistics: {NONE, ALL, INDIVIDUAL}, set at pre-compile, default-value=NONE  # This attribute specifies whether use event statistics.
      integer OsNumberOfCores [0..1]: 1..65535, multiplicity set at pre-compile, set at pre-compile  # Maximum number of cores that are controlled by the OS. | The OS uses the value internally. It depends on the ECU HW.
      integer OsIpiCallQueueDepth: 2..255, set at pre-compile, default-value=5  # The queue depth of the ipicall instance is defined by the value of this attribute.
      container OsHooks  # Container to structure all hooks belonging to the OS
        boolean OsErrorHook: set at pre-compile, default-value=true  # Error hook as defined by ISO 17356 | true: Hook is called false: Hook is not called
        integer OsErrorHookStackSize: 128..65535, set at pre-compile, default-value=1024  # The size of a ErrorHook stack is defined by the value of this attribute.
        boolean OsPostTaskHook: set at pre-compile, default-value=true  # Post-task hook as defined by ISO 17356 | true: Hook is called false: Hook is not called
        boolean OsPreTaskHook: set at pre-compile, default-value=true  # Pre-task hook as defined by ISO 17356 | true: Hook is called false: Hook is not called
        boolean OsPanicHook: set at pre-compile, default-value=true  # Panic-task hook as defined by ISO 17356 | true: Hook is called false: Hook is not called
        boolean OsProtectionHook [0..1]: scope=ECU, multiplicity set at pre-compile, set at pre-compile, default-value=true  # Switch to enable/disable the call to the (user supplied) protection hook. | true: Protection hook is called on protection error false: Protection hook is not called
        integer OsProtectionHookStackSize: 128..65535, set at pre-compile, default-value=1024  # The size of a ProtectionHook stack is defined by the value of this attribute.
        boolean OsShutdownHook: set at pre-compile, default-value=true  # Shutdown hook as defined by ISO 17356 | true: Hook is called false: Hook is not called
        integer OsShutdownHookStackSize: 128..65535, set at pre-compile, default-value=1024  # The size of a ShutdownHook stack is defined by the value of this attribute.
        boolean OsStartupHook: set at pre-compile, default-value=true  # Startup hook as defined by ISO 17356 | true: Hook is called false: Hook is not called
        integer OsStartupHookStackSize: 128..65535, set at pre-compile, default-value=1024  # The size of a StartupHook stack is defined by the value of this attribute.
        foreign reference OsMemoryMappingCodeLocationRef [0..1]: scope=ECU, set at pre-compile, destination-type=SW-ADDR-METHOD  # Reference to the memory mapping containing details about the section where the code is placed.
    container OsPeripheralArea [0..65534]: multiplicity set at pre-compile  # Container to structure the configuration parameters of one peripheral area. The container short name can be used to access this area.
      integer OsPeripheralAreaEndAddress: 0..18446744073709551615, set at pre-compile  # Last valid address of a peripheral area.
      integer OsPeripheralAreaId: 0..18446744073709551615, symbolic-name-value=true  # Id of peripheral area.
      integer OsPeripheralAreaStartAddress: 0..18446744073709551615, set at pre-compile  # First valid address of a peripheral area.
      reference OsPeripheralAreaAccessingApplication [0..*]: destination=OsApplication  # Reference to application which have access to this object.
    container OsResource [0..65535]  # An OsResource object is used to co-ordinate the concurrent access by tasks and ISRs to a shared resource, e.g. the scheduler, any program sequence, memory or any hardware area.
      enumeration OsResourceProperty: {INTERNAL, LINKED, STANDARD}, set at pre-compile, default-value=STANDARD  # This specifies the type of the resource.
      reference OsResourceAccessingApplication [0..31]: multiplicity set at pre-compile, set at pre-compile, destination=OsApplication  # Reference to applications which have an access to this object.
      reference OsResourceLinkedResourceRef [0..1]: multiplicity set at pre-compile, set at pre-compile, destination=OsResource  # The link to the resource. Must be valid if OsResourceProperty is LINKED. If OsResourceProperty is not LINKED the value is ignored.
    container OsScheduleTable [0..65535]  # An OsScheduleTable addresses the synchronization issue by providing an encapsulation of a statically defined set of alarms that cannot be modified at runtime.
      boolean OsScheduleTableRepeating: scope=ECU, set at pre-compile  # true: first expiry point on the schedule table shall be processed at final expiry point delay ticks after the final expiry point is processed. | false: the schedule table processing stops when the final expiry point is processed.
      integer OsScheduleTableDuration: 0..4294967295, set at pre-compile  # This parameter defines the modulus of the schedule table (in ticks).
      reference OsScheduleTableCounterRef: scope=ECU, set at pre-compile, destination=OsCounter  # This parameter contains a reference to the counter which drives the schedule table.
      reference OsSchTblAccessingApplication [0..31]: multiplicity set at pre-compile, set at pre-compile, destination=OsApplication  # Reference to applications which have an access to this object.
      container OsScheduleTableAutostart [0..1]  # This container specifies if and how the schedule table is started on startup of the Operating System. The options to start a schedule table correspond to the API calls to start schedule tables during runtime.
        enumeration OsScheduleTableAutostartType: {ABSOLUTE, RELATIVE, SYNCHRON}, set at pre-compile, default-value=ABSOLUTE  # This specifies the type of the autostart for the schedule table.
        integer OsScheduleTableStartValue [0..1]: 0..4294967295, scope=ECU, multiplicity set at pre-compile, set at pre-compile  # Absolute autostart tick value when the schedule table starts. Only used if the OsScheduleTableAutostartType is ABSOLUTE. | Relative offset in ticks when the schedule table starts. Only used if the OsScheduleTableAutostartType is RELATIVE.
        reference OsScheduleTableAppModeRef: scope=ECU, multiplicity set at pre-compile, set at pre-compile, destination=OsAppMode  # Reference in which application modes the schedule table should be started during startup
      container OsScheduleTableExpiryPoint [1..*]  # The point on a Schedule Table at which the OS activates tasks and/or sets events
        integer OsScheduleTblExpPointOffset: 0..4294967295, set at pre-compile  # The offset from zero (in ticks) at which the expiry point is to be processed.
        container OsScheduleTableEventSetting [0..65535]  # Event that is triggered by that schedule table.
          reference OsScheduleTableSetEventRef: set at pre-compile, destination=OsEvent  # Reference to event that will be set by action
          reference OsScheduleTableSetEventTaskRef: set at pre-compile, destination=OsTask
        container OsScheduleTableTaskActivation [0..65535]  # Task that is triggered by that schedule table.
          reference OsScheduleTableActivateTaskRef: scope=ECU, set at pre-compile, destination=OsTask  # Reference to task that will be activated by action
        container OsScheduleTblAdjustableExpPoint [0..1]  # Adjustable expiry point
          integer OsScheduleTableMaxLengthen: 0..4294967295, set at pre-compile  # The maximum positive adjustment that can be made to the expiry point offset (in ticks).
          integer OsScheduleTableMaxShorten: 0..4294967295, set at pre-compile  # The maximum negative adjustment that can be made to the expiry point offset (in ticks).
      container OsScheduleTableSync [0..1]  # This container specifies the synchronization parameters of the schedule table.
        enumeration OsScheduleTblSyncStrategy: {EXPLICIT, IMPLICIT, NONE}, scope=ECU, origin=AUTOSAR ECUC, set at pre-compile, default-value=NONE  # AUTOSAR OS provides support for synchronization in two ways: explicit and implicit.
        integer OsScheduleTblExplicitPrecision [0..1]: 0..4294967295, scope=ECU, multiplicity set at pre-compile, set at pre-compile, default-value=0  # This configuration is only valid if the explicit synchronization is used.
    container OsSpinlock [0..65535]  # An OsSpinlock object is used to co-ordinate concurrent access by TASKs/ISR2s on different cores to a shared resource.
      enumeration OsSpinlockLockMethod: {LOCK_ALL_INTERRUPTS, LOCK_CAT2_INTERRUPTS, LOCK_NOTHING, LOCK_WITH_RES_SCHEDULER}, set at pre-compile, default-value=LOCK_NOTHING  # Lock method which is used when a spinlock is taken. Note that it is possible that a user (e.g. a Task) might hold more than one spinlock. In this case the last lock taken is forced to use at least a lock methode which locks as strong as the current one.
      enumeration OsSpinlockLockType: {STANDARD, OPTIMIZED}, set at pre-compile, default-value=STANDARD  # Lock type which is used when a spinlock is taken. Note that it is possible that a user (e.g. a Task) might hold more than one spinlock. In this case the last lock taken is forced to use at least a lock methode which locks as strong as the current one.
      reference OsSpinlockAccessingApplication [1..32]: multiplicity set at pre-compile, set at pre-compile, destination=OsApplication  # Reference to OsApplications that have an access to this object.
      reference OsSpinlockSuccessor [0..1]: multiplicity set at pre-compile, set at pre-compile, destination=OsSpinlock  # Reference to OsApplications that have an access to this object. | To check whether a spinlock can be occupied (in a nested way) without any danger of deadlock, a linked list of spinlocks can be defined. A spinlock can only be occupied in the order of the linked list. It is allowed to skip a spinlock. If no linked list is specified, spinlocks cannot be nested.
    container OsTask [0..65535]  # This container represents an ISO 17356 task.
      boolean OsTaskWithProtection: scope=ECU, set at pre-compile, default-value=false  # true: task has private data section(task must be unprivileged). | false: task no private data section.
      boolean OsTaskAliveCheckPoint [0..1]: scope=ECU, set at pre-compile, default-value=false  # true: config task alive check point in code.
      boolean OsTaskUsesFpu: scope=ECU, set at pre-compile, default-value=false  # true: open floating-point arithmetic. | false: close floating-point arithmetic..
      enumeration OsTaskSchedule: {FULL, NON}, set at pre-compile, default-value=FULL  # The OsTaskSchedule attribute defines the preemptability of the task. | If this attribute is set to NON, no internal resources may be assigned to this task.
      enumeration OsTaskType: {EXTENDED, BASIC}, set at pre-compile, default-value=BASIC  # The OsTaskType attribute defines the type of the task.
      boolean OsTaskStackSharing: scope=ECU, set at pre-compile, default-value=false  # true: enable shared stack(only when OsTaskSchedule is NON, OsTaskType is BASIC). | false: disable shared stack
      integer OsTaskActivation: 1..255, set at pre-compile, default-value=1  # This attribute defines the maximum number of queued activation requests for the task. A value equal to "1" means that at any time only a single activation is permitted for this task. Note that the value must be a natural number starting at 1.
      integer OsTaskPriority: 0..65534, set at pre-compile  # The priority of a task is defined by the value of this attribute. This value has to be understood as a relative value, i.e. the values show only the relative ordering of the tasks. | ISO 17356-3 defines the lowest priority as zero (0); larger values correspond to higher priorities.
      integer OsTaskStackSize: 128..65535, set at pre-compile, default-value=1024  # The size of a task stack is defined by the value of this attribute.
      integer OsTaskTicksToWait: 0..4294967295, set at pre-compile, default-value=4294967295  # The ticks to wait is defined by the value of this attribute.
      foreign reference OsMemoryMappingCodeLocationRef [0..1]: scope=ECU, set at pre-compile, destination-type=SW-ADDR-METHOD  # Reference to the memory mapping containing details about the section where the code is placed.
      reference OsTaskAccessingApplication [0..31]: multiplicity set at pre-compile, set at pre-compile, destination=OsApplication  # Reference to applications which have an access to this object.
      reference OsTaskEventRef [0..24]: multiplicity set at pre-compile, set at pre-compile, destination=OsEvent  # This reference defines the list of events the extended task may react on.
      reference OsTaskResourceRef [0..65535]: multiplicity set at pre-compile, set at pre-compile, destination=OsResource  # This reference defines a list of resources accessed by this task.
      container OsTaskAutostart [0..1]  # This container determines whether the task is activated during the system start-up procedure or not for some specific application modes. | If the task shall be activated during the system start-up, this container is present and holds the references to the application modes in which the task is auto-started.
        reference OsTaskAppModeRef: multiplicity set at pre-compile, set at pre-compile, destination=OsAppMode  # Reference to application modes in which that task is activated on startup of the OS
      container OsTaskTimingProtection [0..1]  # This container contains all parameters regarding timing protection of the task.
        float OsTaskAllInterruptLockBudget [0..1]: 0..458129844, scope=ECU, multiplicity set at pre-compile, set at pre-compile, default-value=0  # This parameter contains the maximum time for which the task is allowed to lock all interrupts (via SuspendAllInterrupts() or DisableAllInterrupts()) (in microsecond).
        float OsTaskExecutionBudget [0..1]: 0..458129844, scope=ECU, multiplicity set at pre-compile, set at pre-compile, default-value=0  # This parameter contains the maximum allowed execution time of the task (in microsecond).
        float OsTaskOsInterruptLockBudget [0..1]: 0..458129844, scope=ECU, multiplicity set at pre-compile, set at pre-compile, default-value=0  # This parameter contains the maximum time for which the task is allowed to lock all Category 2 interrupts (via SuspendOSInterrupts()) (in microsecond).
        float OsTaskTimeFrame [0..1]: 0..458129844, scope=ECU, multiplicity set at pre-compile, set at pre-compile, default-value=0  # The minimum inter-arrival time between activations and/or releases of a task (in microsecond).
        container OsTaskResourceLock [0..65535]  # This container contains the worst case time between getting and releasing a given resource (in microsecond).
          float OsTaskResourceLockBudget: 0..458129844, scope=ECU, set at pre-compile  # This parameter contains the maximum time the task is allowed to lock the resource (in microsecond)
          reference OsTaskResourceLockResourceRef: scope=ECU, set at pre-compile, destination=OsResource  # Reference to the resource used by the task
    container OsPublishedInformation [0..65535]  # OsPublishedInformation is used for additional published parameters and information.
      string OsKernelVersion: scope=ECU, multiplicity set at pre-compile, set at pre-compile  # Defines the kernel source code generation.
      string OsPlatformName: scope=ECU, multiplicity set at pre-compile, set at pre-compile, default-value=Platform, max-length=63, min-length=1  # Defines the name of the platform supported with this BSWMD.
      container OsDerivativeInformation [0..1]
        string OsMpuAlignment: multiplicity set at pre-compile, set at pre-compile, default-value=0
        string OsStackAlignment: multiplicity set at pre-compile, set at pre-compile, default-value=0
        container OsPhysicalCore: multiplicity set at pre-compile  # Derivative specific definition of a physical core.
          integer OsPhysicalCoreId: 0..255, multiplicity set at pre-compile, set at pre-compile, default-value=0  # This parameter defines the physical Id of the core.
          container OsPhysicalCoreMpu [0..*]: multiplicity set at pre-compile  # Container to structure all core memory protection unit attributes.
            integer OsPhysicalCoreMpuId: 0..4294967295, multiplicity set at pre-compile, set at pre-compile, default-value=0  # This parameter defines the physical Id of the core MPU.
            string OsPhysicalCoreMpuType [0..1]: multiplicity set at pre-compile, set at pre-compile, default-value=CoreMpu  # Derivative specific type of the core MPU.
            integer OsPhysicalCoreMpuMaxRegions: 0..4294967295, multiplicity set at pre-compile, set at pre-compile, default-value=16  # This parameter specifies the maximum number of regions for the core MPU.
            container OsPhysicalCoreMpuAddress [0..*]: multiplicity set at pre-compile  # Container to define a hardware specific address.
              integer OsPhysicalCoreMpuAddressValue: 0..4294967295, multiplicity set at pre-compile, set at pre-compile, default-value=0  # This parameter specifies a hardware specific address value.
        container OsHardWareTimer [0..255]: multiplicity set at pre-compile
          string OsHardWareTimerChannel: set at pre-compile, max-length=63, min-length=1  # This attribute specifies the macro definition of the timer channel.
          float OsHardWareTimerClockFrequency: 0..Inf, scope=ECU, multiplicity set at pre-compile, set at pre-compile  # Timer clock frequency, MHZ.
        container OsMemoryRegionSpecifics [0..1]: multiplicity set at pre-compile  # Derivative specific settings for a memory protection region.
          container OsMemoryRegionAccess [1..*]: multiplicity set at pre-compile
            enumeration OsMemoryRegionAccessRights: {NONE, R, W, X, RW, RX, WX, RWX}, multiplicity set at pre-compile, set at pre-compile, default-value=NONE  # Defines the access rights for a memory protection region.NONE: No access rights.R: Read access rights.W: Write access rights.X: Execution access rights
            enumeration OsMemoryRegionAccessType: {SUPERVISOR, USER, PROTECTION_SET0, PROTECTION_SET1, PROTECTION_SET2, PROTECTION_SET3, PROTECTION_SET4, PROTECTION_SET5, PROTECTION_SET6, PROTECTION_SET7}, multiplicity set at pre-compile, set at pre-compile, default-value=SUPERVISOR  # Defines the access type for a memory protection region.
    container OsMemoryProtection [0..1]: multiplicity set at pre-compile  # Container to structure all memory protection relevant configuration parameters.Memory protection is only allowed if OS scalability class is set to SC3 or SC4.
      container OsMemoryRegion [0..*]: multiplicity set at pre-compile  # Container to structure the configuration parameters of one memory protection region.
        string OsMemoryRegionStartAddress: multiplicity set at pre-compile, set at pre-compile  # Start address of a memory protection region. The address can be specified either as a valid decimal (1024) or hexadecimal (0x4000) value, or as a valid linker symbol.StartAddress <= Memory to be accessed
        string OsMemoryRegionEndAddress: multiplicity set at pre-compile, set at pre-compile  # End address of a memory protection region. The address can be specified either as a valid decimal (1024) or hexadecimal (0x4000) value, or as a valid linker symbol.Depending on the underlying hardware:Memory to be accessed <= EndAddress or Memory to be accessed < EndAddress
        integer OsMemoryRegionIdentifier [0..1]: 0..4294967295, multiplicity set at pre-compile, set at pre-compile  # Defines the optional hardware specific memory protection region identifier. The interpretation of this parameter is hardware specific (e.g. PID, ProtectionSet or ASID).
        choice reference OsMemoryRegionOwner [0..1]: multiplicity set at pre-compile, set at pre-compile, destination=[OsApplication, OsIsr, OsTask]  # Specifies whether a memory protection region is OS-Application, Task or ISR specific or Global. Application specific: Add reference to an OsApplication, so the region gets active everytime the configured OS-Application is entered. Task specific: Add reference to an OsTask, so the region gets active everytime the configured Task is entered. ISR specific: Add reference to a category 2 OsIsr, so the region gets active everytime the configured ISR is entered. Global: If no owner (reference) is configured, the region is always active.
        choice reference OsMemoryRegionProtectionUnit: multiplicity set at pre-compile, set at pre-compile, destination=[OsSystemMpu, OsPhysicalCoreMpu]  # References on which memory protection unit (core or system) the memory protection region shall be used.
        reference OsMemoryRegionAccessRights [1..*]: multiplicity set at pre-compile, set at pre-compile, destination=OsMemoryRegionAccess  # This reference is used to set access rights for the memory protection region.
package /AUTOSAR/EcucDestinationUriDefSets
  ecuc destination uri def set RteRipsUriDefSet
    ecuc destination uri def RteRipsInvocationHandler
      destination-uri-policy destination-uri-nesting-contract=TARGET-CONTAINER:
        container RteRipsInvocationHandlerFnc [0..*]  # This container describes an invocation handler function implemented by an RTE Implementation Plug-In to handle the invocation of server runnables and triggered runnables via a transformer. Tags: atp.Status=draft
          function name RteRipsInvocationHandlerFncSymbol  # C-Symbol of the Rte_Rips_FillFlushRoutine function. Tags: atp.Status=draft
    ecuc destination uri def RteRipsPlugin
      destination-uri-policy destination-uri-nesting-contract=TARGET-CONTAINER:
        container RteRipsPluginProps  # This container defines the identity of the Rte Implementation Plug-in and provides the RTE relevant parameters of the Rte Implementation Plug-in. Tags: atp.Status=draft | The shortName of the container defines the name of the Rte Implementation Plug-in used for the API infixes.
          boolean RtePluginSupportsIReadIWrite: default-value=false  # Denotes if or if not the plug-in supports the Rte_Rips_IRead/IWrite macros for primitive data. Tags: atp.Status=draft
          enumeration RteRipsGlobalCopyInstantiationPolicy: {RTE_RIPS_INSTANTIATION_BY_PLUGIN, RTE_RIPS_INSTANTIATION_BY_RTE}, default-value=RTE_RIPS_INSTANTIATION_BY_RTE  # Globally enables or disables the support for Rte Implementation Plug-Ins (RIPS) Tags: atp.Status=draft
    ecuc destination uri def RteRipsPluginFillFlushRoutine
      destination-uri-policy destination-uri-nesting-contract=TARGET-CONTAINER:
        container RteRipsPluginFillFlushRoutineFnc [0..*]  # This container describes a Fill-Flush Routine function implemented by a RTE Implementation Plug-In to handle the buffering for implicit communication. Tags: atp.Status=draft
          enumeration RteRipsModeDisablingHandling: {RTE_RIPS_CONSIDER_MODE_DISABLINGS, RTE_RIPS_IGNORE_MODE_DISABLINGS}  # This parameter configures whether mode disabling dependencies are considered for the invocation of Rte_Rips_FillFlushRoutines. Tags: atp.Status=draft
          enumeration RteRipsOsSchedulePoint [0..1]: {NONE, UNCONDITIONAL}  # Introduce a schedule point by explicitly calling Os Schedule service after the execution of the Rte_Rips_FillFlushRoutine. Tags: atp.Status=draft
          function name RteRipsPluginFillFlushRoutineFncSymbol  # C-Symbol of the Rte_Rips_FillFlushRoutine function. Tags: atp.Status=draft
package /AUTOSAR/LifeCycleInfoSets
  life cycle info set AUTOSARParameterDefinition
    life-cycle-infos:
      lc-object=AdcGroupEcucPartitionRef, lc-state=draft
      lc-object=AdcEcucPartitionRef, lc-state=draft
      lc-object=AdcKernelEcucPartitionRef, lc-state=draft
      lc-object=ArtiConstant, lc-state=draft
      lc-object=ArtiConstantString, lc-state=draft
      lc-object=ArtiExpression, lc-state=draft
      lc-object=ArtiExpressionString, lc-state=draft
      lc-object=ArtiHook, lc-state=draft
      lc-object=ArtiHookClass, lc-state=draft
      lc-object=ArtiHookEventName, lc-state=draft
      lc-object=ArtiHookInstance, lc-state=draft
      lc-object=ArtiHookEventParameterTypeRef, lc-state=draft
      lc-object=ArtiHookInstanceParameterTypeRef, lc-state=draft
      lc-object=ArtiObjectClassParameter, lc-state=draft
      lc-object=ArtiParameterTypeMapRef, lc-state=draft
      lc-object=ArtiObjectInstanceParameter, lc-state=draft
      lc-object=ArtiConstantRef, lc-state=draft
      lc-object=ArtiExpressionRef, lc-state=draft
      lc-object=ArtiHookRef, lc-state=draft
      lc-object=ArtiParameterTypeMap, lc-state=draft
      lc-object=ArtiParameterTypeMapPair, lc-state=draft
      lc-object=ArtiParameterTypeMapPairInput, lc-state=draft
      lc-object=ArtiParameterTypeMapPairOutput, lc-state=draft
      lc-object=ArtiGenericComponentClass, lc-state=draft
      lc-object=ArtiGenericComponentClassName, lc-state=draft
      lc-object=ArtiGenericComponentClassParameter, lc-state=draft
      lc-object=ArtiGenericComponentClassParameterName, lc-state=draft
      lc-object=ArtiParameterTypeMapRef, lc-state=draft
      lc-object=ArtiGenericComponentInstance, lc-state=draft
      lc-object=ArtiGenericComponentInstanceName, lc-state=draft
      lc-object=ArtiGenericComponentClassRef, lc-state=draft
      lc-object=ArtiGenericComponentInstanceParameter, lc-state=draft
      lc-object=ArtiConstantRef, lc-state=draft
      lc-object=ArtiExpressionRef, lc-state=draft
      lc-object=ArtiGenericComponentClassParameterRef, lc-state=draft
      lc-object=ArtiHookRef, lc-state=draft
      lc-object=ArtiHwCoreClass, lc-state=draft
      lc-object=ArtiCurrentApplicationClassRef, lc-state=draft
      lc-object=ArtiCurrentTaskClassRef, lc-state=draft
      lc-object=ArtiLastErrorClassRef, lc-state=draft
      lc-object=ArtiHwCoreInstance, lc-state=draft
      lc-object=ArtiCurrentApplicationInstanceRef, lc-state=draft
      lc-object=ArtiCurrentTaskInstanceRef, lc-state=draft
      lc-object=ArtiEcucCoreRef, lc-state=draft
      lc-object=ArtiLastErrorInstanceRef, lc-state=draft
      lc-object=ArtiOsClass, lc-state=draft
      lc-object=ArtiOsAppModeClassRef, lc-state=draft
      lc-object=ArtiOsInstance, lc-state=draft
      lc-object=ArtiOsAppModeEcucRef, lc-state=draft
      lc-object=ArtiOsAppModeInstanceRef, lc-state=draft
      lc-object=ArtiOsEcucRef, lc-state=draft
      lc-object=ArtiOsTaskHookRef, lc-state=draft
      lc-object=ArtiOsTaskClass, lc-state=draft
      lc-object=ArtiOsTaskInstance, lc-state=draft
      lc-object=ArtiGenericComponentInstanceRef, lc-state=draft
      lc-object=ArtiOsTaskEcucRef, lc-state=draft
      lc-object=CanControllerEcucPartitionRef, lc-state=draft
      lc-object=CanTTControllerEcucPartitionRef, lc-state=draft
      lc-object=CanEcucPartitionRef, lc-state=draft
      lc-object=CanTSynGlobalTimeSecureTmacLength, lc-state=draft
      lc-object=CanTSynTxTmacCalculated, lc-state=draft
      lc-object=CanTSynGlobalTimeMinMsgGap, lc-state=draft
      lc-object=CanTSynRxTmacValidated, lc-state=draft
      lc-object=CanTrcvChannelEcucPartitionRef, lc-state=draft
      lc-object=CanTrcvEcucPartitionRef, lc-state=draft
      lc-object=CorTstBackgroundEcucPartitionRef, lc-state=draft
      lc-object=CorTstForegroundEcucPartitionRef, lc-state=draft
      lc-object=CorTstEcucPartitionRef, lc-state=draft
      lc-object=CryptoDriverObjectEcucPartitionRef, lc-state=draft
      lc-object=CryptoEcucPartitionRef, lc-state=draft
      lc-object=DemFreezeFrameRecordTrigger, lc-state=draft
      lc-object=DioPortEcucPartitionRef, lc-state=draft
      lc-object=DioChannelEcucPartitionRef, lc-state=draft
      lc-object=DioChannelGroupEcucPartitionRef, lc-state=draft
      lc-object=DioEcucPartitionRef, lc-state=draft
      lc-object=EepEcucPartitionRef, lc-state=draft
      lc-object=EthCtrlEcucPartitionRef, lc-state=draft
      lc-object=EthEcucPartitionRef, lc-state=draft
      lc-object=EthSwtConfigEcucPartitionRef, lc-state=draft
      lc-object=EthSwtEcucPartitionRef, lc-state=draft
      lc-object=EthTSynGlobalTimeSecureTmacLength, lc-state=draft
      lc-object=EthTSynGlobalTimeMinMsgGap, lc-state=draft
      lc-object=EthTSynTxTmacCalculated, lc-state=draft
      lc-object=EthTSynRxTmacValidated, lc-state=draft
      lc-object=EthTrcvConfigEcucPartitionRef, lc-state=draft
      lc-object=EthTrcvEcucPartitionRef, lc-state=draft
      lc-object=FlsEcucPartitionRef, lc-state=draft
      lc-object=FlsTstEcucPartitionRef, lc-state=draft
      lc-object=FrEcucPartitionRef, lc-state=draft
      lc-object=FrCtrlEcucPartitionRef, lc-state=draft
      lc-object=FrTSynGlobalTimeSecureTmacLength, lc-state=draft
      lc-object=FrTSynUseExtendedMsgFormat, lc-state=draft
      lc-object=FrTSynTxTmacCalculated, lc-state=draft
      lc-object=FrTSynGlobalTimeMinMsgGap, lc-state=draft
      lc-object=FrTSynGlobalTimeTmacTimeout, lc-state=draft
      lc-object=FrTSynRxTmacValidated, lc-state=draft
      lc-object=FrTrcvChannelEcucPartitionRef, lc-state=draft
      lc-object=FrTrcvEcucPartitionRef, lc-state=draft
      lc-object=GptChannelEcucPartitionRef, lc-state=draft
      lc-object=GptEcucPartitionRef, lc-state=draft
      lc-object=GptKernelEcucPartitionRef, lc-state=draft
      lc-object=IcuChannelEcucPartitionRef, lc-state=draft
      lc-object=IcuEcucPartitionRef, lc-state=draft
      lc-object=IcuKernelEcucPartitionRef, lc-state=draft
      lc-object=IpduMContainedPduOffset, lc-state=draft
      lc-object=IpduMPduUpdateBitPosition, lc-state=draft
      lc-object=IpduMContainedPduOffset, lc-state=draft
      lc-object=IpduMPduUpdateBitPosition, lc-state=draft
      lc-object=IPDUM_HEADERTYPE_NONE, lc-state=draft
      lc-object=IPDUM_HEADERTYPE_NONE, lc-state=draft
      lc-object=IpduMUnusedAreasDefault, lc-state=draft
      lc-object=LinEcucPartitionRef, lc-state=draft
      lc-object=LinChannelEcucPartitionRef, lc-state=draft
      lc-object=LinTrcvChannelEcucPartitionRef, lc-state=draft
      lc-object=LinTrcvEcucPartitionRef, lc-state=draft
      lc-object=McuEcucPartitionRef, lc-state=draft
      lc-object=OcuChannelEcucPartitionRef, lc-state=draft
      lc-object=OcuEcucPartitionRef, lc-state=draft
      lc-object=OcuKernelEcucPartitionRef, lc-state=draft
      lc-object=PortPinEcucPartitionRef, lc-state=draft
      lc-object=PortEcucPartitionRef, lc-state=draft
      lc-object=PwmChannelEcucPartitionRef, lc-state=draft
      lc-object=PwmEcucPartitionRef, lc-state=draft
      lc-object=PwmKernelEcucPartitionRef, lc-state=draft
      lc-object=RamTstEcucPartitionRef, lc-state=draft
      lc-object=RamTstBlockParamsEcucPartitionRef, lc-state=draft
      lc-object=RteRipsFillRoutineRef, lc-state=draft
      lc-object=RteRipsFlushRoutineRef, lc-state=draft
      lc-object=RteBswExclusiveAreaResponsibleRipsPluginRef, lc-state=draft
      lc-object=RteModeMachineInstanceResponsibleRipsPluginRef, lc-state=draft
      lc-object=RteDSMQResponsibleRipsPluginRef, lc-state=draft
      lc-object=RteRips, lc-state=draft
      lc-object=RteRipsSupport, lc-state=draft
      lc-object=RteRipsPluginConfigurationRef, lc-state=draft
      lc-object=RteRipsFillRoutineRef, lc-state=draft
      lc-object=RteRipsFlushRoutineRef, lc-state=draft
      lc-object=RteRipsInvocationHandlerRef, lc-state=draft
      lc-object=RteExclusiveAreaResponsibleRipsPluginRef, lc-state=draft
      lc-object=RteModeMachineInstanceResponsibleRipsPluginRef, lc-state=draft
      lc-object=SoAdSocketTcpTlsConnectionRef, lc-state=draft
      lc-object=SpiDeviceEcucPartitionRef, lc-state=draft
      lc-object=SpiEcucPartitionRef, lc-state=draft
      lc-object=SpiKernelEcucPartitionRef, lc-state=draft
      lc-object=TcpIpTlsConfig, lc-state=draft
      lc-object=TcpIpTlsMaxConnections, lc-state=draft
      lc-object=TcpIpTlsCsmRandomGenerateJobRef, lc-state=draft
      lc-object=TcpIpTlsCiphersuites, lc-state=draft
      lc-object=TcpIpTlsCertificateIdentity, lc-state=draft
      lc-object=TcpIpTlsServerNameIdentification, lc-state=draft
      lc-object=TcpIpTlsCiphersuiteDefinition, lc-state=draft
      lc-object=TcpIpTlsCiphersuiteId, lc-state=draft
      lc-object=TcpIpTlsCiphersuiteName, lc-state=draft
      lc-object=TcpIpTlsCiphersuitePriority, lc-state=draft
      lc-object=TcpIpTlsUseAEADCipher, lc-state=draft
      lc-object=TcpIpTlsUsePresharedKeys, lc-state=draft
      lc-object=TcpIpTlsUseSecurityExtensionForceMacThenHash, lc-state=draft
      lc-object=TcpIpTlsVersion, lc-state=draft
      lc-object=TcpIpTlsCiphersuiteWorker, lc-state=draft
      lc-object=TcpIpTlsCipherAEADCipherKeyLength, lc-state=draft
      lc-object=TcpIpTlsCipherEncryptKeyLength, lc-state=draft
      lc-object=TcpIpTlsCipherMacKeyLength, lc-state=draft
      lc-object=TcpIpTlsCipherCsmDecryptJobRef, lc-state=draft
      lc-object=TcpIpTlsCipherCsmDecryptKeyRef, lc-state=draft
      lc-object=TcpIpTlsCipherCsmEncryptJobRef, lc-state=draft
      lc-object=TcpIpTlsCipherCsmEncryptKeyRef, lc-state=draft
      lc-object=TcpIpTlsCipherCsmMacGenerateJobRef, lc-state=draft
      lc-object=TcpIpTlsCipherCsmMacGenerateKeyRef, lc-state=draft
      lc-object=TcpIpTlsCipherCsmMacVerifyJobRef, lc-state=draft
      lc-object=TcpIpTlsCipherCsmMacVerifyKeyRef, lc-state=draft
      lc-object=TcpIpTlsCiphersuiteDefinitionRef, lc-state=draft
      lc-object=TcpIpTlsConnectionHandshakeRef, lc-state=draft
      lc-object=TcpIpTlsHandshake, lc-state=draft
      lc-object=TcpIpTlsCsmPRFSupportType, lc-state=draft
      lc-object=TcpIpTlsCsmHashVerifyJobRef, lc-state=draft
      lc-object=TcpIpTlsCsmKeyExchangeCalcPubValJobRef, lc-state=draft
      lc-object=TcpIpTlsCsmKeyExchangeCalcSecretJobRef, lc-state=draft
      lc-object=TcpIpTlsCsmKeyExchangeDecryptJobRef, lc-state=draft
      lc-object=TcpIpTlsCsmKeyExchangeDecryptKeyRef, lc-state=draft
      lc-object=TcpIpTlsCsmKeyExchangeEncryptJobRef, lc-state=draft
      lc-object=TcpIpTlsCsmKeyExchangeEncryptKeyRef, lc-state=draft
      lc-object=TcpIpTlsCsmKeyExchangeKeyRef, lc-state=draft
      lc-object=TcpIpTlsCsmKeyExchangeSignatureGenerateJobRef, lc-state=draft
      lc-object=TcpIpTlsCsmKeyExchangeSignatureGenerateKeyRef, lc-state=draft
      lc-object=TcpIpTlsCsmKeyExchangeSignatureVerifyJobRef, lc-state=draft
      lc-object=TcpIpTlsCsmKeyExchangeSignatureVerifyKeyRef, lc-state=draft
      lc-object=TcpIpTlsCsmMasterSecretKeyRef, lc-state=draft
      lc-object=TcpIpTlsCsmPrfMacJobRef, lc-state=draft
      lc-object=TcpIpTlsCsmPrfMacKeyRef, lc-state=draft
      lc-object=TcpIpTlsPskIdentity, lc-state=draft
      lc-object=TcpIpTlsPresharedKeyIdentity, lc-state=draft
      lc-object=TcpIpTlsPresharedKeyIdentityHint, lc-state=draft
      lc-object=TcpIpTlsPskGetClientKeyIdentityFunc, lc-state=draft
      lc-object=TcpIpTlsPskGetKeyIdentyHintFunc, lc-state=draft
      lc-object=TcpIpTlsPskGetServerKeyIdentityFunc, lc-state=draft
      lc-object=TcpIpTlsPresharedKeyCsmKeyRef, lc-state=draft
      lc-object=TcpIpTlsConnection, lc-state=draft
      lc-object=TcpIpTlsConnectionGetTimeFunc, lc-state=draft
      lc-object=TcpIpTlsConnectionId, lc-state=draft
      lc-object=TcpIpTlsConnectionType, lc-state=draft
      lc-object=TcpIpTlsMaxFragmentLength, lc-state=draft
      lc-object=TcpIpTlsPortAssignment, lc-state=draft
      lc-object=TcpIpTlsUseClientAuthenticationRequest, lc-state=draft
      lc-object=TcpIpTlsUseSecurityExtensionRecordSizeLimit, lc-state=draft
      lc-object=TcpIpTlsCertificateIdentityRef, lc-state=draft
      lc-object=TcpIpTlsConnectionCiphersuiteWorkerRef, lc-state=draft
      lc-object=TcpIpTlsConnectionGroupRef, lc-state=draft
      lc-object=TcpIpTlsConnectionPskIdentityRef, lc-state=draft
      lc-object=TcpIpTlsIpAddressAssignment, lc-state=draft
      lc-object=TcpIpTlsConnectionGroup, lc-state=draft
      lc-object=WEthCtrlEcucPartitionRef, lc-state=draft
      lc-object=WEthEcucPartitionRef, lc-state=draft
      lc-object=WEthTrcvConfigEcucPartitionRef, lc-state=draft
      lc-object=WEthTrcvEcucPartitionRef, lc-state=draft
      lc-object=WdgEcucPartitionRef, lc-state=draft
