AUTOSAR XML (schema 00046)
package /AUTOSAR/EcucDefs
  module definition vcosMtnce [0..1]: variants pre-compile  # Configuration of the vcosMtnce (vcosMtnce routines) module.
    container vcosMtnceDebugger  # General configuration of debug module
      boolean Orti: scope=ECU, set at pre-compile, default-value=false  # Parameter to specify whether dynamic config is supported. | true: Orti interface is supported false: Orti interface is not supported
      boolean Gliwa: scope=ECU, set at pre-compile, default-value=false  # Parameter to specify whether dynamic config is supported. | true: Gliwa is supported false: Gliwa is not supported
      boolean RTT Parameter Generation: scope=ECU, set at pre-compile, default-value=false  # Parameter to specify whether dynamic config is supported. | true: RTT parameter generation is supported false: RTT parameter generation is not supported
      boolean Task Monitor: scope=ECU, set at pre-compile, default-value=false  # Parameter to specify whether dynamic config is supported. | true: Task monitor is supported false: Task monitor is not supported
      boolean Event Monitor: scope=ECU, set at pre-compile, default-value=false  # Parameter to specify whether dynamic config is supported. | true: Event monitor is supported false: Event monitor is not supported
      boolean Runnable Monitor: scope=ECU, set at pre-compile, default-value=false  # Parameter to specify whether dynamic config is supported. | true: Runnable monitor is supported false: Runnable monitor is not supported
      boolean Isr Monitor: scope=ECU, set at pre-compile, default-value=false  # Parameter to specify whether dynamic config is supported. | true: Isr monitor is supported false: Isr monitor is not supported
      boolean Alarm Monitor: scope=ECU, set at pre-compile, default-value=false  # Parameter to specify whether dynamic config is supported. | true: Alarm monitor is supported false: Aalarm monitor is not supported
      boolean Hook Monitor: scope=ECU, set at pre-compile, default-value=false  # Parameter to specify whether dynamic config is supported. | true: Hook monitor is supported false: Hook monitor is not supported
      boolean Interrupt Masking Monitor: scope=ECU, set at pre-compile, default-value=false  # Parameter to specify whether dynamic config is supported. | true: Interrupt masking monitor is supported false: Interrupt masking monitor is not supported
      boolean CPU Usage Monitor: scope=ECU, set at pre-compile, default-value=false  # Parameter to specify whether dynamic config is supported. | true: CPU usage monitor is supported false: CPU usage monitor is not supported
      boolean CPU Average Load Monitor: scope=ECU, set at pre-compile, default-value=false  # Parameter to specify whether dynamic config is supported. | true: CPU average load monitor is supported false: CPU average load monitor is not supported
    container vcosMtnceCoredump  # Coredump Related Configurations / 概述：Coredump相关配置 | Coredump Function Configurations / 概述：Coredump功能配置
      boolean vcosMtnceDataStorageToFlash: scope=ECU, set at pre-compile, default-value=false  # Control whether to store coredump data in flash. / 控制是否将coredump数据存储到flash中。= | true: store to flash is supported false: store to flash is not supported / true: 支持存储到flash中 false: 不支持存储到flash中
      boolean vcosMtnceShowExtendedInfo: scope=ECU, set at pre-compile, default-value=false  # Control whether to print extended context information during exceptions / 控制在异常时是否打印扩展的上下文信息。= | true: Print context information is supported false: Print context information is not supported / true: 支持打印扩展的上下文信息 false: 不支持打印扩展的上下文信息
    container SystemLog  # System Log macros. | Per CPU exactly one Log object has to be defined.
      container VCOS_MODULE_CONFIG_LOG  # Container of Log
        boolean VCOS_MODULE_CONFIG_LOG: scope=ECU, set at pre-compile, default-value=false  # Parameter to specify whether dynamic config is supported. | true: VCOS_MODULE_CONFIG_LOG macro is supported false: VCOS_MODULE_CONFIG_LOG macro is not supported
        boolean VCOS_LOG_CONFIG_MODE_DEFERRED: scope=ECU, set at pre-compile, default-value=false  # Parameter to specify whether dynamic config is supported. | true: VCOS_LOG_CONFIG_MODE_DEFERRED macro is supported false: VCOS_LOG_CONFIG_MODE_DEFERRED macro is not supported
        boolean VCOS_LOG_CONFIG_MODE_IMMEDIATE: scope=ECU, set at pre-compile, default-value=false  # Parameter to specify whether dynamic config is supported. | true: VCOS_LOG_CONFIG_MODE_IMMEDIATE macro is supported false: VCOS_LOG_CONFIG_MODE_IMMEDIATE macro is not supported
        boolean VCOS_LOG_CONFIG_MODE_MINIMAL: scope=ECU, set at pre-compile, default-value=false  # Parameter to specify whether dynamic config is supported. | true: VCOS_LOG_CONFIG_MODE_MINIMAL macro is supported false: VCOS_LOG_CONFIG_MODE_MINIMAL macro is not supported
        boolean VCOS_LOG_CONFIG_RUNTIME_FILTERING: scope=ECU, set at pre-compile, default-value=false  # Parameter to specify whether dynamic config is supported. | true: VCOS_LOG_CONFIG_RUNTIME_FILTERING macro is supported false: VCOS_LOG_CONFIG_RUNTIME_FILTERING macro is not supported
        integer VCOS_LOG_CONFIG_DEFAULT_LEVEL: scope=ECU, set at pre-compile, default-value=3  # This parameter defines the core number..
        integer VCOS_LOG_CONFIG_MAX_LEVEL: scope=ECU, set at pre-compile, default-value=4  # This parameter defines the core number..
        integer VCOS_LOG_CONFIG_DOMAIN_ID: scope=ECU, set at pre-compile, default-value=0  # This parameter defines the core number..
        boolean VCOS_LOG_CONFIG_MODE_OVERFLOW: scope=ECU, set at pre-compile, default-value=false  # Parameter to specify whether dynamic config is supported. | true: VCOS_LOG_CONFIG_MODE_OVERFLOW macro is supported false: VCOS_LOG_CONFIG_MODE_OVERFLOW macro is not supported
        integer VCOS_LOG_CONFIG_PROCESS_TRIGGER_THRESHOLD: scope=ECU, set at pre-compile, default-value=10  # This parameter defines the core number..
        integer VCOS_LOG_CONFIG_BUFFER_SIZE: scope=ECU, set at pre-compile, default-value=2048  # This parameter defines the core number..
        boolean VCOS_LOG_CONFIG_FUNC_NAME_PREFIX_ERR: scope=ECU, set at pre-compile, default-value=false  # Parameter to specify whether dynamic config is supported. | true: VCOS_LOG_CONFIG_FUNC_NAME_PREFIX_ERR macro is supported false: VCOS_LOG_CONFIG_FUNC_NAME_PREFIX_ERR macro is not supported
        boolean VCOS_LOG_CONFIG_FUNC_NAME_PREFIX_WRN: scope=ECU, set at pre-compile, default-value=false  # Parameter to specify whether dynamic config is supported. | true: VCOS_LOG_CONFIG_FUNC_NAME_PREFIX_WRN macro is supported false: VCOS_LOG_CONFIG_FUNC_NAME_PREFIX_WRN macro is not supported
        boolean VCOS_LOG_CONFIG_FUNC_NAME_PREFIX_INF: scope=ECU, set at pre-compile, default-value=false  # Parameter to specify whether dynamic config is supported. | true: VCOS_LOG_CONFIG_FUNC_NAME_PREFIX_INF macro is supported false: VCOS_LOG_CONFIG_FUNC_NAME_PREFIX_INF macro is not supported
        boolean VCOS_LOG_CONFIG_FUNC_NAME_PREFIX_DBG: scope=ECU, set at pre-compile, default-value=false  # Parameter to specify whether dynamic config is supported. | true: VCOS_LOG_CONFIG_FUNC_NAME_PREFIX_DBG macro is supported false: VCOS_LOG_CONFIG_FUNC_NAME_PREFIX_DBG macro is not supported
        boolean VCOS_LOG_CONFIG_BACKEND_SHOW_COLOR: scope=ECU, set at pre-compile, default-value=false  # Parameter to specify whether dynamic config is supported. | true: VCOS_LOG_CONFIG_BACKEND_SHOW_COLOR macro is supported false: VCOS_LOG_CONFIG_BACKEND_SHOW_COLOR macro is not supported
        boolean VCOS_LOG_CONFIG_BACKEND_FORMAT_TIMESTAMP: scope=ECU, set at pre-compile, default-value=false  # Parameter to specify whether dynamic config is supported. | true: VCOS_LOG_CONFIG_BACKEND_FORMAT_TIMESTAMP macro is supported false: VCOS_LOG_CONFIG_BACKEND_FORMAT_TIMESTAMP macro is not supported
        boolean VCOS_LOG_CONFIG_TIMESTAMP_64BIT: scope=ECU, set at pre-compile, default-value=false  # Parameter to specify whether dynamic config is supported. | true: VCOS_LOG_CONFIG_TIMESTAMP_64BIT macro is supported false: VCOS_LOG_CONFIG_TIMESTAMP_64BIT macro is not supported
        integer VCOS_LOG_CONFIG_TIMER_PERIOD: scope=ECU, set at pre-compile, default-value=2000  # This parameter defines the log macro..
    container vcosMtnceLightenedTrace  # LightenedTrace Configurations
      boolean vcosMtnceLightenedTracerEnabled: scope=ECU, set at pre-compile, default-value=false  # Enable LightenedTrace. | true: VCOS_MODULE_CONFIG_LIGHTENED_TRACER macro is supported false: VCOS_MODULE_CONFIG_LIGHTENED_TRACER macro is not supported
      container vcosMtnceSenderBuffer  # Container of SenderBuffer
        integer vcosMtnceSenderBufferMaxCapacity: 128..65535, set at pre-compile, default-value=1024  # The number of Trace Data that a SenderBuffer can hold is defined by the value of this attribute.
        float vcosMtnceSenderBufferTriggerRate: 0.0..1.0, scope=ECU, multiplicity set at pre-compile, set at pre-compile, default-value=0.80  # When SenderBuffer reaches this percentage, trigger the SenderTask
      container vcosMtnceTraceEvents  # Events that would be traced
        boolean vcosMtnceTraceEventsForTasks: scope=ECU, set at pre-compile, default-value=false  # Trace events of tasks | true: VCOS_MODULE_CONFIG_LIGHTENED_TRACER_TASK macro is supported false: VCOS_MODULE_CONFIG_LIGHTENED_TRACER_TASK macro is not supported
        boolean vcosMtnceTraceEventsForISRs: scope=ECU, set at pre-compile, default-value=false  # Trace events of ISRs | true: VCOS_MODULE_CONFIG_LIGHTENED_TRACER_ISR macro is supported false: VCOS_MODULE_CONFIG_LIGHTENED_TRACER_ISR macro is not supported
        boolean vcosMtnceTraceEventsForHooks: scope=ECU, set at pre-compile, default-value=false  # Trace events of Hooks | true: VCOS_MODULE_CONFIG_LIGHTENED_TRACER_HOOK macro is supported false: VCOS_MODULE_CONFIG_LIGHTENED_TRACER_HOOK macro is not supported
