AUTOSAR XML (schema 00048)
package /AURIX2G/EcucDefs/Mcu_ib_bswmd/BswModuleDescriptions
  bsw module description Mcu
    bsw internal behavior McuBehavior
      exclusive area TomTgcReg
      exclusive area AtomAgcReg
