AUTOSAR XML (schema 4-2-2)
package /AURIX2G/EcucDefs
  module definition Fls [0..1]: post-build-variant-support=true, refined-module-def=Fls, variants post-build  # Configuration of the Fls (internal or external flash driver) module.
    container FlsConfigSet  # Container for runtime configuration parameters of the flash driver.
      integer FlsAcErase: 0..4294967295, post-build-variant-value=true, set at post-build, default-value=0  # Address offset in RAM to which the erase flash access code shall be loaded.
      integer FlsAcWrite: 0..4294967295, post-build-variant-value=true, set at post-build, default-value=0  # Address offset in RAM to which the write flash access code shall be loaded.
      float FlsCallCycle: 1.0E-4..1.0, post-build-variant-value=true, set at post-build, default-value=0.01  # Cycle time of calls of the flash driver's main function (in seconds).
      enumeration FlsDefaultMode: {MEMIF_MODE_FAST, MEMIF_MODE_SLOW}, post-build-variant-value=true, set at post-build, default-value=MEMIF_MODE_SLOW  # This parameter is the default FLS device mode after initialization.
      function name FlsJobEndNotification [0..1]: multiplicity set at post-build, post-build-variant-multiplicity=true, post-build-variant-value=true, set at post-build, default-value=Fee_JobEndNotification  # Mapped to the job end notification routine provided by some upper layer module, typically the Fee module.
      function name FlsJobErrorNotification [0..1]: multiplicity set at post-build, post-build-variant-multiplicity=true, post-build-variant-value=true, set at post-build, default-value=Fee_JobErrorNotification  # Mapped to the job error notification routine provided by some upper layer module, typically the Fee module.
      function name FlsEraseVerifyErrNotif [0..1]: multiplicity set at post-build, origin=INFINEON_AURIX2G, set at post-build, default-value=Fee_17_JobEraseErrorNotification  # Mapped to the EVER notification routine provided by some upper layer module, typically the Fee module.
      function name FlsProgVerifyErrNotif [0..1]: multiplicity set at post-build, origin=INFINEON_AURIX2G, set at post-build, default-value=Fee_17_JobProgErrorNotification  # Mapped to the PVER notification routine provided by some upper layer module, typically the Fee module.
      integer FlsMaxReadFastMode: 1..1048576, post-build-variant-value=true, set at post-build, default-value=64  # The maximum number of bytes to read or compare in one cycle of the flash driver's job processing function in fast mode. Note: The value configured for FlsMaxReadFastMode should be more than the value configured for FlsMaxReadNormalMode
      integer FlsMaxReadNormalMode: 1..1048576, post-build-variant-value=true, set at post-build, default-value=32  # The maximum number of bytes to read or compare in one cycle of the flash driver's job processing function in normal mode.
      integer FlsMaxWriteFastMode: 32..32, post-build-variant-value=true, set at post-build, default-value=32  # The maximum number of bytes to write in one cycle of the flash driver's job processing function in fast mode.
      integer FlsMaxWriteNormalMode: 32..32, post-build-variant-value=true, set at post-build, default-value=32  # The maximum number of bytes to write in one cycle of the flash driver's job processing function in normal mode.
      integer FlsProtection: 0..4294967295, post-build-variant-value=true, set at post-build, default-value=0  # Erase/write protection settings. Only relevant if supported by hardware.
      enumeration FlsWaitStateRead: {FLS_17_DMU_WAITSTATE_READ_0, FLS_17_DMU_WAITSTATE_READ_1, FLS_17_DMU_WAITSTATE_READ_2, FLS_17_DMU_WAITSTATE_READ_3, FLS_17_DMU_WAITSTATE_READ_4, FLS_17_DMU_WAITSTATE_READ_5, FLS_17_DMU_WAITSTATE_READ_6, FLS_17_DMU_WAITSTATE_READ_7, FLS_17_DMU_WAITSTATE_READ_8, FLS_17_DMU_WAITSTATE_READ_9, FLS_17_DMU_WAITSTATE_READ_10, FLS_17_DMU_WAITSTATE_READ_11, FLS_17_DMU_WAITSTATE_READ_12, FLS_17_DMU_WAITSTATE_READ_13, FLS_17_DMU_WAITSTATE_READ_14, FLS_17_DMU_WAITSTATE_READ_15, FLS_17_DMU_WAITSTATE_READ_16, FLS_17_DMU_WAITSTATE_READ_17, FLS_17_DMU_WAITSTATE_READ_18, FLS_17_DMU_WAITSTATE_READ_19, FLS_17_DMU_WAITSTATE_READ_20, FLS_17_DMU_WAITSTATE_READ_21, FLS_17_DMU_WAITSTATE_READ_22, FLS_17_DMU_WAITSTATE_READ_23, FLS_17_DMU_WAITSTATE_READ_24, FLS_17_DMU_WAITSTATE_READ_25, FLS_17_DMU_WAITSTATE_READ_26, FLS_17_DMU_WAITSTATE_READ_27, FLS_17_DMU_WAITSTATE_READ_28, FLS_17_DMU_WAITSTATE_READ_29, FLS_17_DMU_WAITSTATE_READ_30, FLS_17_DMU_WAITSTATE_READ_31, FLS_17_DMU_WAITSTATE_READ_32, FLS_17_DMU_WAITSTATE_READ_33, FLS_17_DMU_WAITSTATE_READ_34, FLS_17_DMU_WAITSTATE_READ_35, FLS_17_DMU_WAITSTATE_READ_36, FLS_17_DMU_WAITSTATE_READ_37, FLS_17_DMU_WAITSTATE_READ_38, FLS_17_DMU_WAITSTATE_READ_39, FLS_17_DMU_WAITSTATE_READ_40, FLS_17_DMU_WAITSTATE_READ_41, FLS_17_DMU_WAITSTATE_READ_42, FLS_17_DMU_WAITSTATE_READ_43, FLS_17_DMU_WAITSTATE_READ_44, FLS_17_DMU_WAITSTATE_READ_45, FLS_17_DMU_WAITSTATE_READ_46, FLS_17_DMU_WAITSTATE_READ_47, FLS_17_DMU_WAITSTATE_READ_48, FLS_17_DMU_WAITSTATE_READ_49, FLS_17_DMU_WAITSTATE_READ_50, FLS_17_DMU_WAITSTATE_READ_51, FLS_17_DMU_WAITSTATE_READ_52, FLS_17_DMU_WAITSTATE_READ_53, FLS_17_DMU_WAITSTATE_READ_54, FLS_17_DMU_WAITSTATE_READ_55, FLS_17_DMU_WAITSTATE_READ_56, FLS_17_DMU_WAITSTATE_READ_57, FLS_17_DMU_WAITSTATE_READ_58, FLS_17_DMU_WAITSTATE_READ_59, FLS_17_DMU_WAITSTATE_READ_60, FLS_17_DMU_WAITSTATE_READ_61, FLS_17_DMU_WAITSTATE_READ_62, FLS_17_DMU_WAITSTATE_READ_63, FLS_17_DMU_WAITSTATE_READ_64, FLS_17_DMU_WAITSTATE_READ_65, FLS_17_DMU_WAITSTATE_READ_66, FLS_17_DMU_WAITSTATE_READ_67, FLS_17_DMU_WAITSTATE_READ_68, FLS_17_DMU_WAITSTATE_READ_69, FLS_17_DMU_WAITSTATE_READ_70, FLS_17_DMU_WAITSTATE_READ_71, FLS_17_DMU_WAITSTATE_READ_72, FLS_17_DMU_WAITSTATE_READ_73, FLS_17_DMU_WAITSTATE_READ_74, FLS_17_DMU_WAITSTATE_READ_75, FLS_17_DMU_WAITSTATE_READ_76, FLS_17_DMU_WAITSTATE_READ_77, FLS_17_DMU_WAITSTATE_READ_78, FLS_17_DMU_WAITSTATE_READ_79, FLS_17_DMU_WAITSTATE_READ_80, FLS_17_DMU_WAITSTATE_READ_81, FLS_17_DMU_WAITSTATE_READ_82, FLS_17_DMU_WAITSTATE_READ_83, FLS_17_DMU_WAITSTATE_READ_84, FLS_17_DMU_WAITSTATE_READ_85, FLS_17_DMU_WAITSTATE_READ_86, FLS_17_DMU_WAITSTATE_READ_87, FLS_17_DMU_WAITSTATE_READ_88, FLS_17_DMU_WAITSTATE_READ_89, FLS_17_DMU_WAITSTATE_READ_90, FLS_17_DMU_WAITSTATE_READ_91, FLS_17_DMU_WAITSTATE_READ_92, FLS_17_DMU_WAITSTATE_READ_93, FLS_17_DMU_WAITSTATE_READ_94, FLS_17_DMU_WAITSTATE_READ_95, FLS_17_DMU_WAITSTATE_READ_96, FLS_17_DMU_WAITSTATE_READ_97, FLS_17_DMU_WAITSTATE_READ_98, FLS_17_DMU_WAITSTATE_READ_99, FLS_17_DMU_WAITSTATE_READ_100, FLS_17_DMU_WAITSTATE_READ_101, FLS_17_DMU_WAITSTATE_READ_102, FLS_17_DMU_WAITSTATE_READ_103, FLS_17_DMU_WAITSTATE_READ_104, FLS_17_DMU_WAITSTATE_READ_105, FLS_17_DMU_WAITSTATE_READ_106, FLS_17_DMU_WAITSTATE_READ_107, FLS_17_DMU_WAITSTATE_READ_108, FLS_17_DMU_WAITSTATE_READ_109, FLS_17_DMU_WAITSTATE_READ_110, FLS_17_DMU_WAITSTATE_READ_111, FLS_17_DMU_WAITSTATE_READ_112, FLS_17_DMU_WAITSTATE_READ_113, FLS_17_DMU_WAITSTATE_READ_114, FLS_17_DMU_WAITSTATE_READ_115, FLS_17_DMU_WAITSTATE_READ_116, FLS_17_DMU_WAITSTATE_READ_117, FLS_17_DMU_WAITSTATE_READ_118, FLS_17_DMU_WAITSTATE_READ_119, FLS_17_DMU_WAITSTATE_READ_120, FLS_17_DMU_WAITSTATE_READ_121, FLS_17_DMU_WAITSTATE_READ_122, FLS_17_DMU_WAITSTATE_READ_123, FLS_17_DMU_WAITSTATE_READ_124, FLS_17_DMU_WAITSTATE_READ_125, FLS_17_DMU_WAITSTATE_READ_126, FLS_17_DMU_WAITSTATE_READ_127, FLS_17_DMU_WAITSTATE_READ_128, FLS_17_DMU_WAITSTATE_READ_129, FLS_17_DMU_WAITSTATE_READ_130, FLS_17_DMU_WAITSTATE_READ_131, FLS_17_DMU_WAITSTATE_READ_132, FLS_17_DMU_WAITSTATE_READ_133, FLS_17_DMU_WAITSTATE_READ_134, FLS_17_DMU_WAITSTATE_READ_135, FLS_17_DMU_WAITSTATE_READ_136, FLS_17_DMU_WAITSTATE_READ_137, FLS_17_DMU_WAITSTATE_READ_138, FLS_17_DMU_WAITSTATE_READ_139, FLS_17_DMU_WAITSTATE_READ_140, FLS_17_DMU_WAITSTATE_READ_141, FLS_17_DMU_WAITSTATE_READ_142, FLS_17_DMU_WAITSTATE_READ_143, FLS_17_DMU_WAITSTATE_READ_144, FLS_17_DMU_WAITSTATE_READ_145, FLS_17_DMU_WAITSTATE_READ_146, FLS_17_DMU_WAITSTATE_READ_147, FLS_17_DMU_WAITSTATE_READ_148, FLS_17_DMU_WAITSTATE_READ_149, FLS_17_DMU_WAITSTATE_READ_150, FLS_17_DMU_WAITSTATE_READ_151, FLS_17_DMU_WAITSTATE_READ_152, FLS_17_DMU_WAITSTATE_READ_153, FLS_17_DMU_WAITSTATE_READ_154, FLS_17_DMU_WAITSTATE_READ_155, FLS_17_DMU_WAITSTATE_READ_156, FLS_17_DMU_WAITSTATE_READ_157, FLS_17_DMU_WAITSTATE_READ_158, FLS_17_DMU_WAITSTATE_READ_159, FLS_17_DMU_WAITSTATE_READ_160, FLS_17_DMU_WAITSTATE_READ_161, FLS_17_DMU_WAITSTATE_READ_162, FLS_17_DMU_WAITSTATE_READ_163, FLS_17_DMU_WAITSTATE_READ_164, FLS_17_DMU_WAITSTATE_READ_165, FLS_17_DMU_WAITSTATE_READ_166, FLS_17_DMU_WAITSTATE_READ_167, FLS_17_DMU_WAITSTATE_READ_168, FLS_17_DMU_WAITSTATE_READ_169, FLS_17_DMU_WAITSTATE_READ_170, FLS_17_DMU_WAITSTATE_READ_171, FLS_17_DMU_WAITSTATE_READ_172, FLS_17_DMU_WAITSTATE_READ_173, FLS_17_DMU_WAITSTATE_READ_174, FLS_17_DMU_WAITSTATE_READ_175, FLS_17_DMU_WAITSTATE_READ_176, FLS_17_DMU_WAITSTATE_READ_177, FLS_17_DMU_WAITSTATE_READ_178, FLS_17_DMU_WAITSTATE_READ_179, FLS_17_DMU_WAITSTATE_READ_180, FLS_17_DMU_WAITSTATE_READ_181, FLS_17_DMU_WAITSTATE_READ_182, FLS_17_DMU_WAITSTATE_READ_183, FLS_17_DMU_WAITSTATE_READ_184, FLS_17_DMU_WAITSTATE_READ_185, FLS_17_DMU_WAITSTATE_READ_186, FLS_17_DMU_WAITSTATE_READ_187, FLS_17_DMU_WAITSTATE_READ_188, FLS_17_DMU_WAITSTATE_READ_189, FLS_17_DMU_WAITSTATE_READ_190, FLS_17_DMU_WAITSTATE_READ_191, FLS_17_DMU_WAITSTATE_READ_192, FLS_17_DMU_WAITSTATE_READ_193, FLS_17_DMU_WAITSTATE_READ_194, FLS_17_DMU_WAITSTATE_READ_195, FLS_17_DMU_WAITSTATE_READ_196, FLS_17_DMU_WAITSTATE_READ_197, FLS_17_DMU_WAITSTATE_READ_198, FLS_17_DMU_WAITSTATE_READ_199, FLS_17_DMU_WAITSTATE_READ_200, FLS_17_DMU_WAITSTATE_READ_201, FLS_17_DMU_WAITSTATE_READ_202, FLS_17_DMU_WAITSTATE_READ_203, FLS_17_DMU_WAITSTATE_READ_204, FLS_17_DMU_WAITSTATE_READ_205, FLS_17_DMU_WAITSTATE_READ_206, FLS_17_DMU_WAITSTATE_READ_207, FLS_17_DMU_WAITSTATE_READ_208, FLS_17_DMU_WAITSTATE_READ_209, FLS_17_DMU_WAITSTATE_READ_210, FLS_17_DMU_WAITSTATE_READ_211, FLS_17_DMU_WAITSTATE_READ_212, FLS_17_DMU_WAITSTATE_READ_213, FLS_17_DMU_WAITSTATE_READ_214, FLS_17_DMU_WAITSTATE_READ_215, FLS_17_DMU_WAITSTATE_READ_216, FLS_17_DMU_WAITSTATE_READ_217, FLS_17_DMU_WAITSTATE_READ_218, FLS_17_DMU_WAITSTATE_READ_219, FLS_17_DMU_WAITSTATE_READ_220, FLS_17_DMU_WAITSTATE_READ_221, FLS_17_DMU_WAITSTATE_READ_222, FLS_17_DMU_WAITSTATE_READ_223, FLS_17_DMU_WAITSTATE_READ_224, FLS_17_DMU_WAITSTATE_READ_225, FLS_17_DMU_WAITSTATE_READ_226, FLS_17_DMU_WAITSTATE_READ_227, FLS_17_DMU_WAITSTATE_READ_228, FLS_17_DMU_WAITSTATE_READ_229, FLS_17_DMU_WAITSTATE_READ_230, FLS_17_DMU_WAITSTATE_READ_231, FLS_17_DMU_WAITSTATE_READ_232, FLS_17_DMU_WAITSTATE_READ_233, FLS_17_DMU_WAITSTATE_READ_234, FLS_17_DMU_WAITSTATE_READ_235, FLS_17_DMU_WAITSTATE_READ_236, FLS_17_DMU_WAITSTATE_READ_237, FLS_17_DMU_WAITSTATE_READ_238, FLS_17_DMU_WAITSTATE_READ_239, FLS_17_DMU_WAITSTATE_READ_240, FLS_17_DMU_WAITSTATE_READ_241, FLS_17_DMU_WAITSTATE_READ_242, FLS_17_DMU_WAITSTATE_READ_243, FLS_17_DMU_WAITSTATE_READ_244, FLS_17_DMU_WAITSTATE_READ_245, FLS_17_DMU_WAITSTATE_READ_246, FLS_17_DMU_WAITSTATE_READ_247, FLS_17_DMU_WAITSTATE_READ_248, FLS_17_DMU_WAITSTATE_READ_249, FLS_17_DMU_WAITSTATE_READ_250, FLS_17_DMU_WAITSTATE_READ_251, FLS_17_DMU_WAITSTATE_READ_252, FLS_17_DMU_WAITSTATE_READ_253, FLS_17_DMU_WAITSTATE_READ_254, FLS_17_DMU_WAITSTATE_READ_255}, origin=INFINEON_AURIX2G, post-build-variant-value=true, set at post-build, default-value=FLS_17_DMU_WAITSTATE_READ_9  # Defines Wait State Configuration for read access from DFLASH.
      enumeration FlsWaitStateErrorCorrection: {FLS_17_DMU_WAITSTATE_ERRCOREC_0, FLS_17_DMU_WAITSTATE_ERRCOREC_1, FLS_17_DMU_WAITSTATE_ERRCOREC_2, FLS_17_DMU_WAITSTATE_ERRCOREC_3, FLS_17_DMU_WAITSTATE_ERRCOREC_4, FLS_17_DMU_WAITSTATE_ERRCOREC_5, FLS_17_DMU_WAITSTATE_ERRCOREC_6, FLS_17_DMU_WAITSTATE_ERRCOREC_7}, origin=INFINEON_AURIX2G, post-build-variant-value=true, set at post-build, default-value=FLS_17_DMU_WAITSTATE_ERRCOREC_1  # Defines Wait State Configuration for error correction
      container FlsDemEventParameterRefs [0..1]: multiplicity set at post-build  # Container for the references to DemEventParameter elements which shall be invoked using the Dem_ReportErrorStatus API in case the corresponding error occurs. The EventId is taken from the referenced DemEventParameter's DemEventId value. The standardized errors are provided in the container and can be extended by vendor specific error references. Tags: atp.Status=obsolete, atp.StatusComment=This container is set to obsolete and will be removed in release 4.3., atp.StatusRevisionBegin=4.2.2
        symbolic name reference FLS_E_COMPARE_FAILED [0..1]: multiplicity set at post-build, post-build-variant-multiplicity=true, post-build-variant-value=true, set at post-build, destination=DemEventParameter  # Reference to the DemEventParameter which shall be issued when the error "Flash compare failed (HW)" has occurred. Tags: atp.Status=obsolete, atp.StatusComment=This reference is set to obsolete and will be removed in release 4.3., atp.StatusRevisionBegin=4.2.2
        symbolic name reference FLS_E_ERASE_FAILED [0..1]: multiplicity set at post-build, post-build-variant-multiplicity=true, post-build-variant-value=true, set at post-build, destination=DemEventParameter  # Reference to the DemEventParameter which shall be issued when the error "Flash erase failed (HW)" has occurred. Tags: atp.Status=obsolete, atp.StatusComment=This reference is set to obsolete and will be removed in release 4.3., atp.StatusRevisionBegin=4.2.2
        symbolic name reference FLS_E_READ_FAILED [0..1]: multiplicity set at post-build, post-build-variant-multiplicity=true, post-build-variant-value=true, set at post-build, destination=DemEventParameter  # Reference to the DemEventParameter which shall be issued when the error "Flash read failed (HW)" has occurred. Tags: atp.Status=obsolete, atp.StatusComment=This reference is set to obsolete and will be removed in release 4.3., atp.StatusRevisionBegin=4.2.2
        symbolic name reference FLS_E_UNEXPECTED_FLASH_ID [0..1]: multiplicity set at post-build, post-build-variant-multiplicity=true, post-build-variant-value=true, set at post-build, destination=DemEventParameter  # Reference to the DemEventParameter which shall be issued when the error "Expected hardware ID not matched" has occurred. Tags: atp.Status=obsolete, atp.StatusComment=This reference is set to obsolete and will be removed in release 4.3., atp.StatusRevisionBegin=4.2.2
        symbolic name reference FLS_E_WRITE_FAILED [0..1]: multiplicity set at post-build, post-build-variant-multiplicity=true, post-build-variant-value=true, set at post-build, destination=DemEventParameter  # Reference to the DemEventParameter which shall be issued when the error "Flash write failed (HW)" has occurred. Tags: atp.Status=obsolete, atp.StatusComment=This reference is set to obsolete and will be removed in release 4.3., atp.StatusRevisionBegin=4.2.2
      container FlsExternalDriver [0..1]: multiplicity set at pre-compile  # This container is present for external Flash drivers only. Internal Flash drivers do not use the parameter listed in this container, hence its multiplicity is 0 for internal drivers.
        symbolic name reference FlsSpiReference [1..*]: multiplicity set at pre-compile, set at pre-compile, destination=SpiSequence  # Reference to SPI sequence (required for external Flash drivers).
      container FlsSectorList  # List of flashable sectors and pages.
        container FlsSector [1..*]: multiplicity set at pre-compile  # Configuration description of a flashable sector
          integer FlsNumberOfSectors: 1..2, set at pre-compile, default-value=2  # Number of continuous sectors with identical values for FlsSectorSize and
          integer FlsPageSize: 8..8, set at pre-compile, default-value=8  # Size of one page of this sector.
          integer FlsSectorSize: 4096..1048576, set at pre-compile, default-value=524288  # Size of this sector.
          integer FlsSectorStartaddress: 0..1044480, set at pre-compile, default-value=0  # Start address of this sector.
    container FlsGeneral  # Container for general parameters of the flash driver. These parameters are always pre-compile.
      boolean FlsAcLoadOnJobStart: set at pre-compile, default-value=false  # The flash driver shall load the flash access code to RAM whenever an erase or write job is started and unload (overwrite) it after that job has been finished or canceled.
      integer FlsBaseAddress: 2936012800..2936012800, set at pre-compile, default-value=2936012800  # The flash memory start address (see also SWS_Fls_00208 and SWS_Fls_00209).
      boolean FlsBlankCheckApi: set at pre-compile, default-value=false  # Compile switch to enable/disable the Fls_BlankCheck function.
      boolean FlsInitCheckApi: origin=INFINEON_AURIX2G, set at pre-compile, default-value=false  # Adds / removes the service Fls_17_Dmu_InitCheck() from the code. true: Fls_17_Dmu_InitCheck() can be used. false: Fls_17_Dmu_InitCheck() can not be used.
      boolean FlsEccErrorInfoApi: origin=INFINEON_AURIX2G, set at pre-compile, default-value=false  # This parameter is used to enable or disable the service/API to get the page address of the most recent ECC error that occurred. true: Fls_17_Dmu_GetEccErrorPageAddress() can be used. false: Fls_17_Dmu_GetEccErrorPageAddress() can not be used.
      boolean FlsCancelApi: set at pre-compile, default-value=false  # Compile switch to enable and disable the Fls_Cancel function.
      boolean FlsCompareApi: set at pre-compile, default-value=false  # Compile switch to enable and disable the Fls_Compare function.
      boolean FlsDevErrorDetect: set at pre-compile, default-value=false  # Switches the Default Error Tracer (Det) detection and notification ON or OFF.
      boolean FlsRunTimeErrorDetect: origin=INFINEON_AURIX2G, set at pre-compile, default-value=true  # Switches the Runtime Error Tracer detection and notification ON or OFF.
      boolean FlsSafetyEnable: origin=INFINEON_AURIX2G, set at pre-compile, default-value=true  # Switch to enable/disable the Safety Error.
      boolean FlsIfxFeeUse: origin=INFINEON_AURIX2G, set at pre-compile, default-value=true  # Enables/Disables the use of IFX FEE functions.
      integer FlsDriverIndex: 0..254, scope=ECU, set at pre-compile, symbolic-name-value=true, default-value=0  # Index of the driver, used by FEE.
      boolean FlsGetJobResultApi: set at pre-compile, default-value=false  # Compile switch to enable and disable the Fls_GetJobResult function.
      boolean FlsGetStatusApi: set at pre-compile, default-value=false  # Compile switch to enable and disable the Fls_GetStatus function.
      boolean FlsSetModeApi: set at pre-compile, default-value=false  # Compile switch to enable and disable the Fls_SetMode function.
      integer FlsTotalSize: 4096..1048576, set at pre-compile, default-value=1048576  # The total amount of flash memory in bytes (see also SWS_Fls_00208 and SWS_Fls_00209).
      boolean FlsUseInterrupts: set at pre-compile, default-value=false  # Job processing triggered by hardware interrupt.
      boolean FlsVersionInfoApi: set at pre-compile, default-value=false  # Pre-processor switch to enable / disable the API to read out the modules version information.
      enumeration FlsInitApiMode: {FLS_17_DMU_MCAL_SUPERVISOR, FLS_17_DMU_MCAL_USER1}, origin=INFINEON_AURIX2G, set at pre-compile, default-value=FLS_17_DMU_MCAL_SUPERVISOR  # This parameter selects the operating modes for FlexRay initialization
      enumeration FlsRuntimeApiMode: {FLS_17_DMU_MCAL_SUPERVISOR, FLS_17_DMU_MCAL_USER1}, origin=INFINEON_AURIX2G, set at pre-compile, default-value=FLS_17_DMU_MCAL_SUPERVISOR  # This parameter selects the operating modes for FlexRay initialization
    container FlsPublishedInformation  # Additional published parameters not covered by CommonPublishedInformation container.
      integer FlsAcLocationErase: 0..4294967295, set at published-information, default-value=0  # Position in RAM, to which the erase flash access code has to be loaded.
      integer FlsAcLocationWrite: 0..4294967295, set at published-information, default-value=0  # Position in RAM, to which the write flash access code has to be loaded.
      integer FlsAcSizeErase: 0..4294967295, set at published-information, default-value=0  # Number of bytes in RAM needed for the erase flash access code.
      integer FlsAcSizeWrite: 0..4294967295, set at published-information, default-value=0  # Number of bytes in RAM needed for the write flash access code.
      float FlsEraseTime: 0.0..4.294967295E9, set at published-information, default-value=1897500  # Maximum time to erase one complete flash sector.
      integer FlsErasedValue: 0..4294967295, set at published-information, default-value=0  # The contents of an erased flash memory cell.
      string FlsExpectedHwId: set at published-information, default-value=0  # Unique identifier of the hardware device that is expected by this driver (the device for which this driver has been implemented).
      integer FlsSpecifiedEraseCycles: 0..4294967295, set at published-information, default-value=125000  # Number of erase cycles specified for the flash device (usually given in the device data sheet).
      float FlsWriteTime: 0.0..4.294967295E9, set at published-information, default-value=5154  # Maximum time to program one complete flash page.
    container FlsIfxSpecificConfig  # This container is used to provide the Ifx specific parameters.
      string FlsStateVarStruct: origin=INFINEON_AURIX2G, post-build-variant-value=true, set at post-build, default-value=FlsStateVar  # This parameter is used to provide the name of the structure containing the entire global variables specific to the Flash driver.
      boolean FlsUseEraseSuspend: origin=INFINEON_AURIX2G, set at pre-compile, default-value=false  # Compile switch to enable or disable the FLS erase suspend and erase resume feature
      integer FlsEraseSuspendTimeout: 12000..65535, origin=INFINEON_AURIX2G, set at pre-compile, default-value=12000  # Timeout for Erase Suspend feature(loop count).
      function name FlsIllegalStateNotification: origin=INFINEON_AURIX2G, set at pre-compile, default-value=NULL_PTR  # This parameter is a pointer to a notification function, which is called when FLS reaches an Illegal state. Illegal state here means that FLS is not able to proceed. No more FLS request shall be triggered; Reset of the system is recommended.
    container CommonPublishedInformation  # Common container, aggregated by all modules. It contains published information about vendor and versions.
      integer ArMajorVersion: 0..255, origin=INFINEON_AURIX2G, set at published-information, default-value=4  # Major version number of AUTOSAR specification on which the appropriate implementation is based on.
      integer ArMinorVersion: 0..255, origin=INFINEON_AURIX2G, set at published-information, default-value=2  # Minor version number of AUTOSAR specification on which the appropriate implementation is based on.
      integer ArPatchVersion: 0..255, origin=INFINEON_AURIX2G, set at published-information, default-value=2  # Patch level version number of AUTOSAR specification on which the appropriate implementation is based on.
      integer SwMajorVersion: 0..255, origin=INFINEON_AURIX2G, set at published-information, default-value=20  # Major version number of the vendor specific implementation of the module. The numbering is vendor specific.
      integer SwMinorVersion: 0..255, origin=INFINEON_AURIX2G, set at published-information, default-value=10  # Minor version number of the vendor specific implementation of the module. The numbering is vendor specific.
      integer SwPatchVersion: 0..255, origin=INFINEON_AURIX2G, set at published-information, default-value=0  # Patch level version number of the vendor specific implementation of the module. The numbering is vendor specific.
      integer ModuleId: 0..65535, origin=INFINEON_AURIX2G, set at published-information, default-value=92  # Module ID of this module from Module List
      integer VendorId: 0..65535, origin=INFINEON_AURIX2G, set at published-information, default-value=17  # Vendor ID of the dedicated implementation of this module according to the AUTOSAR vendor list
      string VendorApiInfix: origin=INFINEON_AURIX2G, set at published-information, default-value=Dmu  # In driver modules which can be instantiated several times on a single ECU, BSW00347 requires that the name of APIs is extended by the VendorId and a vendor specific name. This parameter is used to specify the vendor specific name. In total, the implementation specific name is generated as follows: <ModuleName>_>VendorId>_<VendorApiInfix><Api name from SWS>
      string Release: origin=INFINEON_AURIX2G, set at published-information, default-value=_TRICORE_TC397  # Aurix2G derivative used for the implementation
