AUTOSAR XML (schema 00048)
package /AURIX2G/EcucDefs/Can_ib_bswmd/BswModuleDescriptions
  bsw module description Can
    bsw internal behavior CanBehavior
      exclusive area CanIntCtrl
      exclusive area CanWrMO
      exclusive area IcomMsgCntrVal
