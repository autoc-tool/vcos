AUTOSAR XML (schema 00048)
package /AURIX2G/EcucDefs/Spi_ib_bswmd/BswModuleDescriptions
  bsw module description Spi
    bsw internal behavior SpiBehavior
      exclusive area ChannelLock
      exclusive area SyncLock
      exclusive area Queue_Update
