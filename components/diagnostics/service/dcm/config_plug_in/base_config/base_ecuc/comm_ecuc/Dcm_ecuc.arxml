AUTOSAR XML (schema 00046)
package /ActiveEcuC
  module config Dcm: implementation-config-variant=VARIANT-PRE-COMPILE
    DcmConfigSet
    DcmGeneral:
      DcmDDDIDStorage = false
      DcmDevErrorDetect = false
      DcmRespondAllRequest = false
      DcmVersionInfoApi = false
      DcmTaskTime = 0.01
      DcmHeaderFileInclusion = Dcm_Callout_Stubs.h
      DcmVinRef = <empty>
