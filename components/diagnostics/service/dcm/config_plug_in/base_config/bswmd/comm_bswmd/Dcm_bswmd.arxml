[part 1 of 2: package /AUTOSAR/EcucDefs]
AUTOSAR XML (schema 00046)
package /AUTOSAR/EcucDefs
  module definition Dcm [0..1]: post-build-variant-support=true, variants link-time/post-build/pre-compile  # Configuration of the Dcm (Diagnostic Communications Manager) module. / 概述：Dcm（Diagnostic Communication Manager）是AUTOSAR中负责管理车辆诊断通信的模块，它支持不同的诊断协议并处理来自外部测试设备的诊断请求。 注意：在配置Dcm模块时，需要确保其与ECU的诊断需求和支持的诊断协议相匹配；Dcm配置参数必须符合AUTOSAR CP 4.4标准中定义的属性和结构；在多ECU系统中，应注意Dcm的网络管理和会话控制策略，以保证诊断通信的正确性和高效性。
    container DcmConfigSet  # This container contains the configuration parameters and sub containers of the DCM module supporting multiple configuration sets. / 概述：DcmConfigSet是用于定义诊断通信管理器（Diagnostic Communication Manager）的配置集，包括诊断服务、会话控制、安全访问等相关参数的设置，以支持车辆的诊断通信需求。 注意：在配置DcmConfigSet时，需要确保所有诊断服务的参数与车辆的诊断需求相匹配；对于安全访问和会话控制的配置，应考虑其对车辆安全性的影响；AUTOSAR CP 4.4标准中对诊断服务的配置和管理提供了详细的指导，应遵循这些指导以确保配置的正确性和有效性。
      container DcmDsd  # These parameters configure the Diagnostic Service Dispatcher submodule. / 概述：DcmDsd（Diagnostic Session Dictionary）是AUTOSAR诊断通信管理器（Diagnostic Communication Manager）的配置项，用于定义诊断服务表，包括服务标识符、子功能以及对应的处理函数。 注意：在配置DcmDsd时，必须确保每个诊断服务的标识符和子功能的组合是唯一的，以避免在诊断会话中的冲突；应当根据实际的车辆诊断需求来配置DcmDsd，确保所有必要的诊断服务都被正确定义；在AUTOSAR CP 4.4标准中，DcmDsd的配置应当遵循模块的最新规范，包括对服务处理函数的引用和诊断服务的权限管理。
        container DcmDsdServiceRequestManufacturerNotification [0..*]: requires-index=true  # The name of this container is used to define the name of the R-Port through which the DCM accesses the interface ServiceRequestNotification. / 概述：DcmDsdServiceRequestManufacturerNotification配置项用于定义在执行诊断服务请求时，如何通知制造商特定的软件模块。 注意：在配置此项时，需要确保通知机制与制造商的软件模块兼容；此配置项应与诊断服务表（DSD）中的其他配置保持一致；在实施时应注意不同OEM的特定要求和标准。 | The R-Port is named ServiceRequestManufacturerNotification_{Name} where {Name} is the name of the container DcmDsdServiceRequestManufacturerNotification. The lowerMultiplicity is 0: If container DcmDsdServiceRequestManufacturerNotification does not exist the Indication API is not available.
        container DcmDsdServiceRequestSupplierNotification [0..*]: requires-index=true  # The name of this container is used to define the name of the R-Port through which the DCM accesses the interface ServiceRequestNotification. / 概述：DcmDsdServiceRequestSupplierNotification配置项用于定义诊断服务分发（DSD）模块在接收到服务请求后，如何通知供应商（即服务处理模块）。 注意：在AUTOSAR CP 4.4标准中，确保通知机制与诊断服务处理模块的实现相兼容；通知策略应当支持同步和异步两种模式，以适应不同的服务处理需求；配置时应注意不同服务请求对通知时序和性能的影响。 | The R-Port is named ServiceRequestSupplierNotification_<SWC> where <SWC> is the name of the container DcmDsdServiceRequestSupplierNotification. The lowerMultiplicity is 0: If the container DcmDsdRequestSupplierNotification does not exist the Indication API is not available.
        container DcmDsdServiceTable [1..256]  # This container contains the configuration (DSD parameters) for a Service Identifier Table. / 概述：DcmDsdServiceTable配置项用于定义诊断服务分发表，它指定了哪些诊断服务（通过服务标识符）被分配到哪个诊断服务分发器（DSD）下，以及它们对应的处理函数。 注意：确保每个服务标识符在DcmDsdServiceTable中唯一，以避免服务处理的冲突；在配置服务处理函数时，需考虑其执行时间，以满足系统的实时性要求；AUTOSAR CP 4.4标准中对服务的分发有明确规范，需要确保配置与标准一致。 | Note: It is allowed to add OBD services to a DcmDsdServiceTable related to a UDS Protocol. But it is not allowed to add UDS services to a DcmDsdServiceTable related to an OBD Protocol.
          integer DcmDsdSidTabId: 0..255, scope=ECU, set at link in variant link-time / pre-compile in variant post-build+pre-compile  # Due to using possibly more service tables, the unique DcmDsdSidTabId can be used to identify them. / 概述：DcmDsdSidTabId 是用于标识诊断服务表（Diagnostic Service Table）的唯一标识符，它关联了一组特定的服务识别符（Service Identifier, SID）和对应的诊断服务处理程序。 注意：在配置DcmDsdSidTabId时，必须确保每个诊断服务表的标识符是唯一的，以避免在诊断会话中的冲突；此外，该标识符通常由诊断配置工具自动生成，应避免手动修改以防止潜在的配置错误；在整个诊断系统中，应保持对应关系的一致性，确保诊断请求能够被正确解析和处理。
          container DcmDsdService [1..255]  # This container contains the configuration (DSD parameters) for a Service. / 概述：DcmDsdService配置项定义了诊断服务调度层（Diagnostic Service Dispatcher）中的一个诊断服务，包括服务标识符（Service Identifier）和该服务所关联的子功能。 注意：在配置DcmDsdService时，需要确保服务标识符的唯一性，避免与其他诊断服务冲突；还需关联正确的诊断服务处理器（Service Handler）和子功能，以保证诊断请求能够被正确处理；此外，应考虑服务的安全访问权限，确保只有在适当的诊断会话和安全等级下才能访问该服务。
            boolean DcmDsdServiceUsed: post-build-variant-value=true, set at link in variant link-time / post-build in variant post-build / pre-compile in variant pre-compile, default-value=true  # Allows to activate or deactivate the usage of a Service. This parameter can be used for multi-purpose ECUs. / 概述：DcmDsdServiceUsed是一个配置参数，用于定义诊断服务调度器（Diagnostic Service Dispatcher）中所使用的诊断服务。 注意：在配置DcmDsdServiceUsed时，需要确保只有在DcmDsd中声明的服务才能被使用；此外，每个服务应当与正确的子功能和请求长度匹配；最后，确保服务的安全访问权限设置符合项目的安全需求。 | true - service is available false - service is not available
            boolean DcmDsdSidTabSubfuncAvail: scope=ECU, set at link in variant link-time / pre-compile in variant post-build+pre-compile  # Information about whether the service has subfunctions or not. This parameter is used for the handling of the "suppressPosRspMsgIndicationBit" as defined in ISO 14229-1, which can be used as a reference for the configuration. / 概述：DcmDsdSidTabSubfuncAvail配置项用于定义在诊断服务表中，特定服务标识符（SID）下支持的子功能的可用性。 注意：在配置子功能可用性时，需要确保只有那些确实由ECU支持的子功能被标记为可用；不正确的配置可能导致诊断工具无法正确与ECU通信；在AUTOSAR CP 4.4标准中，应当遵循相关的诊断协议标准（如ISO 14229）来配置子功能的可用性。 | true - service has subfunctions, suppressPosRspMsgIndicationBit is available false - service has no subfunctions, suppressPosRspMsgIndicationBit is not available
            function name DcmDsdSidTabFnc [0..1]: scope=ECU, multiplicity set at link in variant link-time / pre-compile in variant post-build+pre-compile, set at link in variant link-time / pre-compile in variant post-build+pre-compile  # Callback function of the ECU Supplier specific component for the particular service. The function's prototype is as described for <Module>_<DiagnosticService>. If this parameter is not configured, the service is handled Dcm-internally. / 概述：DcmDsdSidTabFnc配置项用于定义诊断服务表中服务标识符（SID）对应的功能处理函数，它指定了当接收到特定SID时，应当调用的函数。 注意：在配置DcmDsdSidTabFnc时，需要确保每个服务标识符对应一个唯一的功能处理函数；处理函数需要符合AUTOSAR标准中定义的接口要求；在配置多个服务标识符时，要注意避免SID之间的冲突。
            integer DcmDsdServiceRole [0..1]: 0..4294967295, scope=ECU, multiplicity set at link in variant link-time / post-build in variant post-build / pre-compile in variant pre-compile, post-build-variant-multiplicity=true, post-build-variant-value=true, set at link in variant link-time / post-build in variant post-build / pre-compile in variant pre-compile  # Bitfield were each bit represents one dedicated role. A diagnostic service is granted access if the bit value is 1. If a bit value is 0, the service is not allowed to be executed for that role. / 概述：DcmDsdServiceRole配置项定义了诊断服务在诊断服务调度器（DSD）中的角色，用于指定该服务是供应商特定的服务还是标准服务，以及它是否需要会话控制或安全访问控制。 注意：在配置DcmDsdServiceRole时，必须确保服务角色与实际的服务需求相匹配；对于需要会话控制或安全访问的服务，应正确配置相关属性以确保服务的安全性和有效性；AUTOSAR CP 4.4标准中对服务角色的定义和使用有明确规范，需要遵循这些规范以保证诊断服务的正确实现。
            integer DcmDsdSidTabServiceId: 0..255, scope=ECU, set at link in variant link-time / pre-compile in variant post-build+pre-compile  # Identifier of the service. / 概述：DcmDsdSidTabServiceId配置项用于定义诊断服务表中的服务标识符（Service Identifier, SID），它指定了哪些服务ID将被诊断会话层处理。 注意：在配置DcmDsdSidTabServiceId时，需要确保服务ID与实际的诊断服务匹配，并且在同一诊断服务表中服务ID是唯一的；此外，服务ID应遵循ISO 14229和OEM特定的诊断服务ID规范；在配置过程中还应注意与DcmDsdSubServiceId的关联性，确保子服务ID的正确配置和使用。 | The possible service identifiers are defined in ISO 14229-1 and ISO 15031-5.
            reference DcmDsdSidTabModeRuleRef [0..1]: scope=ECU, multiplicity set at link in variant link-time / pre-compile in variant post-build+pre-compile, set at link in variant link-time / pre-compile in variant post-build+pre-compile, destination=DcmModeRule  # Reference to a DcmDspModeRule which controls the execution of the service. If there is no reference configured, no mode rule check shall be performed. / 概述：DcmDsdSidTabModeRuleRef配置项用于引用特定的诊断会话控制模式规则，这些规则定义了在哪些诊断会话模式下，特定的服务标识符（SID）是有效的。 注意：在配置DcmDsdSidTabModeRuleRef时，需要确保引用的模式规则与诊断服务表中定义的服务兼容；引用的模式规则必须在Dcm配置中预先定义；正确配置模式规则对于确保诊断服务的正确访问权限至关重要。
            reference DcmDsdSidTabSecurityLevelRef [0..255]: scope=ECU, multiplicity set at link in variant link-time / pre-compile in variant post-build+pre-compile, origin=AUTOSAR_ECUC V1.0.0, set at link in variant link-time / pre-compile in variant post-build+pre-compile, destination=DcmDspSecurityRow  # Reference to a Security Level in which the service is allowed to be executed. Multiple references are allowed for a service. / 概述：DcmDsdSidTabSecurityLevelRef配置项用于将特定的诊断服务标识符（SID）表与相应的安全等级关联起来，确保只有在满足特定安全条件时才能访问和执行这些服务。 注意：在配置时需确保引用的安全等级已经在Dcm的安全策略中定义；每个SID表应该引用至少一个安全等级，以保证服务的安全访问；在实施配置时，应考虑与诊断会话控制的安全等级配合使用，以实现更细粒度的访问控制。 | Please refer to ISO 14229-1, ISO 15031-5 and chapter "Verification of the Service Security Access levels." If there is no reference configured, no service security verification shall be performed.
            reference DcmDsdSidTabSessionLevelRef [0..255]: scope=ECU, multiplicity set at link in variant link-time / pre-compile in variant post-build+pre-compile, origin=AUTOSAR_ECUC V1.0.0, set at link in variant link-time / pre-compile in variant post-build+pre-compile, destination=DcmDspSessionRow  # Reference to a Session Level in which the service is allowed to be executed. Multiple references are allowed for a service. / 概述：DcmDsdSidTabSessionLevelRef配置项用于定义诊断服务标识符（SID）表中的服务可以在哪些诊断会话级别下被访问。 注意：确保配置的会话级别与服务的实际需求相匹配；不同的服务可能需要在不同的诊断会话级别下可用；在配置时要考虑到诊断会话控制逻辑，以确保服务在适当的会话级别下被正确地授权或限制。 | Please refer to ISO 14229-1, ISO 15031-5 and chapter "Verification of the Diagnostic Session". If there is no reference configured, no diagnostic session verification shall be performed.
            container DcmDsdSubService [0..*]  # This container contains the configuration (DSD parameters) for a subservice of a service. Only those services may have subservices, which have the DcmDsdSidTabSubfuncAvail configured as TRUE. / 概述：DcmDsdSubService配置项用于定义诊断服务中的子服务信息，包括子服务的标识符、相关条件以及对应的处理函数。 注意：在配置DcmDsdSubService时，需要确保子服务标识符的唯一性，以避免在同一诊断服务中出现冲突；子服务处理函数应当与子服务的功能和要求相匹配，确保正确响应诊断请求；还需考虑安全访问条件，确保只有在满足特定条件下才能执行子服务。
              boolean DcmDsdSubServiceUsed: post-build-variant-value=true, set at link in variant link-time / post-build in variant post-build / pre-compile in variant pre-compile, default-value=true  # Allows to activate or deactivate the usage of a Subservice. This parameter can be used for multi-purpose ECUs. / 概述：DcmDsdSubServiceUsed配置项用于指定在诊断会话控制中，哪些子服务应被激活或使用。 注意：确保只有在需要的诊断会话中激活相应的子服务，以避免不必要的资源消耗；子服务的配置应符合车辆制造商的诊断策略和安全要求；在配置时需遵循AUTOSAR CP 4.4标准中对诊断服务的具体要求和限制。 | true - subservice is available false - subservice is not available.
              function name DcmDsdSubServiceFnc [0..1]: multiplicity set at link in variant link-time / pre-compile in variant post-build+pre-compile, set at link in variant link-time / pre-compile in variant post-build+pre-compile  # Callback function of the ECU Supplier specific component for the particular service. The function's prototype is as described for <Module>_<DiagnosticService>_<SubService>. / 概述：DcmDsdSubServiceFnc配置项用于定义诊断子服务的处理函数，这些函数负责执行与特定诊断子服务相关的操作。 注意：确保为每个诊断子服务正确配置对应的处理函数，避免诊断功能执行错误；处理函数需要遵循AUTOSAR CP 4.4标准中定义的接口规范；在配置处理函数时，考虑其执行时间对系统性能的影响，以免影响整体诊断响应时间。 | If this parameter is not configured, the subservice is handled Dcm-internally.
              integer DcmDsdSubServiceId: 0..127, scope=ECU, set at link in variant link-time / pre-compile in variant post-build+pre-compile  # Identifier of the subservice. / 概述：DcmDsdSubServiceId配置项用于定义诊断服务中子服务的唯一标识符，这个标识符用于区分不同的子服务，以便在诊断会话中正确处理各种子服务请求。 注意：在配置子服务时，必须确保每个子服务的标识符是唯一的，以避免在诊断服务分派时发生冲突；子服务标识符通常是一个字节大小的值，因此它的取值范围应该在0x00到0xFF之间；在配置子服务标识符时，还需要考虑与全局服务标识符的关系，确保它们在诊断服务分派器中能够被正确解析和处理。 | The possible subservice identifiers are defined in ISO 14229-1 and ISO 15031-5.
              integer DcmDsdSubServiceRole [0..1]: 0..4294967295, scope=ECU, multiplicity set at link in variant link-time / post-build in variant post-build / pre-compile in variant pre-compile, post-build-variant-multiplicity=true, post-build-variant-value=true, set at link in variant link-time / post-build in variant post-build / pre-compile in variant pre-compile  # Bitfield were each bit represents one dedicated role. A sub-function of a diagnostic service is granted access if the bit value is 1. If a bit value is 0, the service is not allowed to be executed for that role. / 概述：DcmDsdSubServiceRole配置项定义了诊断子服务在诊断服务调度器（DSD）中的角色，用于控制子服务的执行权限和行为。 注意：在配置DcmDsdSubServiceRole时，需要确保子服务的角色与其预期的行为一致；角色类型通常包括默认角色、功能请求角色和物理请求角色；在配置时应注意不同角色对安全访问级别的要求。
              reference DcmDsdSubServiceModeRuleRef [0..1]: scope=ECU, multiplicity set at link in variant link-time / pre-compile in variant post-build+pre-compile, set at link in variant link-time / pre-compile in variant post-build+pre-compile, destination=DcmModeRule  # Reference to a DcmDspModeRule which controls the execution of the subservice. / 概述：DcmDsdSubServiceModeRuleRef配置项用于引用一个特定的诊断会话模式规则，该规则定义了在哪些诊断会话模式下子服务可以被执行。 注意：确保引用的会话模式规则与子服务的实际需求相匹配；在配置时应注意不同诊断服务之间的会话模式规则可能存在冲突；在AUTOSAR CP 4.4标准中，会话模式规则需要在Dcm配置中明确定义，并且正确关联到相应的子服务。 | If there is no reference configured, no mode rule check shall be performed.
              reference DcmDsdSubServiceSecurityLevelRef [0..255]: scope=ECU, multiplicity set at link in variant link-time / pre-compile in variant post-build+pre-compile, set at link in variant link-time / pre-compile in variant post-build+pre-compile, destination=DcmDspSecurityRow  # Reference to a Security Level in which the subservice is allowed to be executed. Multiple references are allowed for a subservice. / 概述：DcmDsdSubServiceSecurityLevelRef配置项用于定义诊断子服务的安全级别，确保只有在满足特定安全条件下才能访问这些子服务。 注意：在配置时需确保安全级别与子服务的安全需求相匹配；不正确的安全级别配置可能导致未授权的访问或功能受限；AUTOSAR CP 4.4标准中，安全级别的配置应详细且清晰，避免安全漏洞。 | Please refer to ISO 14229-1, ISO 15031-5 and chapter "Verification of the Service Security Access levels." If there is no reference configured, no subservice security verification shall be performed.
              reference DcmDsdSubServiceSessionLevelRef [0..255]: scope=ECU, multiplicity set at link in variant link-time / pre-compile in variant post-build+pre-compile, set at link in variant link-time / pre-compile in variant post-build+pre-compile, destination=DcmDspSessionRow  # Reference to a Session Level in which the subservice is allowed to be executed. Multiple references are allowed for a subservice. / 概述：DcmDsdSubServiceSessionLevelRef配置项用于指定诊断子服务（SubService）可以在哪些诊断会话级别（Diagnostic Session Level）下被执行，确保诊断服务的执行符合当前会话级别的权限要求。 注意：确保为每个诊断子服务正确配置会话级别，避免在不允许的会话级别下执行诊断操作；AUTOSAR CP 4.4标准中，会话级别的配置应遵循诊断服务需求，不正确的配置可能导致诊断服务无法在特定会话级别下执行；在配置时，应参考相关诊断协议标准，如ISO 14229等，以确保兼容性和标准的遵循。 | Please refer to ISO 14229-1, ISO 15031-5 and chapter "Verification of the Diagnostic Session". If there is no reference configured, no diagnostic session verification shall be performed.
      container DcmDsl  # These parameters configure the Diagnostic Session Layer submodule. / 概述：DcmDsl（Diagnostic Communication Manager Diagnostic Session Layer）是AUTOSAR中负责管理诊断通信会话层的配置项，它定义了诊断服务请求和响应之间的通信规则，以及与客户端（通常是诊断工具）的交互方式。 注意：在配置DcmDsl时，需确保与车辆的诊断协议和诊断需求相匹配；注意DcmDsl配置与DcmDsd（Diagnostic Service Dispatcher）和DcmDsp（Diagnostic Service Processor）的交互关系；在配置诊断会话控制、测试仪器控制和网络管理等功能时，应遵循AUTOSAR CP 4.4标准的相关规定。
        container DcmDslBuffer [1..256]  # This container contains the configuration of a diagnostic buffer. / 概述：DcmDslBuffer配置项用于定义诊断通信管理器（Diagnostic Communication Manager）中的缓冲区，这些缓冲区用于存储发送或接收的诊断消息。 注意：缓冲区大小应根据实际需求和最大可能的诊断消息长度来配置，以避免溢出；确保每个缓冲区的唯一性和正确的关联到相应的DcmDslProtocol；在多客户端环境中，管理缓冲区的分配和释放以防止数据冲突。
          integer DcmDslBufferSize: 8..65535, scope=ECU, set at pre-compile  # Size of the diagnostic buffer in bytes. / 概述：DcmDslBufferSize配置项用于指定诊断会话层（Diagnostic Session Layer）中用于存储接收和发送诊断消息的缓冲区大小。 注意：缓冲区大小应足够容纳最大可能的诊断请求和响应消息；过小的缓冲区可能导致消息处理失败，过大的缓冲区可能会浪费资源；在配置时需考虑ECU的内存限制和诊断需求。 | For a linear buffer the size shall be as large as the longest diagnostic message (request or response). For a paged buffer the size has impacts on the application performance.
        container DcmDslCallbackDCMRequestService [0..255]  # Each DcmDslCallbackDCMRequestService container defines an R-Port with the CallbackDCMRequestServices interface which the Dcm uses to ask permission for protocol changes from the application software. The R-Port has the name CallbackDCMRequestServices_<SWC> where <SWC> is the name of this container. / 概述：DcmDslCallbackDCMRequestService配置项用于定义诊断服务请求时的回调函数，这些回调函数在诊断请求的不同阶段被调用，以实现特定的功能，如权限控制、服务处理前后的操作等。 注意：在配置时需确保回调函数与服务请求处理流程兼容；回调函数应遵循AUTOSAR规定的接口和行为模式；在多服务处理场景中，应注意回调函数的执行顺序和资源共享问题。
        container DcmDslDiagResp  # This container contains the configuration of the automatic requestCorrectlyReceivedResponsePending response management in the Dcm. / 概述：DcmDslDiagResp配置项定义了诊断响应消息的发送行为，包括消息的优先级、缓冲区大小和发送策略，确保诊断响应能够按照既定的方式被正确处理和发送。 注意：在配置DcmDslDiagResp时，必须确保为每个诊断请求设置合适的响应优先级，以避免重要信息的延迟；缓冲区大小应根据实际需要合理设置，以防止数据溢出或资源浪费；发送策略的选择应考虑网络带宽和系统处理能力，以优化诊断通信性能。
          boolean DcmDslDiagRespOnSecondDeclinedRequest: scope=ECU, origin=AUTOSAR_ECUC V1.0.0, set at link in variant link-time / pre-compile in variant post-build+pre-compile  # Defines the reaction upon a second request (ClientB) that can not be processed (e.g. due to priority assessment). / 概述：DcmDslDiagRespOnSecondDeclinedRequest配置项用于定义诊断服务层（DcmDsl）在连续两次请求被拒绝时的响应行为，确保了对异常请求的处理符合诊断通信管理的要求。 注意：该配置项对于确保诊断通信的健壮性和安全性至关重要；必须确保配置正确以避免潜在的通信安全风险；在AUTOSAR CP 4.4标准中，该配置项的属性和行为应详细参照相关诊断通信管理规范进行配置。 | TRUE: when the second request (Client B) can not be processed, it shall be answered with NRC21 BusyRepeatRequest. FALSE: when the second request (Client B) can not be processed, it shall not be responded.
          integer DcmDslDiagRespMaxNumRespPend: 0..255, scope=ECU, origin=AUTOSAR_ECUC V1.0.0, set at link in variant link-time / pre-compile in variant post-build+pre-compile, default-value=0  # Maximum number of negative responses with response code 0x78 (requestCorrectlyReceivedResponsePending) allowed for a request. If Dcm reaches this limit, an automatic 0x10 (generalReject) final response will be trasmitted and the service processing will be cancelled. / 概述：DcmDslDiagRespMaxNumRespPend 定义了在等待诊断响应期间，诊断通信管理器（DCM）可以发送的最大“响应待定”消息数量。 注意：该参数的设置应考虑ECU处理能力和网络带宽，以避免通信拥堵；过高的设置可能导致客户端超时错误；AUTOSAR CP 4.4标准中此配置项的默认值和范围应严格遵守以保证诊断通信的可靠性。
          function name DcmDslDiagResponseIndicationFunc [0..1]: multiplicity set at link in variant link-time / pre-compile in variant post-build+pre-compile, set at link in variant link-time / pre-compile in variant post-build+pre-compile  # DcmDslDiagResponseIndicationFunc defines the function interface for passing the diagnostic response data to the user to do debugging related work during the transmission of the diagnostic response data. / 概述：DcmDslDiagResponseIndicationFunc定义了在传输诊断响应数据的过程中，将诊断响应数据传递给用户做调试相关工作的函数接口。 注意：此配置为非标配置项，仅为用户调试过程中所使用，如果正常量产应用则需要关闭该接口，即不设置该接口的函数名。 | If this parameter is not configured, the subservice is handled Dcm-internally.
        container DcmDslProtocol  # This container contains the configurations of the diagnostic protocols used in Dcm. / 概述：DcmDslProtocol配置项定义了诊断通信层协议的属性，包括诊断协议类型（如UDS，OBD等），以及与之相关的通信参数和定时器设置。 注意：在配置DcmDslProtocol时，需要确保选择的协议类型与车辆标准和法规要求相匹配；同时，通信参数和定时器设置必须满足诊断协议的性能要求；此外，应注意与网络层的兼容性和整个诊断系统的一致性。
          container DcmDslProtocolRow [1..255]  # This container contains the configuration of one particular diagnostic protocol used in Dcm. / 概述：DcmDslProtocolRow配置项定义了诊断通信管理器（Diagnostic Communication Manager）中的协议行，它指定了诊断协议层的配置，如ISO TP、KWP2000等，以及这些协议的相关参数。 注意：在配置DcmDslProtocolRow时，需要确保协议参数与实际使用的诊断协议标准一致；应注意与DcmDslProtocol配置的一致性和兼容性；在多协议系统中，还需确保不同DcmDslProtocolRow之间的参数设置不会相互冲突。
            boolean DcmDslProtocolRowUsed: post-build-variant-value=true, set at link in variant link-time / post-build in variant post-build / pre-compile in variant pre-compile, default-value=false  # Allows to activate or deactivate the usage of a Protocol. This parameter can be used for multi-purpose ECUs. / 概述：DcmDslProtocolRowUsed配置项用于指定诊断通信管理器（Diagnostic Communication Manager）中使用的协议行，它定义了诊断会话层协议（如ISO 14229, ISO 15765等）的具体实现和行为。 注意：在配置DcmDslProtocolRowUsed时，需要确保所选协议与车辆支持的诊断协议一致；每个DcmDslProtocolRow配置必须关联到至少一个DcmDslProtocol，以确保正确的协议行被激活；在多协议系统中，应注意协议之间的优先级和切换逻辑，以避免潜在的冲突。 | true - protocol is available false - protocol is not available.
            boolean DcmSendRespPendOnRestart: set at link in variant link-time / pre-compile in variant post-build+pre-compile, default-value=false  # If set to TRUE, the Dcm will send a NRC 0x78 before a transition to bootloader or performing an ECU reset. If set to False, no 0x78 is send in this case. / 概述：DcmSendRespPendOnRestart配置项用于定义诊断通信管理模块（Diagnostic Communication Manager, DCM）在ECU重启后是否发送响应挂起（Response Pending）消息。 注意：在AUTOSAR CP 4.4标准中，此配置项的使用需要谨慎，确保在ECU重启过程中对诊断请求的处理符合预期；重启行为可能会影响诊断会话的连续性，因此需要特别注意会话管理；此配置项的使用应结合具体的应用场景和ECU的诊断策略来决定。
            enumeration DcmDslProtocolTransType [0..1]: {TYPE1, TYPE2}, scope=ECU, origin=AUTOSAR_ECUC V1.0.0, set at link in variant link-time / pre-compile in variant post-build+pre-compile, default-value=TYPE1  # This parameter is used only if the protocol is of type DCM_ROE_ON_xxx. It selects the transmission type of the protocol. / 概述：DcmDslProtocolTransType 定义了诊断通信管理器（Diagnostic Communication Manager）中使用的传输类型，如正常、周期性或响应式传输。 注意：在配置DcmDslProtocolTransType时，必须确保所选传输类型与车辆网络的支持和诊断需求相匹配；不正确的传输类型配置可能导致诊断通信失败或性能下降；AUTOSAR CP 4.4标准支持多种传输类型，应详细了解每种类型的适用场景。
            enumeration DcmDslProtocolType: {DCM_OBD_ON_CAN, DCM_OBD_ON_IP, DCM_UDS_ON_CAN, DCM_UDS_ON_IP}, scope=ECU, set at pre-compile, symbolic-name-value=true, default-value=DCM_UDS_ON_CAN  # The diagnostic protocol type for the DCM DSL protocol that is being configured. / 概述：DcmDslProtocolType配置项用于定义诊断通信管理器（Diagnostic Communication Manager）中使用的诊断协议类型，如ISO 14229 (UDS) 或 ISO 15765 (DoCAN)。 注意：在配置DcmDslProtocolType时，必须确保选择的协议类型与车辆的诊断需求和规范相匹配；不同的协议类型可能会要求不同的配置参数和服务集；在实施时，应考虑与其他诊断协议的兼容性和共存问题。 | Implementation Type: Dcm_ProtocolType
            float DcmTimStrP2ServerAdjust: 0..1, scope=ECU, set at link in variant link-time / pre-compile in variant post-build+pre-compile, default-value=0  # This parameter is used to guarantee that the diagnostic response is available on the bus before reaching P2 by adjusting the current DcmDspSessionP2ServerMax. / 概述：DcmTimStrP2ServerAdjust 用于调整诊断通信中服务器的P2定时器，这是响应客户端请求后服务器在规定时间内必须给出响应的时间。 注意：该配置项的值必须根据具体的车辆网络环境和诊断需求进行调整；不正确的P2Server时间设置可能导致诊断通信失败或性能下降；应遵循OEM的具体规定和标准来设置此参数。 | This parameter mainly represents the software architecture dependent communication delay between the time the transmission is initiated by DCM and the time when the message is actually transmitted to the bus. The parameter value is defined in seconds and must be a multiple of DcmTaskTime.
            float DcmTimStrP2StarServerAdjust: 0..5, scope=ECU, set at link in variant link-time / pre-compile in variant post-build+pre-compile, default-value=0  # This parameter is used to guarantee that the diagnostic response is available on the bus before reaching P2Star by adjusting the current DcmDspSessionP2StarServerMax. / 概述：DcmTimStrP2StarServerAdjust配置项用于调整诊断通信控制器（Diagnostics Communication Manager）中的P2*服务器定时器，该定时器定义了服务器在发送响应之前等待客户端请求的最大时间。 注意：该值通常需要根据具体的车辆网络环境和诊断需求进行调整；过小的值可能导致网络拥堵时无法正确响应诊断请求，过大的值可能导致诊断响应延迟；在调整此参数时，应遵循相关的诊断标准和制造商的指导。 | This parameter mainly represents the software architecture dependent communication delay between the time the transmission is initiated by DCM and the time when the message is actually transmitted to the bus. The parameter value is defined in seconds and must be a multiple of DcmTaskTime.
            integer DcmDslProtocolMaximumResponseSize [0..1]: 1..65535, scope=ECU, multiplicity set at pre-compile, set at pre-compile, default-value=4095  # This parameter is mandatory and defines the maximum length of the response message in case DcmPagedBufferEnabled == TRUE / 概述：DcmDslProtocolMaximumResponseSize配置项用于定义诊断通信层中，针对每个诊断协议所能支持的最大响应报文大小，确保诊断响应不会超过ECU的缓冲区限制。 注意：在配置时需确保该值不小于诊断服务的最大可能响应长度；同时考虑到网络层的限制，如ISO TP的单帧或多帧传输限制；此外，该值应小于或等于ECU硬件和网络接口的最大承载能力。
            integer DcmDslProtocolPriority: 0..255, scope=ECU, set at link in variant link-time / pre-compile in variant post-build+pre-compile, default-value=1  # Protocol priority used during protocol preemption. A higher priority protocol may preempt a lower priority protocol. / 概述：DcmDslProtocolPriority配置项用于定义诊断通信管理器（Diagnostic Communication Manager）中不同诊断协议之间的优先级，以决定在多个诊断请求同时到达时哪个协议应该被优先处理。 注意：在配置时必须确保每个诊断协议都有一个唯一的优先级值；优先级的配置应该反映实际的系统需求，确保关键诊断服务能够优先处理；在实际应用中，应考虑到不同车辆网络（如CAN, LIN, FlexRay等）的特性和要求，合理分配优先级。 | Lower numeric values represent higher protocol priority: 0 - Highest protocol priority 255 - Lowest protocol priority
            integer DcmDspProtocolEcuAddr [0..1]: 0..65535, scope=ECU, set at pre-compile  # Ecu source address used for diagnostic communication. This parameter is required for Generic Connections. / 概述：DcmDspProtocolEcuAddr配置项用于定义诊断通信管理器（Diagnostic Communication Manager）中，针对不同诊断协议的ECU地址信息，确保诊断请求能够正确地被ECU识别和处理。 注意：在配置DcmDspProtocolEcuAddr时，需要确保地址信息与车辆网络中的实际地址匹配；对于使用相同诊断协议的不同ECU，应有不同的地址配置以避免冲突；此配置项应与车辆的网络管理配置保持一致，以确保诊断服务的正确路由。
            reference DcmDemClientRef: scope=ECU, multiplicity set at pre-compile, set at pre-compile, destination=DemClient  # Reference to DemClient in Dem configuration. / 概述：DcmDemClientRef是一个配置项，用于在诊断通信管理器（Diagnostic Communication Manager, DCM）模块中引用诊断事件管理器（Diagnostic Event Manager, DEM）的客户端标识符，实现DCM与DEM之间的交互。 注意：确保引用的DEM客户端标识符在DEM模块中已定义，以保证DCM能正确访问DEM服务；在配置时应注意版本兼容性，确保DCM和DEM模块遵循相同或兼容的AUTOSAR版本；在多客户端系统中，正确管理每个DCM客户端与DEM的关联，避免配置错误导致诊断服务失败。 | Used by the Dem to distinguish different client calls.
            reference DcmDslProtocolRxBufferRef: scope=ECU, set at link in variant link-time / pre-compile in variant post-build+pre-compile, destination=DcmDslBuffer  # Reference to a configured diagnostic buffer that is used for diagnostic request reception for the protocol. / 概述：DcmDslProtocolRxBufferRef配置项用于指定诊断通信层（DcmDsl）中用于接收数据的缓冲区引用，确保诊断请求能够被正确接收并存储。 注意：在配置时需确保引用的缓冲区大小足以容纳预期的最大诊断请求消息；缓冲区应当独立于其他通信对象以避免数据冲突；在多协议配置中，每个协议可能需要独立的接收缓冲区。
            reference DcmDslProtocolSIDTable: scope=ECU, set at link in variant link-time / pre-compile in variant post-build+pre-compile, destination=DcmDsdServiceTable  # Reference to a service table that is used for diagnostic request processing for this protocol. / 概述：DcmDslProtocolSIDTable配置项用于定义诊断会话层中支持的服务标识符（Service Identifier，SID）及其关联的处理函数，确保诊断请求能够被正确解析和响应。 注意：在配置DcmDslProtocolSIDTable时，必须确保每个SID与其对应的处理函数正确映射，避免服务处理混淆；应考虑诊断会话控制和安全访问限制，以免在不适当的会话或安全级别下执行服务；根据AUTOSAR CP 4.4标准，还需确保配置项与诊断协议（如UDS，KWP2000等）的要求相符。
            reference DcmDslProtocolTxBufferRef: scope=ECU, set at link in variant link-time / pre-compile in variant post-build+pre-compile, destination=DcmDslBuffer  # Reference to a configured diagnostic buffer that is used for diagnostic response transmission for the protocol. / 概述：DcmDslProtocolTxBufferRef配置项用于指定诊断会话层（Dsl）中，用于传输响应消息的缓冲区引用，确保诊断响应能够被正确地存储和发送。 注意：必须确保引用的TxBuffer足够大，以容纳可能的最大响应消息；在配置多个诊断协议时，应注意不同协议可能需要不同大小的TxBuffer；该配置项在AUTOSAR CP 4.4中是必需的，缺失或错误配置可能导致诊断通信失败。
            choice container DcmDslConnection [1..*]  # This container contains the configuration of a communication channel for one particular protocol. / 概述：DcmDslConnection配置项定义了诊断通信管理器（Diagnostic Communication Manager）中客户端（通常是诊断工具）与服务器（车辆控制单元或ECU）之间的通信连接参数，包括连接的类型、通信协议和优先级等。 注意：在配置DcmDslConnection时，需确保通信协议与车辆支持的诊断协议一致；连接类型应根据实际的诊断需求和车辆网络架构选择；优先级设置需考虑到不同诊断任务之间的相对重要性，避免重要诊断任务被延迟或阻塞。 | Note that it is allowed to communicate with multiple testers, therefore multiple connections may be configured for a protocol.
              container DcmDslMainConnection [0..1]  # This container contains the configuration for a main connection of a diagnostic protocol. Additionally it may contain references to ROE and Periodic connections if the protocol type or protocol transmission type needs them. / 概述：DcmDslMainConnection配置项定义了诊断通信管理器（Diagnostic Communication Manager）中主连接的属性，这包括了与客户端（如诊断工具）的通信参数和连接引用。 注意：在配置DcmDslMainConnection时，需要确保它与所引用的DcmDslProtocolRow和DcmDslConnection配置一致；主连接应该唯一地关联到一个特定的诊断协议；在配置多个连接时，要注意它们之间的优先级和冲突管理。
                integer DcmDslProtocolRxConnectionId: 0..65535, scope=ECU, multiplicity set at pre-compile, set at link in variant link-time / pre-compile in variant post-build+pre-compile, symbolic-name-value=true  # Unique identifier of the tester which uses this connection for diagnostic communication. / 概述：DcmDslProtocolRxConnectionId 是用于定义诊断通信管理器（Diagnostic Communication Manager）中，诊断协议层与网络层之间的接收连接标识符，确保正确的数据传输和接收。 注意：在配置时需确保每个DcmDslProtocolRxConnectionId是唯一的，以避免数据接收时的冲突；该标识符通常与具体的通信通道和网络协议栈配置相关联；在配置多个诊断协议时，应注意不同协议间的连接标识符不要重复。
                integer DcmDslProtocolRxTesterSourceAddr [0..1]: 0..65535, scope=ECU, multiplicity set at pre-compile, set at link in variant link-time / pre-compile in variant post-build+pre-compile  # Tester source address uniquely describes a client and will be used e.g within the jump to Bootloader interfaces. This parameter is not required for generic connections (DcmPdus with MetaDataLength >= 1). / 概述：DcmDslProtocolRxTesterSourceAddr配置项定义了用于车辆诊断通信中，接收端（通常是车辆的诊断控制模块）所期望的测试仪器的源地址。 注意：在配置时需确保地址符合网络中实际测试设备的地址；不同的诊断协议可能需要不同的源地址配置；源地址配置错误可能导致诊断通信失败。
                reference DcmDslPeriodicTransmissionConRef [0..1]: scope=ECU, multiplicity set at pre-compile, origin=AUTOSAR_ECUC V1.0.0, set at link in variant link-time / pre-compile in variant post-build+pre-compile, destination=DcmDslPeriodicTransmission  # Reference to a periodic transmission connection which is used for the processing of periodic transmission events. / 概述：DcmDslPeriodicTransmissionConRef配置项用于引用Dcm中用于周期性传输的连接，它指定了哪些网络连接可以用于周期性数据的传输。 注意：在配置周期性传输时，确保引用的网络连接支持所需的传输协议和带宽；周期性传输可能对网络带宽和ECU处理能力有较高要求，需谨慎配置；AUTOSAR CP 4.4中对于周期性传输的支持和配置可能有特定限制或要求，需要参考具体的AUTOSAR文档。
                reference DcmDslProtocolComMChannelRef: scope=ECU, set at link in variant link-time / pre-compile in variant post-build+pre-compile, requires-symbolic-name-value=true, destination=ComMChannel  # Reference to the ComMChannel on which the DcmDslProtocolRxPdu is received and the DcmDslProtocolTxPdu is transmitted. / 概述：DcmDslProtocolComMChannelRef配置项用于指定诊断通信管理（Diagnostic Communication Manager）层中，每个诊断协议所使用的通信通道引用。 注意：确保每个诊断协议正确引用了对应的ComM通道，以保证诊断消息能够通过正确的网络通道传输；在配置时需注意与网络管理配置的一致性，避免配置错误导致通信失败；该配置项在AUTOSAR CP 4.4标准中是必需的，缺失可能导致诊断功能不完整或不可用。
                reference DcmDslROEConnectionRef [0..1]: scope=ECU, multiplicity set at pre-compile, origin=AUTOSAR_ECUC V1.0.0, set at link in variant link-time / pre-compile in variant post-build+pre-compile, destination=DcmDslResponseOnEvent  # Reference to a ResponseOnEvent connection which is used for the processing of ResponseOnEvent events. / 概述：DcmDslROEConnectionRef配置项用于定义诊断通信管理（Diagnostic Communication Manager）中，响应式事件（Response On Event, ROE）与网络连接之间的关联。这使得系统能够在特定网络连接上根据事件触发诊断响应。 注意：在配置DcmDslROEConnectionRef时，必须确保引用的网络连接已经定义且有效；此配置项对于实现基于事件的诊断通信至关重要，因此需要仔细配置以避免通信问题；AUTOSAR CP 4.4标准中，对于ROE的支持和配置要求可能与早期版本有所不同，需要注意版本间的兼容性。
                container DcmDslProtocolRx [1..*]  # This container contains the configuration parameters of a reception channel in a diagnostic connection. / 概述：DcmDslProtocolRx配置项用于定义诊断通信层中接收通道的属性，包括接收数据的协议、PDU ID、以及与之相关的资源和参数。 注意：在配置DcmDslProtocolRx时，需要确保PDU ID与ECU中实际的PDU配置相匹配；此外，应当注意与DcmDslProtocolTx配置项的一致性，以保证诊断通信的双向性；最后，该配置项的属性应符合AUTOSAR CP 4.4标准中对诊断通信层的规定。 | The PDU referenced by this reception channel can consume meta data items of type SOURCE_ADDRESS_16 and TARGET_ADDRESS_16.
                  enumeration DcmDslProtocolRxAddrType: {DCM_FUNCTIONAL_TYPE, DCM_PHYSICAL_TYPE}, scope=ECU, set at link in variant link-time / pre-compile in variant post-build+pre-compile  # Selects the addressing type of the reception channel. Physical addressing is used for 1:1 communication, functional addressing is used for 1:N communication. / 概述：DcmDslProtocolRxAddrType配置项用于定义诊断通信管理器（Diagnostic Communication Manager）中，不同诊断协议下的接收地址类型，如物理地址或功能地址。 注意：在配置DcmDslProtocolRxAddrType时，需要确保地址类型与诊断协议的要求相匹配；此配置项对于确保正确的诊断请求路由至适当的服务组件至关重要；在多协议环境中，应注意不同协议间的地址类型可能会有所不同，需要分别配置。 | For details refer to ISO 14229-1.
                  integer DcmDslProtocolRxPduId: 0..65535, scope=ECU, set at pre-compile, symbolic-name-value=true, default-value=0  # Identifier of the PDU that is used for this reception channel. / 概述：DcmDslProtocolRxPduId配置项用于定义诊断通信管理器（Diagnostic Communication Manager）中，接收协议数据单元（Protocol Data Unit）的标识符，它关联了网络层的接收PDU与Dcm的特定协议。 注意：在配置DcmDslProtocolRxPduId时，必须确保PDU ID与ECU中定义的PDU相匹配，并且在整个系统中是唯一的；此外，PDU ID应与正确的Dcm协议层配置相对应，以确保诊断消息能够被正确处理；在配置时还应注意PDU的传输方向，确保是接收方向的PDU ID。
                  reference DcmDslProtocolRxPduRef: scope=ECU, set at link in variant link-time / pre-compile in variant post-build+pre-compile, destination=Pdu  # Reference to a Pdu in EcuC that is used for this reception channel. / 概述：DcmDslProtocolRxPduRef配置项用于指定诊断通信管理器（Diagnostic Communication Manager）中，诊断会话层（Diagnostic Session Layer）所使用的接收PDU（Protocol Data Unit）的引用。 注意：确保引用的PDU与所需的诊断协议匹配；PDU配置必须在PduR模块中正确定义；在配置多个协议时，注意PDU的唯一性和冲突避免。
                container DcmDslProtocolTx [0..1]  # This container contains the configuration parameters of a transmission channel in a diagnostic connection. / 概述：DcmDslProtocolTx配置项定义了诊断通信管理器（Diagnostic Communication Manager）中的传输协议层，用于管理与车辆控制单元（ECU）之间的数据传输。 注意：在配置DcmDslProtocolTx时，必须确保其与车辆的ECU支持的协议一致；配置错误可能导致诊断通信失败；此配置项应与DcmDslProtocolRx相匹配，以确保数据的双向正确传输。 | The PDU referenced by this transmission channel can produce meta data items of type TARGET_ADDRESS_16 and SOURCE_ADDRESS_16.
                  integer DcmDslTxConfirmationPduId: 0..65535, scope=ECU, set at pre-compile, symbolic-name-value=true, default-value=0  # Identifier of the PDU that is used by the lower level module for transmission confirmation of responses on this channel. / 概述：DcmDslTxConfirmationPduId用于标识诊断通信管理（Diagnostic Communication Manager）模块中，发送确认消息时所使用的协议数据单元（PDU）ID。 注意：该配置项必须与实际使用的PDU ID一致，以确保正确的消息确认；在配置时需注意与其他模块的PDU ID避免冲突；在AUTOSAR CP 4.4中，确保PDU ID的配置符合ECU的通信需求和规范。
                  reference DcmDslProtocolTxPduRef: scope=ECU, set at link in variant link-time / pre-compile in variant post-build+pre-compile, destination=Pdu  # Reference to a Pdu in EcuC that is used for this transmission channel. / 概述：DcmDslProtocolTxPduRef配置项用于指定诊断会话层（DcmDsl）中，用于传输（发送）诊断消息的PDU（协议数据单元）引用。 注意：确保引用的PDU与所需的诊断协议兼容；在配置多个协议时，注意避免PDU引用冲突；AUTOSAR CP 4.4中，该配置项的属性应与PDU属性匹配，若有不一致，需检查PDU配置。
              container DcmDslPeriodicTransmission [0..1]  # This container contains the configuration of a periodic transmission connection. / 概述：DcmDslPeriodicTransmission配置项用于定义诊断通信层中，周期性数据传输的参数和行为，这包括周期性响应的发送间隔和优先级等设置。 注意：在AUTOSAR CP 4.4标准中，需要确保周期性传输的配置不会与其他网络通信活动发生冲突；合理设置周期性传输的时间间隔，以避免对网络的过度占用；考虑到不同ECU的处理能力和网络带宽，应当在系统级别上协调周期性传输的配置。
                container DcmDslPeriodicConnection [0..*]  # This container contains the configuration of a transmission channel for a periodic transmission connection. / 概述：DcmDslPeriodicConnection配置项用于定义诊断通信管理器（Diagnostic Communication Manager）中，周期性数据传输的连接参数，包括周期性消息的发送间隔和优先级。 注意：在配置周期性连接时，需确保发送间隔和优先级符合网络带宽和系统处理能力；配置的值应与ECU的实际能力和网络管理策略相匹配；在多ECU系统中，还需考虑不同ECU间的周期性消息协调。 | The PDU referenced by this transmission channel can produce meta data items of type TARGET_ADDRESS_16 and SOURCE_ADDRESS_16.
                  integer DcmDslPeriodicTxConfirmationPduId: 0..65535, scope=ECU, set at pre-compile, symbolic-name-value=true  # Identifier of the PDU that is used by the lower level module for transmission confirmation of responses on this channel. / 概述：DcmDslPeriodicTxConfirmationPduId配置项用于定义诊断通信层（DcmDsl）中，周期性传输确认的PDU标识符，这是用于确认周期性响应消息已经被成功发送的。 注意：在配置DcmDslPeriodicTxConfirmationPduId时，需要确保PDU ID与ECU中定义的PDU ID一致；此ID应与实际用于周期性消息传输的PDU ID相匹配；在配置时应注意不要与其他PDU ID冲突，以避免通信错误。
                  reference DcmDslPeriodicTxPduRef: scope=ECU, set at link in variant link-time / pre-compile in variant post-build+pre-compile, destination=Pdu  # Reference to a Pdu in EcuC that is used for this periodic transmission channel. / 概述：DcmDslPeriodicTxPduRef配置项用于引用由诊断通信管理器（Diagnostic Communication Manager）定期发送的PDU（协议数据单元）。 注意：在配置DcmDslPeriodicTxPduRef时，需要确保引用的PDU符合诊断协议要求，并且已经在PDU路由表中正确定义；此外，该PDU应当配置为可定期发送，以支持Dcm的定期数据传输需求；在配置过程中，还需注意PDU的传输属性，如周期时间和带宽管理，以确保系统资源的有效利用和通信的可靠性。
              container DcmDslResponseOnEvent [0..1]  # This container contains the configuration of a ResponseOnEvent connection. / 概述：DcmDslResponseOnEvent配置项用于定义诊断通信管理器（Diagnostic Communication Manager）在特定事件发生时如何响应，例如在接收到特定的诊断请求或者内部事件时。 注意：在配置DcmDslResponseOnEvent时，需要确保事件触发条件与响应动作之间的映射关系符合系统的诊断需求；此配置项应与其他诊断服务配置协同工作，避免配置冲突；AUTOSAR CP 4.4标准中可能对事件类型、响应行为和优先级等属性有具体的规定，需要遵守这些规定以确保兼容性。 | The PDU referenced by this transmission channel can produce meta data items of type TARGET_ADDRESS_16 and SOURCE_ADDRESS_16.
                integer DcmDslRoeTxConfirmationPduId [0..1]: 0..65535, scope=ECU, multiplicity set at pre-compile, set at pre-compile, symbolic-name-value=true  # Identifier of the PDU that is used by the lower level module for transmission confirmation of responses on this connection. / 概述：DcmDslRoeTxConfirmationPduId配置项用于定义诊断通信层中，用于发送响应事件报告（Response On Event, ROE）的确认消息的PDU（协议数据单元）标识符。 注意：在配置DcmDslRoeTxConfirmationPduId时，需要确保所指定的PDU ID与系统中定义的PDU ID一致，并且与其他服务或功能使用的PDU ID不冲突；此配置项通常与Dcm配置中的网络层PDU ID相关联，需要根据网络管理策略和PDU路由信息进行正确配置；在AUTOSAR CP 4.4标准中，确保该配置项的使用符合诊断服务的规范要求，以保证ROE服务的正确实现和响应。
                reference DcmDslRoeTxPduRef [0..1]: scope=ECU, multiplicity set at pre-compile, set at link in variant link-time / pre-compile in variant post-build+pre-compile, destination=Pdu  # Reference to a Pdu in EcuC that is used for this ResponseOnEvent transmission connection. / 概述：DcmDslRoeTxPduRef配置项用于定义诊断通信管理器（Diagnostic Communication Manager）中响应输出事件（Response On Event）的传输协议数据单元（PDU）引用。 注意：确保引用的PDU符合网络层的配置和要求；在配置时需注意PDU的传输能力是否满足响应事件的数据需求；此配置项应与网络管理配置紧密协调，以保证数据的正确传输和处理。
      container DcmDsp  # These parameters apply to Diagnostic Service Processing. There will always be one set of these parameters per Dcm. / 概述：DcmDsp配置项涉及诊断会话层的服务处理设置，用于定义诊断服务如何在不同诊断会话中被处理和执行。 注意：在配置DcmDsp时，需确保诊断服务与会话控制策略相匹配，以避免在非法会话中执行服务；对于安全相关服务，还需考虑与安全访问级别的兼容性；AUTOSAR CP 4.4中可能增加了新的属性或服务，需要检查标准的最新版本以确保配置的兼容性。 | Please note: Although the multiplicity is set to 0..1. It can be expected that this container exists in any valid DCM configuration.
        boolean DcmDspDDDIDcheckPerSourceDID [0..1]: multiplicity set at link in variant link-time / pre-compile in variant post-build+pre-compile, set at link in variant link-time / pre-compile in variant post-build+pre-compile  # Defines the check for session, security and mode dependencies per source DIDs with a ReadDataByIdentifier (0x22). / 概述：DcmDspDDDIDcheckPerSourceDID配置项用于定义在动态数据诊断（Dynamic Data Definition, DDD）过程中，每个源数据标识符（Source DID）的访问权限检查策略。 注意：在配置时需确保每个源DID的访问权限与系统安全策略一致；若系统中未使用DDD功能，则该配置项可忽略；AUTOSAR CP 4.4标准要求明确每个DID的安全访问级别，以防止未授权访问。 | true: Dcm module shall check the session, security and mode dependencies per source DIDs with a ReadDataByIdentifier (0x22) with DID in the range 0xF200 to 0xF3FF false: Dcm module shall not check the session, security and mode dependencies per source DIDs with a ReadDataByIdentifier (0x22) with DID in the range 0xF200 to 0xF3FF
        boolean DcmDspEnableObdMirror: scope=ECU, set at link in variant link-time / pre-compile in variant post-build+pre-compile, default-value=false  # DcmDspEnableObdMirror defines whether a DID inside the OBD range (F400-F4FF) and the OBD InfoType range (F800-F8FF) shall get the DID value as defined for OBD on reception of the UDS Service ReadDataByIdentifier (0x22), or not. / 概述：DcmDspEnableObdMirror配置项用于决定是否启用OBD镜像功能，该功能允许在车辆的OBD系统中复制和存储诊断信息，以便在需要时进行快速访问和检索。 注意：在AUTOSAR CP 4.4标准中，确保OBD镜像功能的使用符合相关法规��求；如果不需要此功能，应将其配置为禁用以节省资源；在实现时要注意数据的同步和一致性，避免数据冗余和不一致。 | It also defines whether a RID inside the OBD range (E000-E0FF) shall handle the RID as defined for OBD on reception of the UDS Service RoutineControl (0x31), or not.
        boolean DcmDspEnableSessionChangeCallback: scope=ECU, set at link in variant link-time / pre-compile in variant post-build+pre-compile, default-value=false  # Enable callback to be called on diagnostic session state change. / 概述：DcmDspEnableSessionChangeCallback配置项用于定义诊断会话控制服务（Diagnostic Session Control service）在会话变更时是否调用特定的回调函数，以执行用户定义的操作。 注意：在配置时需确保回调函数的实现与预期行为一致；此配置项对于实现会话管理逻辑特别重要；AUTOSAR CP 4.4标准中，确保该配置项的使用与系统需求相匹配，避免不必要的资源消耗。 | Enable callback to be called on diagnostic session state change.
        boolean DcmDspEnableEcuResetCallback: scope=ECU, set at link in variant link-time / pre-compile in variant post-build+pre-compile, default-value=false  # Enable callback to be called on ecu reset change. / 概述：DcmDspEnableEcuResetCallback配置项用于定义在执行ECU重置服务（如UDS服务0x11）之前，是否需要调用一个特定的回调函数，以便执行一些特定的预处理操作。 注意：在AUTOSAR CP 4.4标准中，确保回调函数的实现不会导致重置流程���的任何延迟或阻塞；如果不需要特定的预处理操作，可以不配置此项或将其设置为NULL；回调函数的设计应遵循AUTOSAR的编码规范，确保安全和效率。 | Enable callback to be called on ecu reset change.
        enumeration DcmDspDataDefaultEndianness: {BIG_ENDIAN, LITTLE_ENDIAN, OPAQUE}, set at link in variant link-time / pre-compile in variant post-build+pre-compile, default-value=opaque  # Defines the default endianness belonging to a DID, RID or PID if the corresponding data does not define an endianness. / 概述：DcmDspDataDefaultEndianness配置项用于定义诊断服务处理数据时的默认字节序（Endianness），确保数据的一致性和正确解释，特别是在跨平台通信中。 注意：在AUTOSAR CP 4.4中，必须明确指定每个诊断数据元素的字节序；如果未指定，则使用此默认值；在多字节数据处理时，正确的字节序至关重要以避免数据解释错误。
        integer DcmDspMaxDidToRead [0..1]: 1..65535, scope=ECU, multiplicity set at link in variant link-time / pre-compile in variant post-build+pre-compile, set at link in variant link-time / pre-compile in variant post-build+pre-compile, default-value=1  # Indicates the maximum allowed DIDs in a single "ReadDataByIdentifier" request. / 概述：DcmDspMaxDidToRead配置项用于定义在一个读取数据标识符（ReadDataByIdentifier）服务请求中，诊断通信管理器（Diagnostic Communication Manager）可以处理的最大数据标识符（DID）数量。 注意：该值必须根据ECU的处理能力和网络带宽来合理设置，以避免在执行读取DID请求时超出ECU的处理能力或造成网络拥堵；在AUTOSAR CP 4.4标准中，如果该值设置得过大，可能会违反响应时间要求或内存限制，因此需要仔细评估合适的值；在配置时，还需考虑与其他诊断服务的数据交互和对应的资源分配。
        integer DcmDspMaxPeriodicDidToRead [0..1]: 1..65535, multiplicity set at link in variant link-time / pre-compile in variant post-build+pre-compile, set at link in variant link-time / pre-compile in variant post-build+pre-compile  # Indicates the maximum allowed periodicDIDs which can be read in a single "ReadDataByPeriodicIdentifier" request. / 概述：DcmDspMaxPeriodicDidToRead配置项用于指定诊断通信管理器（Diagnostic Communication Manager）在周期性数据标识符读取列表中能够管理的最大数据标识符数量。 注意：该值应根据实际应用需求和系统资源合理配置；超出此数量的周期性数据标识符请求可能会被拒绝；在配置时需考虑ECU的内存和处理能力限制。
        integer DcmDspPowerDownTime [0..1]: 0..255, scope=ECU, multiplicity set at link in variant link-time / pre-compile in variant post-build+pre-compile, set at link in variant link-time / pre-compile in variant post-build+pre-compile  # This parameter indicates to the client the minimum time of the stand-by sequence the server will remain in the power-down sequence. / 概述：DcmDspPowerDownTime配置项用于定义诊断通信管理器（Diagnostic Communication Manager）在接收到车辆关闭信号后，等待进入节能模式前的时间。 注意：该值应根据具体的车辆电源管理策略来配置；过短的时间可能导致在车辆关闭前未完成必要的诊断通信；过长的时间可能会导致不必要的电源消耗。 | The resolution of this parameter is one second per count. The following values are valid: 00 - FE hex: 0 - 254 s powerDownTime; FF hex: indicates a failure or time not available. This value needs to be defined by the integrator according to the ECU capabilities. This parameter has to be available if the service EcuReset, sub-service enableRapidPowerShutDown is configured.
        container DcmDspAuthentication [0..1]  # This container contains the configuration for the UDS service Authentication (0x29). / 概述：DcmDspAuthentication配置项用于定义诊断会话控制中的安全访问认证机制，包括但不限于密钥长度、加密算法类型以及尝试次数等参数，以确保对车辆进行诊断操作时的数据安全。 注意：在配置DcmDspAuthentication时，必须确保所选加密算法符合AUTOSAR CP 4.4标准和行业安全要求；密钥长度应根据最新的安全标准选择，避免使用过短的密钥；重试次数限制应合理设置，以防止暴力破解尝试。
          float DcmDspAuthenticationDefaultSessionTimeOut [0..1]: 0..Inf, scope=ECU, multiplicity set at pre-compile, set at pre-compile  # Defines the number of seconds after which the Dcm makes a transition to deauthenticated state, in case of no active communication. / 概述：DcmDspAuthenticationDefaultSessionTimeOut配置项用于定义诊断会话控制中，默认的会话超时时间，这是在成功认证后，系统保持会话状态的最长时间。 注意：该时间值需要根据实际应用场景合理设置，以避免过短导致频繁重新认证，或过长增加系统安全风险；在AUTOSAR CP 4.4中，确保该配置与系统的安全需求一致；不同的诊断会话类型可能需要不同的超时设置，应细致考虑。
          integer DcmDspAuthenticationDeauthenticatedRole: 1..4294967295, scope=ECU, set at pre-compile  # Role used for service authentication verification in the deauthenticated state. / 概述：DcmDspAuthenticationDeauthenticatedRole配置项定义了在车辆诊断通信控制模块（Diagnostic Communication Manager）中，当用户未通过认证时所分配的安全访问级别。 注意：在AUTOSAR CP 4.4标准中，确保该配置项与系统的安全策略一致；正确配置此项对于保护诊断服务免受未授权访问至关重要；在实施时需考虑与其他安全相关配置项的兼容性和一致性。
          integer DcmDspAuthenticationGeneralNRC [0..1]: 0..255, scope=ECU, set at pre-compile  # Defines the NRC that shall be send as replacement of all ISO 14229-1 defined NRCs in case of invalid certificate or content. / 概述：DcmDspAuthenticationGeneralNRC配置项用于定义在执行诊断会话控制、安全访问或其他服务时，如果客户端（通常是诊断工具）未能通过安全认证，则由诊断通信管理器（DCM）返回的负面响应代码（NRC）。 注意：在配置DcmDspAuthenticationGeneralNRC时，需要确保所选的NRC符合ISO 14229标准中定义的错误代码；不同服务可能需要配置不同的NRC以满足特定的安全要求；AUTOSAR CP 4.4标准中并未对所有可能的NRC进行详细规定，因此在实施时需参考最新的ISO 14229文档。
          integer DcmDspAuthenticationRoleSize: 1..4, scope=ECU, set at pre-compile  # Defines the size in bytes for the role element within a certificate. / 概述：DcmDspAuthenticationRoleSize定义了诊断会话控制中，用于身份认证的角色大小，即每个角色所需的数据长度。 注意：该配置项的值应根据具体的安全访问需求来设置，确保足够的数据长度以支持不同的安全算法；过大的值可能会增加系统的内存消耗，而过小的值可能导致安全机制无法正常工作；在AUTOSAR CP 4.4标准中，需确保此配置与安全访问需求相匹配，但标准本身不限制具体的大小值。
          integer DcmDspAuthenticationWhiteListDIDMaxSize [0..1]: 1..255, scope=ECU, set at pre-compile  # Defines the maximum size in bytes for the white list element within a certificate. / 概述：DcmDspAuthenticationWhiteListDIDMaxSize 定义了在诊断会话中，可以在不进行安全访问检查的情况下访问的数据标识符（DID）的最大数量。 注意：此参数的设置应考虑系统的安全需求，避免设置过高，以免降低系统的安全性；应根据实际应用需求合理配置此值；在AUTOSAR CP 4.4标准中，确保此配置与安全策略和访问控制列表相匹配。
          integer DcmDspAuthenticationWhiteListMemorySelectionMaxSize [0..1]: 1..255, scope=ECU, set at pre-compile  # Defines the maximum size in bytes for the white list element within a certificate. / 概述：DcmDspAuthenticationWhiteListMemorySelectionMaxSize配置项用于定义诊断服务中，认证过程允许的最大内存范围大小，以确保认证过程中的内存访问是受限制的。 注意：在配置此参数时，需要确保其值不超过ECU内存管理的最大限制；此参数的设置应与实际的安全需求和ECU的内存容量相匹配；在AUTOSAR CP 4.4标准中，如果该配置项的属性与标准定义的属性不一致，需要检查并调整以确保符合标准要求。
          integer DcmDspAuthenticationWhiteListRIDMaxSize [0..1]: 1..255, scope=ECU, set at pre-compile  # Defines the maximum size in bytes for the white list element within a certificate. / 概述：DcmDspAuthenticationWhiteListRIDMaxSize 定义了在诊断会话中，用于认证过程的最大请求标识符（RID）列表的大小。 注意：此参数的设置应考虑系统的安全需求和资源限制；过大的列表可能会消耗额外的系统资源，影响性能；确保此参数的设置符合AUTOSAR CP 4.4的安全管理要求。
          integer DcmDspAuthenticationWhiteListServicesMaxSize [0..1]: 1..255, scope=ECU, set at pre-compile  # Defines the maximum size in bytes for the white list element within a certificate. / 概述：DcmDspAuthenticationWhiteListServicesMaxSize配置项用于定义诊断服务中，允许在未进行安全访问认证的情况下执行的服务列表的最大尺寸。 注意：在配置时需确保该值符合系统对安全性和资源限制的要求；超出此尺寸的服务将需要进行安全访问认证后才能执行；AUTOSAR CP 4.4标准中应检查此配置项是否存在版本特定的限制或变更。
          reference DcmDspAuthenticationGeneralNRCModeRuleRef [0..1]: scope=ECU, multiplicity set at pre-compile, set at pre-compile, destination=DcmModeRule  # Mode rule that defines if the general NRC shall be send for all failures due to invalid certificate or content. / 概述：DcmDspAuthenticationGeneralNRCModeRuleRef配置项用于引用一个模式规则，该规则定义了在执行诊断会话控制（Diagnostic Session Control）时，如果认证（Authentication）服务不满足特定条件，应该返回的负响应代码（Negative Response Code, NRC）。 注意：在配置DcmDspAuthenticationGeneralNRCModeRuleRef时，需要确保引用的模式规则与实际的诊断服务逻辑相匹配；如果配置的模式规则不存在或者不正确，可能会导致诊断服务在特定情况下无法正确返回NRC；AUTOSAR CP 4.4标准中对于NRC的使用有严格的规定，因此需要仔细检查配置以确保符合标准要求。
          reference DcmDspAuthenticationPersistStateModeRuleRef [0..1]: scope=ECU, multiplicity set at pre-compile, set at pre-compile, destination=DcmModeRule  # References a mode rule that defines if the authentication state shall be persisted in non-volatile memory. / 概述：DcmDspAuthenticationPersistStateModeRuleRef配置项用于引用一个模式管理规则，该规则定义了诊断会话控制（Diagnostic Session Control）下，认证状态（Authentication state）的持久性行为。 注意：在配置时，需要确保引用的模式管理规则与所需的认证状态持久性行为相匹配；此配置项对于实现会话控制逻辑至关重要，因此必须谨慎处理；AUTOSAR CP 4.4标准中，模式管理规则应当符合预定义的模式声明，以确保系统行为的一致性。
          container DcmDspAuthenticationConnection [0..*]  # This container contains the authentication configuration use for a dsl connection. / 概述：DcmDspAuthenticationConnection配置项用于定义诊断会话控制中，特定安全访问（Security Access）服务请求与ECU之间的认证连接参数。 注意：在配置时需确保安全算法和密钥长度符合AUTOSAR CP 4.4标准要求；认证过程中的时间限制和尝试次数应合理设置，以防止恶意攻击；该配置项的设置应与ECU的安全策略紧密相关，确保系统的安全性。
            reference DcmDspAuthenticationCertificatePublicKeyStoreJobRef: scope=ECU, multiplicity set at pre-compile, set at pre-compile, requires-symbolic-name-value=true, destination=CsmJob  # Reference to a CsmJob used to store the public key within the Csm. / 概述：DcmDspAuthenticationCertificatePublicKeyStoreJobRef 是一个配置项，用于引用存储认证证书公钥的作业，这通常是诊断通信管理（Diagnostic Communication Manager）的一部分，用于处理安全相关的认证过程。 注意：在配置DcmDspAuthenticationCertificatePublicKeyStoreJobRef时，需要确保引用的作业与实际的公钥存储作业相匹配；此配置项通常与车辆制造商的安全策略和诊断安全需求紧密相关；在实施时，应考虑与其他安全模块的接口和数据共享策略，以确保系统的整体安全性。
            reference DcmDspAuthenticationClientCertificateRef: scope=ECU, multiplicity set at pre-compile, set at pre-compile, requires-symbolic-name-value=true, destination=KeyMCertificate  # Reference to a KeyMCertificate used to handle the client certificate for this connection. / 概述：DcmDspAuthenticationClientCertificateRef配置项用于引用客户端证书，该证书在诊断通信安全中用于客户端认证过程，确保通信双方的身份可靠和数据的安全性。 注意：在配置客户端证书引用时，需要确保引用的证书与系统中实际使用的证书相匹配；此外，应当注意证书的有效期和更新机制，以防止因过期或失效的证书导致认证失败；AUTOSAR CP 4.4标准中对于证书的格式和存储可能有具体要求，需要根据标准进行相应配置。
            reference DcmDspAuthenticationClientChallengeSignJobRef: scope=ECU, multiplicity set at pre-compile, set at pre-compile, requires-symbolic-name-value=true, destination=CsmJob  # Reference to a job used to sign the client challenge. / 概述：DcmDspAuthenticationClientChallengeSignJobRef 是一个配置项，用于引用执行客户端挑战签名任务的加密服务作业，这通常是在执行诊断认证过程中的一部分。 注意：在配置DcmDspAuthenticationClientChallengeSignJobRef时，需要确保所引用的加密服务作业与实际的客户端挑战签名任务相匹配；此配置项必须指向有效的Crypto Service Job，否则认证过程可能无法正确执行；在AUTOSAR CP 4.4标准中，确保该配置项的使用与标准定义的服务作业管理机制兼容。
            reference DcmDspAuthenticationConnectionCertificateRef: scope=ECU, multiplicity set at pre-compile, set at pre-compile, requires-symbolic-name-value=true, destination=KeyMCertificate  # Reference to a KeyMCertificate used to store the certificate within the KeyM. / 概述：DcmDspAuthenticationConnectionCertificateRef配置项用于引用在诊断通信过程中用于认证的连接证书，这是确保通信安全性的一部分。 注意：在AUTOSAR CP 4.4标准中，确保引用的证书与实际用于认证的证书相匹配；证书管理应遵循AUTOSAR的安全规范；在配置时需注意证书的有效性和更新机制。
            reference DcmDspAuthenticationConnectionMainConnectionRef: scope=ECU, multiplicity set at pre-compile, set at pre-compile, destination=DcmDslMainConnection  # Reference to the dsl diagnostic connection that uses this authentication configuration. / 概述：DcmDspAuthenticationConnectionMainConnectionRef配置项用于引用诊断通信管理器（Diagnostic Communication Manager）中主连接的标识符，这是用于特定认证过程的诊断通信链路。 注意：确保引用的连接标识符在系统中是存在且有效的；该配置项通常与安全访问服务相关，需要正确配置以保证安全性；在多连接环境中，应注意选择正确的主连接以避免认证过程中的通信问题。
            reference DcmDspAuthenticationECUCertificateKeyElementRef [0..1]: scope=ECU, multiplicity set at pre-compile, set at pre-compile, requires-symbolic-name-value=true, destination=CryptoKeyElement  # Reference to a CryptoKeyElement used as server certificate during bi-directional authentication. / 概述：DcmDspAuthenticationECUCertificateKeyElementRef配置项用于引用存储在ECU中的证书或密钥元素，这些证书或密钥用于诊断服务中的安全认证过程。 注意：在配置DcmDspAuthenticationECUCertificateKeyElementRef时，需要确保引用的证书或密钥元素在ECU中确实存在并且可用；此外，应当注意证书或密钥的格式和安全要求是否符合AUTOSAR CP 4.4标准；最后，确保认证过程中对证书或密钥的访问权限和保护措施得当，以防止潜在的安全风险。
            reference DcmDspAuthenticationECUCertificateRef [0..1]: scope=ECU, multiplicity set at pre-compile, set at pre-compile, requires-symbolic-name-value=true, destination=CsmKey  # Reference to a KeyMCertificate with the server certificate for bi-directional authentication. / 概述：DcmDspAuthenticationECUCertificateRef配置项用于引用ECU证书，该证书通常用于诊断服务中的安全认证过程，以确保通信的安全性。 注意：在配置DcmDspAuthenticationECUCertificateRef时，需要确保引用的证书符合ECU的安全要求和标准；此外，该引用应正确指向存储在ECU中的有效证书；在AUTOSAR CP 4.4中，应检查该配置项是否与最新的诊断安全标准保持一致。
            reference DcmDspAuthenticationPublicKeyElementRef: scope=ECU, multiplicity set at pre-compile, set at pre-compile, requires-symbolic-name-value=true, destination=KeyMCertificateElement  # Reference to a certificate data element with the public key in the certificate. / 概述：DcmDspAuthenticationPublicKeyElementRef配置项用于引用存储在Crypto Certificate Manager中的公钥元素，该公钥用于诊断服务组件（Dcm）中的安全访问认证过程。 注意：在配置DcmDspAuthenticationPublicKeyElementRef时，必须确保引用的公钥元素与所需的安全算法和认证过程相匹配；公钥元素的存储位置和格式应符合AUTOSAR的加密服务管理规范；在实际应用中，公钥的管理和更新需要遵循严格的安全策略，以防止未授权的访问或篡改。
            reference DcmDspAuthenticationRandomJobRef: scope=ECU, multiplicity set at pre-compile, set at pre-compile, requires-symbolic-name-value=true, destination=CsmJob  # Reference to a certificate parse job used to parse the authentication certificate. / 概述：DcmDspAuthenticationRandomJobRef配置项用于引用在诊断会话中用于认证的随机数生成作业，它是诊断安全访问服务的一部分，确保安全性要求得到满足。 注意：在配置DcmDspAuthenticationRandomJobRef时，需要确保引用的作业符合AUTOSAR标准中定义的随机数生成机制；此配置项通常与安全算法和密钥管理模块紧密相关，因此需要与安全专家协作以确保正确实现；在不同的安全等级下，可能需要配置不同的随机数生成作业，因此应根据项目的安全需求进行配置。
            reference DcmDspAuthenticationRoleElementRef: scope=ECU, multiplicity set at pre-compile, set at pre-compile, requires-symbolic-name-value=true, destination=KeyMCertificateElement  # Reference to a certificate data element with the role in the certificate. / 概述：DcmDspAuthenticationRoleElementRef配置项用于引用特定的安全访问角色元素，它定义了诊断会话控制（Diagnostic Session Control）中安全访问（Security Access）服务所需的认证和授权级别。 注意：在配置DcmDspAuthenticationRoleElementRef时，需要确保引用的安全访问角色元素在系统中是存在且有效的；此外，应当注意角色元素与所需安全级别之间的匹配关系，以确保正确的访问控制；AUTOSAR CP 4.4标准中对安全访问的配置可能有特定的要求和限制，需要遵守这些规范以保证系统的安全性。
            reference DcmDspAuthenticationTargetIdentificationModeRuleRef [0..1]: scope=ECU, multiplicity set at pre-compile, set at pre-compile, destination=DcmModeRule  # Reference to a mode rule that is used to evaluate the target identification. / 概述：DcmDspAuthenticationTargetIdentificationModeRuleRef配置项用于定义诊断会话控制（Diagnostic Session Control）中，针对特定诊断请求的认证和授权过程中，目标识别模式的规则引用。 注意：此配置项要求与安全访问（Security Access）服务的配置紧密协调，确保诊断安全级别和目标识别模式的一致性；在配置时需确保引用的规则与实际的安全策略相匹配，避免安全漏洞；AUTOSAR CP 4.4标准中对此配置项的具体要求可能与早期版本有所不同，需要仔细核对标准文档。
            reference DcmDspAuthenticationVerifyProofOfOwnerShipClientJobRef: scope=ECU, multiplicity set at pre-compile, set at pre-compile, requires-symbolic-name-value=true, destination=CsmJob  # Reference to a CsmJob used to verify the proof of ownership client in the Csm. / 概述：DcmDspAuthenticationVerifyProofOfOwnerShipClientJobRef 是用于引用执行车辆所有权证明验证的客户端服务作业的配置项，它确保了诊断通信管理器（Dcm）在进行安全访问时能够正确调用相关的服务作业。 注意：在配置时需确保引用的客户端服务作业与实际实现的认证机制相匹配；若该配置项引用错误，可能会导致安全访问验证失败；AUTOSAR CP 4.4标准中应保持该配置项与相关的认证服务作业之间的一致性和正确性。
            reference DcmDspAuthenticationWhiteListDIDElementRef [0..1]: scope=ECU, multiplicity set at pre-compile, set at pre-compile, requires-symbolic-name-value=true, destination=KeyMCertificateElement  # Reference to a certificate data element with the white list for data identifiers in the certificate. / 概述：DcmDspAuthenticationWhiteListDIDElementRef配置项用于指定在执行诊断会话控制或安全访问服务时，不需要进行安全访问认证的数据标识符（DID）列表。 注意：在配置此项时，确保只有那些确实不需要安全保护的DID被列入白名单；不恰当的配置可能会导致安全风险；AUTOSAR CP 4.4标准中应当有明确的定义和限制关于哪些DID可以被包含在白名单中。
            reference DcmDspAuthenticationWhiteListMemorySelectionElementRef [0..1]: scope=ECU, multiplicity set at pre-compile, set at pre-compile, requires-symbolic-name-value=true, destination=KeyMCertificateElement  # Reference to a certificate data element with the white list for user defined memory selection in the certificate. / 概述：DcmDspAuthenticationWhiteListMemorySelectionElementRef配置项用于定义诊断服务中，哪些内存区域可以在没有进行安全访问认证的情况下被访问，以支持特定的诊断需求。 注意：在配置时需确保所选内存区域的访问不会影响系统的安全性和稳定性；该配置项在AUTOSAR CP 4.4中可能没有直接对应，需要通过安全访问配置来间接实现；正确配置白名单内存区域对于避免潜在的安全风险至关重要。
            reference DcmDspAuthenticationWhiteListRIDElementRef [0..1]: scope=ECU, multiplicity set at pre-compile, set at pre-compile, requires-symbolic-name-value=true, destination=KeyMCertificateElement  # Reference to a certificate data element with the white list for routine identifiers in the certificate. / 概述：DcmDspAuthenticationWhiteListRIDElementRef 是用于定义在诊断会话中，哪些诊断请求标识符（RID）可以在没有安全访问（即不需要进行安全认证）的情况下被执行。 注意：此配置项应谨慎使用，以避免安全漏洞；确保只有非敏感操作被列入白名单；AUTOSAR CP 4.4标准中未明确提及此配置项，可能属于特定实现或扩展。
            reference DcmDspAuthenticationWhiteListServicesElementRef: scope=ECU, multiplicity set at pre-compile, set at pre-compile, requires-symbolic-name-value=true, destination=KeyMCertificateElement  # Reference to a certificate data element with the white list in the certificate. / 概述：DcmDspAuthenticationWhiteListServicesElementRef配置项用于定义在执行诊断会话控制时，不需要进行安全访问认证的服务列表。 注意：在配置此项时，必须确保只有那些不影响车辆安全和安全性的服务被列入白名单；应遵循相关的法规和标准，确保不会因为绕过安全认证而暴露敏感操作；在AUTOSAR CP 4.4标准中，应正确使用引用机制来指向具体的服务，以保证配置的一致性和正确性。
        container DcmDspClearDTC [0..1]  # This container contains the configuration for the Clear DTC service. / 概述：DcmDspClearDTC是一个配置参数，用于定义诊断通信管理器（Diagnostic Communication Manager）中的DTC（Diagnostic Trouble Code）清除服务的行为和属性，包括清除DTC的范围和条件。 注意：在配置DcmDspClearDTC时，需要确保它符合车辆制造商的诊断策略和法规要求；此外，应注意与其他诊断服务的交互，以及在不同诊断会话控制下的DTC清除权限。
          function name DcmDspClearDTCCheckFnc [0..1]: scope=ECU, multiplicity set at pre-compile, set at pre-compile  # Callback function for condition check, manufacturer / supplier specific checks on the groupOfDTC, which is requested to clear. / 概述：DcmDspClearDTCCheckFnc配置项用于定义一个函数，该函数在执行故障码清除（Clear Diagnostic Trouble Codes, DTCs）操作之前被调用，以检查是否满足清除DTC的条件。 注意：在配置DcmDspClearDTCCheckFnc时，需要确保所引用的函数符合AUTOSAR标准中对该函数的定义和要求；该函数的实现应当仅检查清除DTC的条件，而不执行其他诊断服务或副作用；在设计该函数时，应考虑到车辆状态和安全要求，确保在适当的条件下才允许清除DTC。 | This parameter is related to the interface : Xxx_ClearDTCCheckFnc.
          reference DcmDspClearDTCModeRuleRef [0..1]: scope=ECU, multiplicity set at link in variant link-time / pre-compile in variant post-build+pre-compile, set at link in variant link-time / pre-compile in variant post-build+pre-compile, destination=DcmModeRule  # Reference to DcmModeRule / 概述：DcmDspClearDTCModeRuleRef配置项用于定义诊断服务中清除故障码（DTC）操作的模式规则引用，指定在何种条件下允许执行清除DTC的操作。 注意：确保引用的模式规则与实际的诊断需求相匹配，避免因规则设置不当导致清除DTC操作无法按预期执行；在配置时需考虑车辆的安全和诊断策略，确保不会误清除关键故障码；AUTOSAR CP 4.4标准中，对于DcmDspClearDTCModeRuleRef的具体实现细节和限制可能有更新，建议参考最新的AUTOSAR文档。 | Mode rule which controls to clear the DTCs. If there is no reference, no check of the mode rule shall be done.
        container DcmDspComControl [0..1]  # Provides the configuration of the CommunicationControl mechanism. / 概述：DcmDspComControl配置项是用于定义诊断通信控制服务（Diagnostic Communication Manager Service）的参数，它允许控制ECU（电子控制单元）的通信能力，例如开启或关闭ECU的网络通信。 注意：在配置DcmDspComControl时，需要确保与ECU支持的诊断服务和安全级别相匹配；此外，应考虑与其他诊断服务的交互和对车辆网络的影响；AUTOSAR CP 4.4标准中可能对该服务的实现和配置有具体的要求和限制，需要遵循这些规范来确保兼容性和正确性。
          container DcmDspComControlAllChannel [0..255]  # Collection of ComM channels which shall be controlled if all networks are addressed. / 概述：DcmDspComControlAllChannel 是一个配置项，用于定义诊断通信管理（Diagnostic Communication Manager）中是否允许对所有通信通道执行通信控制。 注意：在AUTOSAR CP 4.4标准中，需要确保Dcm模块配置与通信堆栈的其他部分兼容；如果不需要对所有通道执行通信控制，应避免启用此配置以节省资源；此配置项的使用应符合车辆制造商的诊断策略和安全要求。
            boolean DcmDspComControlAllChannelUsed: post-build-variant-value=true, set at link in variant link-time / post-build in variant post-build / pre-compile in variant pre-compile, default-value=true  # Allow to activate or deactivate the usage of a ComM channel collection to be controlled, for multi purpose ECUs / 概述：DcmDspComControlAllChannelUsed配置项用于指定在执行通信控制服务时，是否允许控制所有通信通道。 注意：在AUTOSAR CP 4.4标准中，此配置项确保了诊断通信控制服务（Service 0x28）能够按需控制单个或所有通信通道；若设置为允许，需确保系统设计能够安全地处理对所有通道的控制；不正确的配置可能导致通信中断或系统行为不稳定。 | true = ComM channel collection used false = ComM channel collection not used
            reference DcmDspAllComMChannelRef: scope=ECU, post-build-variant-value=true, set at link in variant link-time / post-build in variant post-build / pre-compile in variant pre-compile, requires-symbolic-name-value=true, destination=ComMChannel  # Reference to ComM channel. / 概述：DcmDspAllComMChannelRef配置项用于引用诊断通信管理器（Diagnostic Communication Manager）中所有通信通道的标识符，这些通道在执行诊断会话控制时需要被管理。 注意：在配置DcmDspAllComMChannelRef时，需要确保引用的ComM通道标识符与实际的通信通道配置相匹配；此配置项对于确保在不同诊断会话中正确管理通信通道至关重要；在AUTOSAR CP 4.4标准中，应当遵循相关的模块间接口定义和引用机制。
          container DcmDspComControlSetting [0..1]  # Provide the configuration of the Communication control. / 概述：DcmDspComControlSetting 用于定义诊断通信控制模块的设置，包括启用或禁用网络通信控制功能。 注意：在配置DcmDspComControlSetting时，必须确保与车辆的网络管理策略一致；此配置项应根据具体的车辆网络需求和诊断需求进行调整；不正确的设置可能导致网络通信异常或诊断功能不可用。
            reference DcmDspComControlCommunicationReEnableModeRuleRef [0..1]: scope=ECU, multiplicity set at link in variant link-time / pre-compile in variant post-build+pre-compile, set at link in variant link-time / pre-compile in variant post-build+pre-compile, destination=DcmModeRule  # Reference to DcmModeRule Mode rule which controls re-enabling / 概述：DcmDspComControlCommunicationReEnableModeRuleRef配置项用于引用一个定义了通信控制器重新启用模式的规则，这个规则指定了在执行诊断通信控制时，通信通道如何被重新启用。 注意：确保引用的模式规则与实际的通信控制需求相匹配；在配置时要注意引用的模式规则必须已在系统中定义；在多通道通信系统中，要确保每个通道的重新启用规则正确配置，以避免通信混乱。 | of communication by DCM. [ref. SWS_Dcm_00753]
          container DcmDspComControlSpecificChannel [0..*]  # Assigns subnet number to ComM channel which will be controlled. / 概述：DcmDspComControlSpecificChannel配置项用于定义诊断服务组件（Dcm）中，通信控制服务（Communication Control, 0x28）针对特定通信通道的控制属性和行为。 注意：在配置时需确保通道标识符与实际系统中的通信通道相匹配；该配置项在AUTOSAR CP 4.4中要求明确支持网络管理控制器的能力，如果系统不支持，应在设计时予以考虑；配置应遵循ECU支持的通信协议和标准，确保兼容性和协议一致性。
            boolean DcmDspComControlSpecificChannelUsed: post-build-variant-value=true, set at link in variant link-time / post-build in variant post-build / pre-compile in variant pre-compile, default-value=true  # Allow to activate or deactivate the usage of a Subnet assigned to the ComM channel which will be controlled, for multi purpose ECUs. / 概述：DcmDspComControlSpecificChannelUsed配置项用于指定诊断服务是否允许对特定的通信通道进行控制，这有助于在执行诊断会话时，根据需要启用或禁用特定的通信路径。 注意：在AUTOSAR CP 4.4标准中，确保在使用此配置项时，已经明确了哪些通信通道可以被控制，以避免对系统通信造成意外的干扰；此配置项的使用应与车辆制造商的安全和诊断策略保持一致；在配置时，应详细考虑对通信通道控制的影响，确保不会影响到系统的正常运行和安全。 | true = Subnet used false = Subnet not used
            integer DcmDspSubnetNumber: 1..14, scope=ECU, set at pre-compile  # Subnet Number which controls the specific ComMChannel. / 概述：DcmDspSubnetNumber配置项用于定义诊断通信管理器（Diagnostic Communication Manager）中子网的数量，这有助于管理不同网络子集上的诊断通信。 注意：在配置DcmDspSubnetNumber时，需要确保其值反映了实际网络拓扑中存在的子网数量；超出实际子网数量的配置可能会导致资源浪费；如果配置的子网数量少于实际存在的子网，可能会导致部分子网上的诊断请求无法得到处理。
            reference DcmDspSpecificComMChannelRef: scope=ECU, post-build-variant-value=true, set at link in variant link-time / post-build in variant post-build / pre-compile in variant pre-compile, requires-symbolic-name-value=true, destination=ComMChannel  # Reference to ComM channel. / 概述：DcmDspSpecificComMChannelRef配置项用于指定诊断通信管理器（Diagnostic Communication Manager）中特定的通信通道引用，以便于Dcm模块控制特定通道的通信状态。 注意：在配置DcmDspSpecificComMChannelRef时，需要确保引用的ComM通道已经在系统中定义并且有效；此配置项通常与车辆网络相关的诊断功能紧密相关，因此需要根据网络架构和诊断需求谨慎配置；在AUTOSAR CP 4.4标准中，应当遵循相关的模块间接口定义和配置规则，以确保模块间的兼容性和通信的正确性。
          container DcmDspComControlSubNode [0..65535]  # This container gives information about the node identification number and the ComM channel used to address a sub-network. / 概述：DcmDspComControlSubNode配置项用于定义诊断通信控制服务（Diagnostic Communication Manager Service）中子节点的通信控制选项，它指定了哪些网络节点（ECUs）的通信可以被控制。 注意：在配置DcmDspComControlSubNode时，需要确保子节点的标识符与实际网络中的ECU标识符相匹配；此配置项通常与车辆网络拓扑结构和诊断需求紧密相关，因此需要根据具体的车辆网络设计来进行配置；在AUTOSAR CP 4.4标准中，应当遵循相关的诊断服务规范来确保通信控制的正确实施。
            boolean DcmDspComControlSubNodeUsed: post-build-variant-value=true, set at link in variant link-time / post-build in variant post-build / pre-compile in variant pre-compile, default-value=true  # This parameter determines if a node control function is available or not. / 概述：DcmDspComControlSubNodeUsed 是一个配置项，用于指定是否在诊断通信控制（Dcm）服务中使用子节点控制。 注意：在AUTOSAR CP 4.4标准中，如果项目需要支持对网络中的子节点（如网关下的各个ECU）进行通信控制，则应启用此配置项；如果不需要子节点控制功能，该配置项应设置为不启用以节省资源；在配置时需要确保与项目需求和网络架构相匹配。
            integer DcmDspComControlSubNodeId: 1..65535, scope=ECU, set at link in variant link-time / pre-compile in variant post-build+pre-compile  # The node identification number DcmDspComControlSubNodeId is addressed by the CommunicationControl (0x28) request. / 概述：DcmDspComControlSubNodeId配置项用于定义诊断通信控制服务（Diagnostic Communication Manager Service Processor）中子网络的标识符，这有助于管理不同子网络上的通信控制。 注意：在配置DcmDspComControlSubNodeId时，需要确保子网络标识符的唯一性，以避免在诊断会话中的冲突；此外，标识符应与实际网络结构相对应，确保正确的通信控制；在AUTOSAR CP 4.4标准中，如果子网络的概念被用于项目中，该配置项应当与网络管理配置紧密协调。
            reference DcmDspComControlSubNodeComMChannelRef: scope=ECU, post-build-variant-value=true, set at link in variant link-time / post-build in variant post-build / pre-compile in variant pre-compile, requires-symbolic-name-value=true, destination=ComMChannel  # This parameter references a ComM channel where this node is connected to. / 概述：DcmDspComControlSubNodeComMChannelRef配置项用于定义诊断服务组件（Dcm）中，特定子节点与通信管理（ComM）通道的关联，以便控制网络通信状态。 注意：确保引用的ComM通道与子节点兼容；在配置时需注意AUTOSAR版本对ComM通道引用的具体要求可能有所不同；此配置项对于实现网络管理和诊断通信控制功能至关重要。
        container DcmDspCommonAuthorization [0..255]  # This container contains the configuration (parameters) for the common Authorization being equal for several services / sub-services. / 概述：DcmDspCommonAuthorization配置项用于定义诊断服务的授权级别，它规定了访问不同诊断服务时所需的安全级别，以确保只有授权用户可以执行特定的诊断操作。 注意：在配置DcmDspCommonAuthorization时，需要确保授权级别与实际的安全需求相匹配；此外，应注意与Dcm的安全策略和密钥管理机制的兼容性；在AUTOSAR CP 4.4标准中，应遵循相关的模块和服务的安全规范。
          reference DcmDspCommonAuthorizationModeRuleRef [0..1]: scope=ECU, multiplicity set at link in variant link-time / pre-compile in variant post-build+pre-compile, set at link in variant link-time / pre-compile in variant post-build+pre-compile, destination=DcmModeRule  # Reference to DcmModeRule / 概述：DcmDspCommonAuthorizationModeRuleRef配置项用于引用一个授权模式规则，该规则定义了对诊断服务请求的访问权限控制，以确保只有授权的用户可以访问特定的诊断服务。 注意：在配置时需确保引用的授权模式规则已经定义且有效；授权模式规则的配置应与系统的安全需求相匹配，以防未授权访问；AUTOSAR CP 4.4中，对授权模式的支持和实现细节可能有所不同，需要参考具体的AUTOSAR文档。 | Mode rule which controls this service/ sub-service. If there is no reference, no check of the mode rule shall be done.
          reference DcmDspCommonAuthorizationSecurityLevelRef [0..255]: scope=ECU, multiplicity set at link in variant link-time / pre-compile in variant post-build+pre-compile, set at link in variant link-time / pre-compile in variant post-build+pre-compile, destination=DcmDspSecurityRow  # Reference to DcmDspSecurityRow / 概述：DcmDspCommonAuthorizationSecurityLevelRef配置项用于引用在诊断服务处理期间需要的安全等级，它定义了访问特定诊断服务时所需的安全授权级别。 注意：在配置时需确保引用的安全等级与实际实现的安全策略相匹配；若引用了不存在的安全等级，可能导致诊断服务无法正确执行；在多安全等级的系统中，正确管理和配置每个服务的安全等级至关重要。 | Security levels allowed to control this service/ sub-service. If there is no reference, no check of security level shall be done.
          reference DcmDspCommonAuthorizationSessionRef [0..255]: scope=ECU, multiplicity set at link in variant link-time / pre-compile in variant post-build+pre-compile, set at link in variant link-time / pre-compile in variant post-build+pre-compile, destination=DcmDspSessionRow  # Reference to DcmDspSessionRow / 概述：DcmDspCommonAuthorizationSessionRef配置项用于定义诊断服务组件（Diagnostic Service Component）在执行特定服务前所需的会话控制权限，确保只有在适当的会话级别下才能访问和执行特定的诊断服务。 注意：该配置项需要与会话控制管理模块的会话级别定义保持一致；确保为每个需要会话控制的诊断服务正确配置会话级别；不正确的会话级别配置可能导致诊断服务无法在预期的会话中执行。 | Sessions allowed to control this service/ sub-service. If there is no reference, no check of session level shall be done.
          reference DcmDspCommonAuthorizationVehicleSystemGroupRef [0..255]: scope=ECU, multiplicity set at link in variant link-time / pre-compile in variant post-build+pre-compile, set at link in variant link-time / pre-compile in variant post-build+pre-compile, destination=DcmDspVehicleSystemGroupRow  # Defines RID availability dependency to a specific VSG / 概述：DcmDspCommonAuthorizationVehicleSystemGroupRef 用于定义诊断会话控制中，特定车辆系统组的访问权限引用。 注意：确保引用的车辆系统组在系统中已定义且有效；此配置项对安全性要求高，应仔细管理权限设置；在AUTOSAR CP 4.4中，此配置项的使用应符合最新的安全和诊断标准。 | VSGs allowed to control this service/ sub-service. If there is no reference, no check of vsg shall be done.
        container DcmDspControlDTCSetting [0..1]  # Provide the configuration of the ControlDTCSetting mechanism. / 概述：DcmDspControlDTCSetting配置项用于定义诊断通信管理器（Diagnostic Communication Manager）中，控制诊断故障码（DTC）设置的行为和属性，如启用或禁用DTC的存储。 注意事项：在配置DcmDspControlDTCSetting时，需确保与车辆制造商的诊断策略一致；此配置项对故障诊断和后续的故障处理流程有重要影响；AUTOSAR CP 4.4标准中，对DTC控制的具体实现细节有明确规范，需遵守这些规范以保证兼容性。
          boolean DcmSupportDTCSettingControlOptionRecord [0..1]: scope=ECU, multiplicity set at pre-compile, set at pre-compile, default-value=false  # This configuration switch defines if the DTCSettingControlOptionRecord is in general supported in the request message or not. / 概述：DcmSupportDTCSettingControlOptionRecord配置项用于定义诊断通信管理器（Diagnostic Communication Manager）是否支持故障码设置控制选项记录功能，这是一个用于控制故障诊断记录开启或关闭的功能。 注意：在配置Dcm模块时，需要根据项目需求决定是否启用此功能；如果启用，需确保与故障管理模块的交互被正确实现；在不同地区的法规要求可能不同，需要根据目标市场的法规要求来配置此项。
          reference DcmDspControlDTCSettingReEnableModeRuleRef [0..1]: scope=ECU, multiplicity set at link in variant link-time / pre-compile in variant post-build+pre-compile, set at link in variant link-time / pre-compile in variant post-build+pre-compile, destination=DcmModeRule  # Reference to DcmModeRule / 概述：DcmDspControlDTCSettingReEnableModeRuleRef配置项用于引用诊断服务组件中控制DTC设置的重新启用模式规则，这决定了在何种条件下可以重新启用DTC记录。 注意：确保引用的模式规则与实际的诊断需求和法规要求相匹配；在配置时应参照相关的诊断需求文档；在AUTOSAR CP 4.4标准中，应保证该引用的模式规则在系统中是存在且有效的。 | Mode rule which controls re-enabling of controlDTCsetting by DCM. The DCM module shall execute a ControlDTCSetting.Off (call Dem_EnableDTCSetting()) in case that the referenced mode rule is not fulfilled anymore.
        container DcmDspData [0..*]  # This container contains the configuration (parameters) of a Data belonging to a DID / 概述：DcmDspData配置项用于定义诊断服务处理模块中的数据属性，如数据标识符和数据类型，以便正确处理来自诊断工具的请求。 注意：确保数据标识符的唯一性和与标准诊断数据标识符的一致性；数据类型应符合AUTOSAR CP 4.4标准中定义的类型；在配置时需考虑数据的安全性和访问权限控制。
          add info DcmDspOdxDataDescription [0..1]: multiplicity set at pre-compile, set at pre-compile  # Defines additional description for ODX documentation / 概述：DcmDspOdxDataDescription配置项用于定义诊断通信管理器（Diagnostic Communication Manager）中，ODX（Open Diagnostic data eXchange）文件中的数据描述，这些描述包括用于车辆诊断的数据结构和参数。 注意：在AUTOSAR CP 4.4中，确保ODX文件与Dcm模块的配置保持一致；ODX数据描述应符合ISO 22901-1标准；在实施时，应注意数据描述的精确性和兼容性，以确保诊断服务的正确性。
          boolean DcmDspDataConditionCheckReadFncUsed [0..1]: multiplicity set at pre-compile, set at pre-compile, default-value=false  # This parameter determines if a condition check function is available or not. / 概述：DcmDspDataConditionCheckReadFncUsed 是一个配置项，用于指定是否使用了数据条件检查读取功能，这是诊断通信管理器（Diagnostic Communication Manager）的一部分，用于在读取数据之前检查是否满足特定条件。 注意：在AUTOSAR CP 4.4标准中，该配置项应当与实际实现的功能相匹配；如果未实现数据条件检查功能，则该配置项应设置为false；如果实现了该功能，确保相关函数的正确实现和配置。
          enumeration DcmDspDataEndianness [0..1]: {BIG_ENDIAN, LITTLE_ENDIAN, OPAQUE}, multiplicity set at link in variant link-time / pre-compile in variant post-build+pre-compile, set at link in variant link-time / pre-compile in variant post-build+pre-compile, default-value=opaque  # Defines the endianness of the data belonging to a DID in a diagnostic request or response message. / 概述：DcmDspDataEndianness配置项用于定义诊断服务处理数据时所采用的字节序，确保数据的正确解析和编码，可以是大端（Big Endian）或小端（Little Endian）。 注意：在配置DcmDspDataEndianness时，需要确保它与ECU中数据的实际存储格式一致；不正确的字节序配置可能导致诊断响应错误或数据解析失败；AUTOSAR CP 4.4标准中，该配置项应与ECU的硬件架构和编译器设置保持一致。
          enumeration DcmDspDataType: {UINT8, UINT8_N}, scope=ECU, set at link in variant link-time / pre-compile in variant post-build+pre-compile, default-value=UINT8  # Provide the implementation data type of data belonging to a DID. / 概述：DcmDspDataType配置项用于定义诊断服务处理器（Diagnostic Service Processor）中使用的数据类型，这些数据类型用于读取或写入数据时与ECU内部数据类型的映射。 注意：在配置DcmDspDataType时，需要确保数据类型的定义与ECU支持的实际数据类型相匹配；此外，应注意数据类型的大小、符号性以及字节序（大端或小端）是否符合ECU的硬件架构和应用需求；在AUTOSAR CP 4.4标准中，数据类型的配置应遵循标准规定的数据类型模板。
          enumeration DcmDspDataUsePort: {USE_DATA_ASYNCH_CLIENT_SERVER, USE_DATA_ASYNCH_FNC, USE_DATA_SYNCH_CLIENT_SERVER, USE_DATA_SYNCH_FNC, USE_BLOCK_ID}, scope=ECU, set at pre-compile, default-value=USE_DATA_ASYNCH_CLIENT_SERVER  # Defines which interface shall be used to access the data. / 概述：DcmDspDataUsePort配置项指定了诊断服务组件（Diagnostic Service Component）如何访问车辆数据，即通过哪种端口（Sender-Receiver或Client-Server）与其他软件组件交互以获取或设置数据。 注意：在AUTOSAR CP 4.4中，确保选择的端口类型与所需的数据交互模式兼容；配置时需考虑数据的实时性要求和安全性要求；不同的端口类型可能会影响系统的响应时间和资源占用。
          function name DcmDspDataConditionCheckReadFnc [0..1]: scope=ECU, multiplicity set at pre-compile, set at pre-compile  # Function name to demand application if the conditions (e.g. System state) to read the DID are correct. (ConditionCheckRead-function). / 概述：DcmDspDataConditionCheckReadFnc配置项用于定义一个函数，该函数在读取诊断数据之前执行，用于检查是否满足读取条件。 注意：该函数应返回一个标准的Dcm_ReturnReadDataConditionCheckType枚举值，以指示读取条件是否满足；如果读取条件不满足，应阻止数据的读取并返回相应的错误码；确保该函数的实现与系统的安全和权限管理策略一致。 | Multiplicity shall be equal to parameter DcmDspDataReadFnc. This parameter is related to the interface Xxx_ConditionCheckRead.
          function name DcmDspDataEcuSignal [0..1]: scope=ECU, multiplicity set at pre-compile, set at pre-compile  # Function name to control the access to a certain ECU Signal by the DCM. (IoHwAb_Dcm_<symbolic name of ECU signal>-function). / 概述：DcmDspDataEcuSignal配置项用于定义诊断服务中与ECU信号相关的数据，它指定了如何从ECU中读取或向ECU写入数据。 注意：在配置DcmDspDataEcuSignal时，需要确保引用的数据标识符与ECU中实际的信号匹配；此外，还需注意数据的读写权限和安全访问条件是否符合要求；在配置数据信号时，还应考虑数据的格式和长度是否符合诊断标准和ECU的实际处理能力。
          function name DcmDspDataFreezeCurrentStateFnc [0..1]: scope=ECU, multiplicity set at pre-compile, set at pre-compile  # Function name to request to application to freeze the current state of an IOControl. (FreezeCurrentState-function). / 概述：DcmDspDataFreezeCurrentStateFnc是一个配置项，用于定义诊断服务组件（Diagnostic Communication Manager）中的数据服务处理函数，该函数用于冻结当前的数据状态，通常与诊断服务如读取冻结帧数据相关。 注意：在配置DcmDspDataFreezeCurrentStateFnc时，需要确保该函数与实际的数据冻结需求相匹配，并且符合ECU的硬件和软件能力；该函数的实现必须满足AUTOSAR标准中对诊断服务的要求；在实现时应注意资源的同步和互斥，避免在多任务环境下的数据一致性问题。 | This parameter is related to the interface Xxx_FreezeCurrentState.
          function name DcmDspDataGetScalingInfoFnc [0..1]: scope=ECU, multiplicity set at pre-compile, set at pre-compile  # Function name to request to application the scaling information of the DID. (GetScalingInformation-function). / 概述：DcmDspDataGetScalingInfoFnc是一个配置项，用于指定一个函数，该函数由诊断通信管理器（Diagnostic Communication Manager）调用，以获取数据标识符（Data Identifier, DID）的缩放信息。 注意：在配置DcmDspDataGetScalingInfoFnc时，需要确保所引用的函数符合AUTOSAR标准中定义的原型和行为要求；此函数通常与DID相关联，因此必须确保DID配置正确；在实现时，应注意缩放信息的准确性和与DID的一致性。 | This parameter is related to the interface Xxxx_GetScalingInformation.
          function name DcmDspDataReadDataLengthFnc [0..1]: scope=ECU, multiplicity set at pre-compile, set at pre-compile  # Function name to request from application the data length of a DID. (ReadDataLength-function). / 概述：DcmDspDataReadDataLengthFnc配置项用于定义一个函数，该函数负责返回诊断服务中特定数据标识符（DID）的数据长度，确保数据交换的准确性和有效性。 注意：在实现该函数时，需要确保返回的数据长度准确反映了对应DID的实际数据大小；对于可变长度的DID，该函数实现应能动态计算并返回正确的长度；在AUTOSAR CP 4.4标准中，该配置项的命名和功能需遵循规范，以保证诊断服务的兼容性和互操作性。 | This parameter is related to the interface Xxx_ReadDataLength.
          function name DcmDspDataReadEcuSignal [0..1]: scope=ECU, multiplicity set at pre-compile, set at pre-compile  # Function name for read access to a certain ECU Signal by the DCM. (IoHwAb_Dcm_Read<EcuSignalName>-function). / 概述：DcmDspDataReadEcuSignal 用于定义诊断服务组件中，从ECU读取信号的配置和行为。 注意：确保配置的信号与ECU支持的信号匹配；在配置时应注意数据的安全性和访问权限；此配置项应与ECU的实际硬件和软件能力相一致。 | Only relevant if DcmDspDataUsePort==USE_ECU_SIGNAL.
          function name DcmDspDataReadFnc [0..1]: multiplicity set at pre-compile, set at pre-compile  # Function name to request from application the data value of a DID. / 概述：DcmDspDataReadFnc配置项指定了用于读取诊断数据的函数，这是在诊断服务中用于获取ECU内部数据的函数指针。 注意：确保该函数与实际的数据读取逻辑相匹配，以保证诊断服务的正确执行；在配置时需注意函数的返回类型和参数列表与AUTOSAR标准的一致性；对于不同的数据项可能需要配置不同的读取函数。 | (ReadData-function). This parameter is related to the interface Xxx_ReadData.
          function name DcmDspDataResetToDefaultFnc [0..1]: scope=ECU, multiplicity set at pre-compile, set at pre-compile  # Function name to request to application to reset an IOControl to default value. (ResetToDefault-function). / 概述：DcmDspDataResetToDefaultFnc配置项用于定义诊断服务组件（Diagnostic Communication Manager）中，特定数据元素重置为默认值时所调用的函数。 注意：该函数需要确保能够将数据安全地重置为出厂设置或预定义的默认状态；在实现时需考虑数据重置过程中可能对系统其他部分产生的影响；根据AUTOSAR CP 4.4标准，确保该函数符合诊断服务的安全和权限要求。 | This parameter is related to the interface Xxx_ResetToDefault.
          function name DcmDspDataReturnControlToEcuFnc [0..1]: scope=ECU, multiplicity set at pre-compile, set at pre-compile  # Function name to request to application to return control to ECU of an IOControl. (ReturnControlToECU-function). / 概述：DcmDspDataReturnControlToEcuFnc配置项用于定义诊断服务组件（Diagnostic Communication Manager）中，执行"返回控制权给ECU"操作的函数指针，该操作是服务0x31（写数据或调整参数）的一部分。 注意：在配置该函数指针时，确保所引用的函数与AUTOSAR标准中定义的原型一致；函数实现应确保能够将数据项的控制权从诊断工具返回给ECU；在多ECU系统中，应确保该函数能够正确区分并作用于目标ECU。 | This parameter is related to the interface Xxx_ReturnControlToECU.
          function name DcmDspDataShortTermAdjustmentFnc [0..1]: scope=ECU, multiplicity set at pre-compile, set at pre-compile  # Function name to request to application to adjust the IO signal. (ShortTermAdjustment-function). / 概述：DcmDspDataShortTermAdjustmentFnc配置项用于定义诊断服务组件（Diagnostic Communication Manager）中，短期调整数据的函数名称，该函数用于处理来自诊断测试仪的调整请求。 注意：函数名称应遵循C语言命名规则，避免与其他函数名冲突；确保该函数实现符合AUTOSAR标准中对短期调整的要求；在配置时需注意与Dcm配置的其他部分的一致性，如数据标识符和服务标识符的匹配。 | This parameter is related to the interface Xxx_ShortTermAdjustment.
          function name DcmDspDataWriteFnc [0..1]: scope=ECU, multiplicity set at pre-compile, set at pre-compile  # Function name to request application to write the data value of a DID. (WriteData-function). / 概述：DcmDspDataWriteFnc配置项用于定义诊断服务组件（Diagnostic Communication Manager）中，用于写入数据到ECU的函数指针。 注意：在AUTOSAR CP 4.4标准中，确保该函数指针指向的函数遵循了标准的API原型；该函数通常与DcmDspData元素相关联，需要确保数据一致性和安全性；在实现时，应考虑对写入操作的权限管理和错误处理。 | This parameter is related to the interface Xxx_WriteData.
          integer DcmDspDataByteSize [0..1]: 0..65535, scope=ECU, multiplicity set at link in variant link-time / pre-compile in variant post-build+pre-compile, set at link in variant link-time / pre-compile in variant post-build+pre-compile  # Defines the array length in bytes or the the maximum array length for variable datalengths. / 概述：DcmDspDataByteSize配置项用于定义诊断服务处理中，数据元素的大小，即数据元素占用的字节数。 注意：在配置DcmDspDataByteSize时，需要确保其值与实际数据元素的大小相匹配；超出有效范围的配置可能导致数据处理错误；AUTOSAR CP 4.4标准中可能有特定的限制或要求，需要遵守这些规范以确保兼容性。
          reference DcmDspDataBlockIdRef [0..1]: scope=ECU, multiplicity set at pre-compile, origin=AUTOSAR_ECUC V1.0.0, set at pre-compile, requires-symbolic-name-value=true, destination=NvMBlockDescriptor  # NRAM blockId to access the data. / 概述：DcmDspDataBlockIdRef 用于引用诊断服务中的特定数据块标识符，该标识符用于访问或修改ECU中存储的数据。 注意：确保引用的数据块标识符在整个诊断系统中是唯一的；在配置时应关联正确的数据块以避免数据错误；在AUTOSAR CP 4.4中，对数据块的访问权限和安全性要求应严格遵守。 | Only relevant if DcmDspDataUsePort==USE_BLOCK_ID.
          reference DcmDspDataInfoRef: scope=ECU, set at pre-compile, destination=DcmDspDataInfo  # Reference to 1 DcmDspDataInfo / 概述：DcmDspDataInfoRef配置项用于引用数据元素的特定信息，这些信息定义了数据元素如何被诊断服务处理，包括读取和写入权限、安全访问级别等。 注意：确保引用的数据信息与实际的诊断需求相匹配，避免权限不足或过高；在配置时需注意数据信息的兼容性，确保其符合AUTOSAR CP 4.4标准；对于安全敏感的数据元素，应仔细配置安全访问级别，以防未授权访问。
          choice container DcmDspDiagnosisScaling [0..1]  # This container contains the configuration (parameters) of an alternative Diagnosis Representation. Out if this the scaling between Diagnosis and ECU internal representation and vice versa can be calculated.
            container DcmDspAlternativeDataInterface [0..1]  # This container contains the configuration (parameters) of an alternative Diagnosis Representation by the means of a VariableDataPrototoype in a DataInterface. | Additionally a reference to PortInterfaceMapping can be defined which provide already the mapping rules between the VariableDataPrototoype in a DataInterface used by the software component (DcmDspExternalSRDataElementClass) and the intended Diagnosis Representation defined by DcmDataElement.
              foreign reference DcmDataElement: set at pre-compile, destination-type=VARIABLE-DATA-PROTOTYPE  # Alternative Diagnosis Representation for the data defined by the means of a VariableDataPrototoype in a DataInterface. | The CompuMethod of the data type of the referenced VariableDataPrototype will be applied to the data type of the VariableDataPrototype in the interface used by the Dcm.
              foreign reference DcmPortInterfaceMapping [0..1]: multiplicity set at pre-compile, set at pre-compile, destination-type=PORT-INTERFACE-MAPPING  # Optional reference to PortInterfaceMapping which defines the mapping rules. | The PortInterfaceMapping is used to get the DataPrototypeMapping that describes a conversion between the data prototype referenced by DcmDataElement and the data prototype referenced from DcmDspExternalSRDataElementClass.
            container DcmDspAlternativeDataType [0..1]  # This container contains the configuration (parameters) of an alternative Diagnosis Representation by the means of an ApplicationDataType. | Additionally the definition of a text table mapping can be a defined for ApplicationDataTypes with a CompuMethod of category TEXTTABLE and SCALE_LINEAR_AND_TEXTTABLE.
              foreign reference DcmApplicationDataType: set at pre-compile, destination-type=APPLICATION-DATA-TYPE  # Alternative Diagnosis Representation for the data defined by the means of a ApplicationDataType of category VALUE, BOOLEAN or ARRAY. | The CompuMethod that applies to the referenced ApplicationDataType in case of category VALUE or BOOLEAN will be applied to the data type of the VariableDataPrototype in the interface used by the Dcm.
              container DcmDspTextTableMapping [0..*]  # The purpose of the DcmDspTextTableMapping is to associate a texttable value defined in the context of the Dcm to a texttable value defined in the context of a CompuMethod referenced by a DataType that shall be taken to create a dataElement in a SenderReceiverInterface. By this means it is possible to create a primitive version of a TexttableMapping (which can only be applied if a dataElement already exists). | In other words, the DcmDspTextTableMapping provides a similar mechanism to the TexttableMapping in a situation where the TexttableMapping cannot be applied since the SenderReceiverInterface for the PortPrototype on the Dcm ServiceComponent does not yet exist.
                integer DcmDspDiagnosisRepresentationDataValue: 0..18446744073709551615, scope=ECU, set at pre-compile  # The data value in the diagnosis representation.
                integer DcmDspInternalDataValue: 0..18446744073709551615, scope=ECU, set at pre-compile  # The ECU internal data value.
            container DcmDspAlternativeDiagnosticDataElement [0..1]  # This container contains the configuration (parameters) of an alternative Diagnosis Representation by the means of Diagnostic Extract.
              foreign reference DcmDspDiagnosticDataElementRef: set at pre-compile, destination-type=DIAGNOSTIC-DATA-ELEMENT  # Alternative Diagnosis Representation for the data defined by the means of a DiagnosticDataElement in the Diagnostic Extract. | This EcucForeignReference enables the access to all SwDataDefProps, in particular BaseType, CompuMethod and DataConstr The CompuMethod and DataConstr that applies to the referenced DiagnosticDataElement will be applied to the data type of the VariableDataPrototype in the interface used by the Dcm. The mapped ImplementationDataType needs to match the given BaseType.
          choice container DcmDspExternalSRDataElementClass [0..1]  # This container defines the source of data in a provided port which shall be read respectively the target of data in a required port which shall be written. / 概述：DcmDspExternalSRDataElementClass配置项用于定义诊断服务处理过程中，外部信号或数据元素的属性和行为，如数据大小、地址、读写权限等。 注意：在配置时需确保数据元素的属性与实际应用中的数据类型和访问权限相匹配；对于敏感或安全相关的数据，应特别注意访问权限的设置；AUTOSAR CP 4.4标准中，对于数据元素的定义和使用有明确规范，需要遵循这些规范以保证诊断服务的正确实现。 | This container shall contain either one DcmSubElementInDataElementInstance OR DcmDataElementInstance OR DcmSubElementInImplDataElementInstance reference.
            container DcmDataElementInstance [0..1]  # Instance Reference to the primitive data in a port where the data element is typed with an ApplicationPrimitveDataType or an ImplementationDataType.
              instance reference DcmDataElementInstanceRef: set at pre-compile, destination-context=ROOT-SW-COMPOSITION-PROTOTYPE SW-COMPONENT-PROTOTYPE PORT-PROTOTYPE, destination-type=AUTOSAR-DATA-PROTOTYPE  # Instance Reference to the primitive or array data which shall be read or written. | Supported are VariableDataPrototypes in SenderReceiverInterfaces and NvDataInterfaces and ParameterDataPrototypes in ParameterInterfaces (read only). This reference is applicable if the AutosarDataPrototype is typed with a ApplicationPrimitiveDataType of category VALUE or BOOLEAN or ApplicationArrayDataType or if the AutosarDataPrototype is typed with a ImplementationDataType of category VALUE, ARRAY or TYPE_REFERENCE that in turn boils down to VALUE or ARRAY
            container DcmSubElementInDataElementInstance [0..1]  # Instance Reference to the primitve sub-element (at any level) of composite data in a port where the data element is typed with an ApplicationCompositeDataType.
              instance reference DcmSubElementInDataElementInstanceRef: set at pre-compile, destination-context=ROOT-SW-COMPOSITION-PROTOTYPE SW-COMPONENT-PROTOTYPE PORT-PROTOTYPE AUTOSAR-DATA-PROTOTYPE APPLICATION-COMPOSITE-ELEMENT-DATA-PROTOTYPE*, destination-type=APPLICATION-COMPOSITE-ELEMENT-DATA-PROTOTYPE  # Instance Reference to the primitve sub-element (at any level) of composite data in a port which shall be read. | Supported are VariableDataPrototypes in SenderReceiverInterfaces and NvDataInterfaces and ParameterDataPrototypes in ParameterInterfaces (read only). This reference is applicable if the AutosarDataPrototype is typed with a ApplicationCompositeDataType.
            container DcmSubElementInImplDataElementInstance [0..1]  # Instance Reference to the primitve sub-element (at any level) of composite data in a port where the data element is typed with an ImplementationDataType.
              instance reference DcmSubElementInImplDataElementInstanceRef: set at pre-compile, destination-context=ROOT-SW-COMPOSITION-PROTOTYPE SW-COMPONENT-PROTOTYPE PORT-PROTOTYPE AUTOSAR-DATA-PROTOTYPE IMPLEMENTATION-DATA-TYPE-ELEMENT*, destination-type=IMPLEMENTATION-DATA-TYPE-ELEMENT  # Instance Reference to the primitve sub-element (at any level) of composite data in a port which shall be read. | Supported are VariableDataPrototypes in SenderReceiverInterfaces and NvDataInterfaces and ParameterDataPrototypes in ParameterInterfaces (read only). This reference is applicable if the AutosarDataPrototype is typed with a ImplementationDataType of category STRUCTURE or ARRAY. Please note that in case of ARRAY the index attribute in the target reference has to be set to select a single array element.
          container DcmDspDidDataSupportInfo [0..1]  # This container defines the supported information. / 概述：DcmDspDidDataSupportInfo配置项用于定义诊断服务中数据标识符（DID）的支持信息，包括DID是否支持读取、写入、控制等操作。 注意：在配置DcmDspDidDataSupportInfo时，需要确保所指定的DID与实际支持的诊断服务相匹配；对于不支持的操作，应明确标记以避免诊断工具误操作；AUTOSAR CP 4.4标准中对DID的操作权限有严格规定，需遵守相应的安全和权限要求。
            integer DcmDspDidDataSupportInfoBit: 0..255, scope=ECU, set at link in variant link-time / pre-compile in variant post-build+pre-compile  # Referenced Bit of the SupportInfo / 概述：DcmDspDidDataSupportInfoBit配置项用于定义在诊断服务中，数据标识符（DID）的支持信息位，这通常用于指示某个DID是否支持读取、写入或控制操作。 注意：在配置DcmDspDidDataSupportInfoBit时，需要确保它与DID支持的操作相匹配；此配置项的设置必须符合ISO 14229标准中定义的服务响应格式；在AUTOSAR CP 4.4中，如果此配置项的属性与标准不一致，可能会导致诊断通信不正确或不兼容。
            reference DcmDspDidDataSupportInfoRef: scope=ECU, multiplicity set at link in variant link-time / pre-compile in variant post-build+pre-compile, set at link in variant link-time / pre-compile in variant post-build+pre-compile, destination=DcmDspDidSupportInfo  # Reference to DcmDspDidSupportInfo / 概述：DcmDspDidDataSupportInfoRef 用于引用支持特定数据标识符（DID）的数据支持信息，这有助于诊断通信管理中数据的读取和编码过程。 注意：确保引用的数据支持信息与DID匹配正确，以保证诊断功能的正确执行；在配置时应参考具体的DID和其数据结构要求；在AUTOSAR CP 4.4中，此配置项的使用应严格遵循标准定义的数据封装和访问规则。
        container DcmDspDataInfo [0..*]  # This container contains the configuration (parameters) of one Data. / 概述：DcmDspDataInfo 是用于定义诊断服务中数据元素的属性，如数据的安全访问级别和读写权限。 注意：确保配置的安全访问级别符合系统的安全需求；读写权限应明确，避免数据访问冲突；在配置时应考虑数据的敏感性和保护需求。
          integer DcmDspDataScalingInfoSize [0..1]: 0..4294967295, scope=ECU, multiplicity set at link in variant link-time / pre-compile in variant post-build+pre-compile, set at link in variant link-time / pre-compile in variant post-build+pre-compile, default-value=0  # If Scaling information service is available for this Data, it provides the size in bytes of the scaling information. / 概述：DcmDspDataScalingInfoSize配置项用于定义诊断服务中数据缩放信息的大小，这通常与数据参数的缩放比例有关，用于调整或转换数据值。 注意：在配置数据缩放信息时，必须确保DcmDspDataScalingInfoSize的值与实际应用中使用的数据类型大小相匹配；此配置项的值应符合ECU支持的数据长度限制；在AUTOSAR CP 4.4标准中，如果数据缩放功能未被使用，该配置项可能不需要配置或者应设置为零。
        container DcmDspDid [0..*]  # This container contains the configuration (parameters) of the DID. / 概述：DcmDspDid 是用于定义诊断服务中数据标识符（DID）的配置，它指定了DID的属性、访问权限和与之关联的读写函数。 注意：确保DID的唯一性以避免在诊断会话中的冲突；合理配置访问权限以符合安全要求；在配置读写函数时，确保它们符合实际的硬件和应用需求。
          boolean DcmDspDidUsed: scope=ECU, post-build-variant-value=true, set at link in variant link-time / post-build in variant post-build / pre-compile in variant pre-compile, default-value=true  # Allow to activate or deactivate the usage of a DID, for multi purpose ECUs / 概述：DcmDspDidUsed配置项用于指定在诊断服务中使用的数据标识符（DID），它定义了哪些DID将被诊断通信管理器（Diagnostic Communication Manager）识别和处理。 注意：在配置DcmDspDidUsed时，需要确保所引用的DID已在系统中定义，并且与诊断需求相匹配；DID的授权级别和安全访问条件也需要正确配置，以确保只有合适的诊断会话和安全级别才能访问这些DID；此外，DcmDspDidUsed配置应与车辆的诊断规范一致，避免配置不一致导致的诊断功能异常。 | true = DID available false = DID not available
          enumeration DcmDspDidUsePort: {USE_DATA_ELEMENT_SPECIFIC_INTERFACES}, set at pre-compile, default-value=USE_DATA_ELEMENT_SPECIFIC_INTERFACES  # Selects application interface type for DID data elements between a single operation for all data elements or data element specific operations. / 概述：DcmDspDidUsePort配置项用于指定诊断数据标识符（DID）是否使用端口接口来访问数据。 注意：在AUTOSAR CP 4.4标准中，确保DcmDspDidUsePort的设置与DID访问方式一致；如果使用端口接口，则需要定义相应的端口接口映射；不使用端口时，应使用内部或外部函数访问DID数据。
          integer DcmDspDidIdentifier: 0..65535, scope=ECU, set at link in variant link-time / pre-compile in variant post-build+pre-compile  # 2 byte Identifier of the DID / 概述：DcmDspDidIdentifier用于定义诊断数据标识符（DID）的属性，包括DID的标识符号、访问权限、以及与之关联的读写服务等。 注意：在配置DcmDspDidIdentifier时，确保DID符合ISO 14229标准中定义的范围；配置的访问权限需满足安全访问需求，避免未授权访问；AUTOSAR CP 4.4中对DID的处理能力和配置方式可能与早期版本有所不同，需注意兼容性。 | Within each DcmConfigSet all DcmDspDidIdentifier values shall be unique.
          integer DcmDspDidSize: 0..65535, scope=ECU, set at link in variant link-time / pre-compile in variant post-build+pre-compile  # Length of a DID in byte(s). / 概述：DcmDspDidSize配置项用于定义诊断数据标识符（DID）的大小，即DID所能承载的数据长度，这对于确保数据的正确读取和编码至关重要。 注意：DID大小需根据实际应用需求和标准协议要求谨慎设置；超出规定大小的DID可能导致诊断通信过程中的数据错误或丢失；在AUTOSAR CP 4.4中，确保DID大小与ECU支持的数据长度一致是必要的。
          reference DcmDspDidInfoRef: scope=ECU, set at link in variant link-time / pre-compile in variant post-build+pre-compile, destination=DcmDspDidInfo  # Reference to DcmDspDidInfo containing information on this DID. / 概述：DcmDspDidInfoRef是一个配置项，用于引用与诊断数据标识符(DID)相关的信息，如DID的属性、服务和安全级别等，以支持诊断服务中对DID的处理。 注意：在配置DcmDspDidInfoRef时，确保引用的信息与DID的实际需求相匹配，以避免诊断服务中的错误处理；引用的信息应在系统中唯一定义，避免重复或冲突；AUTOSAR CP 4.4标准中对DcmDspDidInfoRef的使用有明确规范，需要遵守相关规则以保证兼容性。
          reference DcmDspDidRef [0..*]: scope=ECU, multiplicity set at link in variant link-time / pre-compile in variant post-build+pre-compile, requires-index=true, set at link in variant link-time / pre-compile in variant post-build+pre-compile, destination=DcmDspDid  # Reference to DcmDspDid in case this DID refer to one or serveral other DID's / 概述：DcmDspDidRef配置项用于定义诊断服务中数据标识符（DID）的引用，确保正确的数据访问和操作。 注意：在配置DcmDspDidRef时，必须确保引用的DID在系统中是存在且有效的；配置错误可能导致诊断通信失败；应遵循AUTOSAR CP 4.4标准中对DID管理和访问的具体规定。
          container DcmDspDidSignal [0..*]  # This container defines the reference to 1 DcmDspData container and position relevant for this DID. / 概述：DcmDspDidSignal配置项用于定义诊断数据标识符（DID）与信号之间的映射关系，确保在执行诊断服务时能够正确访问和操作特定的车辆信号。 注意：在配置DcmDspDidSignal时，需确保信号与DID之间的映射关系准确无误；对���每个DID，应详细定义信号的访问权限和安全级别；此配置项在AUTOSAR CP 4.4标准中应遵循诊断通信管理模块的规范要求。
            integer DcmDspDidByteOffset: 0..65535, scope=ECU, set at link in variant link-time / pre-compile in variant post-build+pre-compile  # Defines the absolute byte offset of the data defined by DcmDspDidDataRef reference to DcmDspData container in the DID. / 概述：DcmDspDidByteOffset配置项用于定义数据标识符（DID）在数据存储区中的字节偏移量，这决定了DID数据在内存中的具体位置。 注意：在配置DcmDspDidByteOffset时，需要确保偏移量正确反映了DID数据在内存中的实际位置；避免不同的DID之间存在重叠，这可能导致数据的读写冲突；在配置时还应考虑数据对齐要求，以确保有效的内存访问和符合架构的数据访问规则。
            reference DcmDspDidDataRef: scope=ECU, set at link in variant link-time / pre-compile in variant post-build+pre-compile, destination=DcmDspData  # Reference to 1 DcmDspData container relevant for this DID. / 概述：DcmDspDidDataRef配置项用于定义诊断数据标识符（DID）与其相关数据元素的关联，这样在诊断通信中可以正确地访问和管理这些数据。 注意：在配置DcmDspDidDataRef时，必须确保引用的数据元素与DID兼容，并且满足诊断服务的数据格式和长度要求；此外，应当注意数据元素的访问权限设置，以确保只有授权的诊断会话和安全等级才能访问敏感数据；在AUTOSAR CP 4.4标准中，如果配置项的属性与标准不一致，可能会导致诊断服务无法正确执行或数据访问出现错误。
          container DcmDspDidSupportInfo [0..1]  # This container defines the support information to declare the usability of the data bytes within the DIDs / 概述：DcmDspDidSupportInfo配置项用于定义诊断服务中数据标识符（DID）的支持信息，包括DID是否支持读取、写入、控制等操作。 注意：在配置DcmDspDidSupportInfo时，需要确保每个DID的支持信息与实际功能需求相匹配；对于不支持的操作，应明确标记以避免诊断工具误操作；AUTOSAR CP 4.4标准要求详细定义每个DID的支持级别，以确保诊断通信的准确性和安全性。
            integer DcmDspDidSupportInfoLen: 0..255, scope=ECU, set at link in variant link-time / pre-compile in variant post-build+pre-compile  # Length of the support information in bytes. / 概述：DcmDspDidSupportInfoLen配置项用于定义诊断服务中数据标识符（DID）的支持信息长度，即DID的支持信息所占用的字节数。 注意：在AUTOSAR CP 4.4标准中，DcmDspDidSupportInfoLen的值应当与实际DID支持信息的长度相匹配；如果设置不正确，可能会导致诊断响应格式错误或信息丢失；此配置项通常由诊断通信管理模块的开发者或配置工程师根据具体的DID和诊断需求来设定。
            integer DcmDspDidSupportInfoPos: 0..255, scope=ECU, set at link in variant link-time / pre-compile in variant post-build+pre-compile  # Length of the support information in bytes. / 概述：DcmDspDidSupportInfoPos配置项用于定义数据标识符（DID）在诊断服务中的支持信息位置，这有助于诊断服务确定如何处理特定的DID。 注意：在配置DcmDspDidSupportInfoPos时，需要确保DID与其支持信息位置的映射是唯一的，以避免在诊断通信过程中的任何歧义；此外，应当遵循AUTOSAR标准中对于DID支持信息的规定，确保配置的兼容性和正确性；在实际应用中，还需考虑DID支持信息位置对于诊断工具的影响，以确保工具能正确解析和使用DID。
        container DcmDspDidInfo [0..*]  # This container contains the configuration (parameters) of the DID's Info / 概述：DcmDspDidInfo配置项用于定义诊断数据标识符（DID）的属性，包括DID的读取、写入和控制权限，以及与之相关的服务和子功能。 注意：在配置DcmDspDidInfo时，需要确保DID与其属性的匹配正确，遵循ISO 14229和AUTOSAR标准中对服务和子功能的定义；此外，对于安全相关的DID，还需配置相应的安全访问级别；在配置过程中，还应注意DID的唯一性，避免与其他DID冲突。
          boolean DcmDspDidDynamicallyDefined: scope=ECU, set at link in variant link-time / pre-compile in variant post-build+pre-compile, default-value=false  # Indicates if this DID can be dynamically defined / 概述：DcmDspDidDynamicallyDefined配置项用于定义动态数据标识符（Dynamic Data Identifier, DID）的属性，这些DIDs可以在车辆运行时通过诊断服务动态定义。 注意：在AUTOSAR CP 4.4标准中，确保动态定义的DIDs不与静态定义的DIDs冲突；动态DIDs的管理需要遵循诊断服务的规范；对于动态DIDs的存储和恢复机制，应当考虑车辆断电后的数据持久性要求。 | true = DID can be dynamically defined false = DID can not be dynamically defined
          integer DcmDspDDDIDMaxElements [0..1]: 1..255, multiplicity set at link in variant link-time / pre-compile in variant post-build+pre-compile, set at link in variant link-time / pre-compile in variant post-build+pre-compile, default-value=1  # Maximum number of source elements of a DDDID. / 概述：DcmDspDDDIDMaxElements配置项定义了动态定义数据标识符（Dynamic Data Identifier, DDDID）中最大元素的数量，这是用于诊断通信中，允许在一个DDDID中动态定义的最大数据元素数。 注意：在AUTOSAR CP 4.4标准中，需要确保此配置项的值不超过实际系统能够处理的最大元素数量；过高的值可能会导致系统资源不足，而过低的值可能限制了DDDID的灵活性和功能性；此配置项的设置应考虑到ECU的内存和处理能力。
          container DcmDspDidControl [0..1]  # This container contains the configuration (parameters) of the DID control. / 概述：DcmDspDidControl配置项用于定义诊断数据标识符（DID）的控制属性，包括控制选项和相关的服务处理规则，以便在车辆诊断通信中对DID执行控制操作。 注意：在配置DcmDspDidControl时，需要确保控制选项与DID支持的控制类型相匹配；应注意与DcmDspDidInfo配置项的一致性，以确保正确的服务响应；在AUTOSAR CP 4.4标准中，控制操作可能受到安全访问（Secured Access）的限制，因此配置时应考虑安全策略的要求。
            boolean DcmDspDidFreezeCurrentState: scope=ECU, set at pre-compile, default-value=false  # This indicates the presence of "FreezeCurrentState". / 概述：DcmDspDidFreezeCurrentState配置项用于定义诊断服务是否支持冻结当前数据标识符（DID）的状态，这允许在诊断会话期间暂时保存DID的当前值。 注意：在实现此功能时，需要确保ECU具备足够的资源来存储冻结的DID值；此配置项的使用应符合车辆制造商的诊断策略和要求；在配置时应注意与其他诊断服务的兼容性和数据一致性。
            boolean DcmDspDidResetToDefault: scope=ECU, set at pre-compile, default-value=false  # This indicates the presence of "ResetToDefault". / 概述：DcmDspDidResetToDefault配置项用于定义诊断服务中重置数据标识符（DID）到其默认值的行为，确保在执行特定的诊断请求时，能够将DID恢复到预设的默认状态。 注意：在配置时需确保DID支持重置到默认值的操作；重置操作可能会影响系统的正常运行，需谨慎设计；此配置项在AUTOSAR CP 4.4中应与DID相关的安全访问权限设置相匹配，以避免安全风险。
            boolean DcmDspDidShortTermAdjustment: scope=ECU, set at pre-compile, default-value=false  # This indicates the presence of "ShortTermAdjustment". / 概述：DcmDspDidShortTermAdjustment配置项用于定义诊断会话中，对数据标识符（DID）的短期调整参数和行为。 注意：该配置项必须确保与车辆的安全和隐私要求相符合；调整操作应在授权的诊断会话中进行，避免未授权访问；在实施时需考虑对系统性能的影响，确保不会对其他系统功能造成干扰。
            enumeration DcmDspDidControlMask: {DCM_CONTROLMASK_EXTERNAL, DCM_CONTROLMASK_INTERNAL, DCM_CONTROLMASK_NO}, scope=ECU, set at pre-compile, default-value=DCM_CONTROLMASK_INTERNAL  # This indicates the presence of "controlEnableMask" in SWC service interfaces and defines how the Dcm treats a service request. / 概述：DcmDspDidControlMask配置项用于定义诊断服务中数据标识符（DID）的控制选项掩码，它决定了哪些位可以被客户端（如诊断工具）控制。 注意：在配置DcmDspDidControlMask时，需要确保掩码与DID支持的控制选项相匹配；掩码中的每个位代表DID的一个特定控制功能，因此需要仔细设计以避免不必要的功能暴露；在AUTOSAR CP 4.4标准中，如果该属性与DID的实际功能或安全要求不一致，可能会导致诊断服务的安全性问题。
            integer DcmDspDidControlMaskSize [0..1]: 1..4294967294, scope=ECU, set at pre-compile  # The value defines the size of the controlEnableMaskRecord in bytes. / 概述：DcmDspDidControlMaskSize配置项定义了用于DID控制操作的掩码大小，该掩码用于确定哪些位可以被控制。 注意：掩码大小应与DID的大小相匹配，以确保正确的操作；在配置掩码时，需要注意数据的字节序；掩码大小的配置必须符合ECU支持的数据长度限制。
            integer DcmDspDidControlRole [0..1]: 0..4294967295, scope=ECU, multiplicity set at link in variant link-time / post-build in variant post-build / pre-compile in variant pre-compile, post-build-variant-multiplicity=true, post-build-variant-value=true, set at link in variant link-time / post-build in variant post-build / pre-compile in variant pre-compile  # Bitfield were each bit represents one dedicated role. A DID is granted IOcontrol access if the bit value is 1. If a bit value is 0, the DID is not allowed to be controlled for that role. / 概述：DcmDspDidControlRole配置项定义了数据标识符（DID）的控制权限，用于指定哪些会话层或安全访问级别可以对DID执行控制操作。 注意：在配置DcmDspDidControlRole时，需要确保控制权限与项目的安全需求相匹配；此外，应当注意不同DID可能需要不同的控制权限设置；在配置时还应考虑到会话层的变化，确保在不同会话下DID的控制权限得到正确管理。
            reference DcmDspDidControlModeRuleRef [0..1]: scope=ECU, multiplicity set at link in variant link-time / pre-compile in variant post-build+pre-compile, set at link in variant link-time / pre-compile in variant post-build+pre-compile, destination=DcmModeRule  # Reference to DcmModeRule / 概述：DcmDspDidControlModeRuleRef配置项用于引用一个诊断服务数据标识符（DID）的控制模式规则，该规则定义了在何种条件下可以对DID执行控制操作。 注意：在配置DcmDspDidControlModeRuleRef时，需要确保引用的控制模式规则已经在系统中定义；控制模式规则应与DID的安全级别和会话控制要求相匹配；在AUTOSAR CP 4.4标准中，控制模式规则的定义和引用应遵循模块的规范要求。 | Mode rule which controls this DID. If there is no reference, no check of the mode rule shall be done.
            reference DcmDspDidControlSecurityLevelRef [0..*]: scope=ECU, multiplicity set at link in variant link-time / pre-compile in variant post-build+pre-compile, set at link in variant link-time / pre-compile in variant post-build+pre-compile, destination=DcmDspSecurityRow  # Reference to DcmDspSecurityRow / 概述：DcmDspDidControlSecurityLevelRef配置项用于指定数据标识符（DID）控制操作所需的安全访问级别，确保只有在达到适当的安全级别后才能对DID执行控制操作。 注意：在配置时需确保引用的安全级别与实际的安全策略相匹配；如果配置了不支持的安全级别，可能导致控制操作无法执行；AUTOSAR CP 4.4标准中可能有对支持的安全级别数量或类型的限制，需要遵守这些限制。 | Security levels allowed to control this DID. If there is no reference, no check of security level shall be done.
            reference DcmDspDidControlSessionRef [0..*]: scope=ECU, multiplicity set at link in variant link-time / pre-compile in variant post-build+pre-compile, set at link in variant link-time / pre-compile in variant post-build+pre-compile, destination=DcmDspSessionRow  # Reference to DcmDspSessionRow / 概述：DcmDspDidControlSessionRef配置项用于指定哪些诊断会话层(Diagnostic Session Layer)可以访问特定的数据标识符(DID)进行控制操作。 注意：确保只有授权的诊断会话能够访问和控制DID；在配置时需遵循安全访问规则，防止未授权访问；该配置项应与DID的安全访问级别设置相匹配，以确保数据安全。 | Sessions allowed to control this DID. If there is no reference, no check of session level shall be done.
            reference DcmDspDidControlVehicleSystemGroupRef [0..*]: scope=ECU, multiplicity set at link in variant link-time / pre-compile in variant post-build+pre-compile, set at link in variant link-time / pre-compile in variant post-build+pre-compile, destination=DcmDspVehicleSystemGroupRow  # Defines DID IO Control operation availability dependency to a specific VSG / 概述：DcmDspDidControlVehicleSystemGroupRef配置项用于引用诊断服务组件中的车辆系统组，该组定义了一组相关的车辆控制系统，这些系统可以通过诊断数据标识符（DID）进行控制。 注意：在配置DcmDspDidControlVehicleSystemGroupRef时，需要确保引用的车辆系统组在系统中是存在且有效的；此配置项通常与特定的DID关联，确保正确映射以满足诊断需求；在AUTOSAR CP 4.4标准中，应当遵循诊断配置的模块化原则，确保配置的一致性和可维护性。 | VSGs allowed to control this DID. If there is no reference, no check of vsg shall be done.
            container DcmDspDidControlEnableMask [0..32]  # The shortname of the container value defines the symbol of the controlMask. / 概述：DcmDspDidControlEnableMask配置项用于定义诊断服务中数据标识符（DID）的控制权限，它指定了在执行控制操作时哪些位需要被检查和使能。 注意：在配置DcmDspDidControlEnableMask时，需要确保掩码与DID支持的控制操作相匹配；掩码的长度应与DID的大小一致；在定义掩码时，要注意权限管理，确保只有授权的用户可以执行敏感或关键的控制操作。
              integer DcmDspDidControlMaskBitPosition: 0..31, scope=ECU, set at pre-compile  # Defines the position of the bit in the controlMask starting from most significant bit (MSB first) to least significant bit. / 概述：DcmDspDidControlMaskBitPosition 定义了在诊断控制服务中，控制选项掩码的位位置，用于控制数据标识符的特定功能。 注意：在配置控制选项掩码时，必须确保位位置正确且符合相关诊断标准；掩码位位置的错误配置可能导致诊断功能不正确或无法执行；此配置项应与车辆制造商的诊断需求和规范一致。 | This Bit endianness is identical to the controlMask in UDS. The DcmDspDidControlMaskSize should be considered for most significant bit.
          container DcmDspDidRead [0..1]  # This container contains the configuration (parameters) of the DID read. / 概述：DcmDspDidRead配置项用于定义诊断服务中数据标识符（DID）的读取属性，包括访问权限和读取方法。 注意：确保配置的读取权限符合车辆制造商的安全要求；在配置读取方法时，应考虑数据的实时性和准确性；遵循AUTOSAR CP 4.4标准中对DID读取的具体规定和限制。
            integer DcmDspDidReadRole [0..1]: 0..4294967295, scope=ECU, multiplicity set at link in variant link-time / post-build in variant post-build / pre-compile in variant pre-compile, post-build-variant-multiplicity=true, post-build-variant-value=true, set at link in variant link-time / post-build in variant post-build / pre-compile in variant pre-compile  # Bitfield were each bit represents one dedicated role. A DID is granted read access if the bit value is 1. If a bit value is 0, the DID is not allowed to be read for that role. / 概述：DcmDspDidReadRole配置项定义了数据标识符（DID）在诊断服务中的读取权限，用于控制不同诊断会话和安全等级下的访问权限。 注意：确保配置的读取权限符合车辆制造商的安全要求和法规要求；在配置时需考虑不同诊断会话和安全等级的需求；AUTOSAR CP 4.4标准中，此配置项应详细定义每个DID的访问权限，以防止未授权访问。 | Reading DIDs is possible by different UDS services. This setting applies to all possible DID read operations.
            reference DcmDspDidReadModeRuleRef [0..1]: scope=ECU, multiplicity set at link in variant link-time / pre-compile in variant post-build+pre-compile, set at link in variant link-time / pre-compile in variant post-build+pre-compile, destination=DcmModeRule  # Reference to DcmModeRule / 概述：DcmDspDidReadModeRuleRef配置项用于引用一个规则，该规则定义了数据标识符（DID）在诊断会话控制（Diagnostic Session Control）和安全访问（Security Access）等级下的读取条件。 注意：在配置DcmDspDidReadModeRuleRef时，需要确保引用的规则已经在Dcm配置中定义；此外，要注意规则的适用性，确保在特定的诊断会话和安全等级下DID是可读的；如果规则配置不正确，可能导致DID在某些情况下无法被正确读取，影响诊断功能。 | Mode rule which controls to read this DID. If there is no reference, no check of the mode rule shall be done.
            reference DcmDspDidReadSecurityLevelRef [0..*]: scope=ECU, multiplicity set at link in variant link-time / pre-compile in variant post-build+pre-compile, set at link in variant link-time / pre-compile in variant post-build+pre-compile, destination=DcmDspSecurityRow  # Reference to DcmDspSecurityRow Referenced security levels are allowed to read this DID. / 概述：DcmDspDidReadSecurityLevelRef配置项用于指定访问特定数据标识符（DID）时所需的安全等级，确保只有在满足相应安全条件下才能读取敏感或受保护的数据。 注意：在配置时需确保引用的安全等级与实际实现的安全策略相匹配；如果配置了不支持的安全等级，可能导致数据访问权限校验失败；AUTOSAR CP 4.4标准中，安全等级通常以bitmask的形式表示，需要注意正确配置这些bitmask值。 | If there is no reference, no check of security level shall be done.
            reference DcmDspDidReadSessionRef [0..*]: scope=ECU, multiplicity set at link in variant link-time / pre-compile in variant post-build+pre-compile, set at link in variant link-time / pre-compile in variant post-build+pre-compile, destination=DcmDspSessionRow  # Reference to DcmDspSessionRow Referenced sessions are allowed to read this DID. / 概述：DcmDspDidReadSessionRef配置项指定了数据标识符（DID）在哪些诊断会话层级中可被读取。 注意：确保配置的会话层级与实际应用中的诊断安全需求相匹配；不正确的会话配置可能导致数据访问权限问题；在AUTOSAR CP 4.4中，每个DID的会话访问权限应明确区分并正确配置。 | If there is no reference, no check of session level shall be done.
            reference DcmDspDidReadVehicleSystemGroupRef [0..*]: scope=ECU, multiplicity set at link in variant link-time / pre-compile in variant post-build+pre-compile, set at link in variant link-time / pre-compile in variant post-build+pre-compile, destination=DcmDspVehicleSystemGroupRow  # Defines DID read operation availability dependency to a specific VSG. / 概述：DcmDspDidReadVehicleSystemGroupRef配置项用于定义诊断服务中，读取数据标识符（DID）时所关联的车辆系统组引用。 注意：确保引用的车辆系统组在系统中已定义且有效；此配置项应与具体的DID及其读取权限和安全策略一致；在配置时需考虑数据的安全性和访问权限控制。 | If there is no reference, no check of vsg shall be done.
          container DcmDspDidWrite [0..1]  # This container contains the configuration (parameters) of the DID write. / 概述：DcmDspDidWrite配置项用于定义诊断服务中数据标识符（DID）的写操作属性，包括写入权限、写入条件和相关的回调函数。 注意：在配置DcmDspDidWrite时，需要确保写入权限符合系统安全要求；写入条件应与实际应用场景相匹配，避免在不适当的时机允许写操作；回调函数需要正确实现，以确保写入操作的数据处理符合预期。
            integer DcmDspDidWriteRole [0..1]: 0..4294967295, scope=ECU, multiplicity set at link in variant link-time / post-build in variant post-build / pre-compile in variant pre-compile, post-build-variant-multiplicity=true, post-build-variant-value=true, set at link in variant link-time / post-build in variant post-build / pre-compile in variant pre-compile  # Bitfield were each bit represents one dedicated role. A DID is granted write access if the bit value is 1. If a bit value is 0, the DID is not allowed to be written for that role. / 概述：DcmDspDidWriteRole配置项定义了数据标识符（DID）的写入权限，用于控制对特定DID的写入访问，确保只有授权的客户端可以修改DID的值。 注意：在配置DcmDspDidWriteRole时，需要确保权限设置符合应用的安全要求；此外，应考虑与DcmDspDidReadRole的配置一致性，以保证读写权限的合理性；最后，需要注意的是，任何修改都应遵循AUTOSAR CP 4.4标准中关于数据访问权限的规定。
            reference DcmDspDidWriteModeRuleRef [0..1]: scope=ECU, multiplicity set at link in variant link-time / pre-compile in variant post-build+pre-compile, set at link in variant link-time / pre-compile in variant post-build+pre-compile, destination=DcmModeRule  # Reference to DcmModeRule / 概述：DcmDspDidWriteModeRuleRef配置项用于引用一个规则，该规则定义了数据标识符（DID）写入操作的条件，确保只有在满足特定条件时才能对DID执行写入操作。 注意：在配置DcmDspDidWriteModeRuleRef时，需要确保引用的规则已经在系统中定义；规则的定义应符合AUTOSAR的诊断事件管理和服务请求管理要求；此外，对于写入操作的安全性和合法性要求较高，因此需要仔细设计和验证引用的规则。 | Mode rule which controls to write this DID. If there is no reference, no check of the mode rule shall be done.
            reference DcmDspDidWriteSecurityLevelRef [0..*]: scope=ECU, multiplicity set at link in variant link-time / pre-compile in variant post-build+pre-compile, set at link in variant link-time / pre-compile in variant post-build+pre-compile, destination=DcmDspSecurityRow  # Reference to DcmDspSecurityRow Referenced security levels are allowed to wirte this DID. / 概述：DcmDspDidWriteSecurityLevelRef配置项用于指定在诊断服务中写入数据标识符（DID）所需的安全访问级别，确保只有在满足相应安全级别条件下才能对DID进行写操作。 注意：在配置此项时，必须确保引用的安全级别已在Dcm的安全策略中定义；安全级别的配置应与实际的安全需求相匹配，以防止未授权的数据访问；AUTOSAR CP 4.4标准中可能对安全级别的表示方法和可用选项有具体规定，需要遵守这些规定以确保兼容性。 | If there is no reference, no check of security level shall be done.
            reference DcmDspDidWriteSessionRef [0..*]: scope=ECU, multiplicity set at link in variant link-time / pre-compile in variant post-build+pre-compile, set at link in variant link-time / pre-compile in variant post-build+pre-compile, destination=DcmDspSessionRow  # Reference to DcmDspSessionRow Referenced sessions are allowed to write this DID. / 概述：DcmDspDidWriteSessionRef配置项用于指定哪些诊断会话层次（Diagnostic Session Layers）允许对数据标识符（DID）进行写操作。 注意：确保仅在允许的诊断会话中进行DID的写操作，避免在不适当的会话中修改数据；此配置项对安全访问控制至关重要，需谨慎配置以防止未授权访问。 | If there is no reference, no check of session level shall be done.
            reference DcmDspDidWriteVehicleSystemGroupRef [0..*]: scope=ECU, multiplicity set at link in variant link-time / pre-compile in variant post-build+pre-compile, set at link in variant link-time / pre-compile in variant post-build+pre-compile, destination=DcmDspVehicleSystemGroupRow  # Defines DID write operation availability dependency to a specific VSG. / 概述：DcmDspDidWriteVehicleSystemGroupRef配置项用于引用一个车辆系统组，该组定义了一组数据标识符（DID），这些DID可以在诊断会话中被写入。 注意：在配置时需确保引用的车辆系统组中的DID支持写入操作；对于不支持写入的DID，尝试写入可能会导致诊断会话中的错误响应；AUTOSAR CP 4.4标准中，确保该配置项与车辆系统组的定义一致，避免引用不存在的组。 | If there is no reference, no check of vsg shall be done.
        container DcmDspDidRange [0..255]  # This container defines the DID Range / 概述：DcmDspDidRange配置项用于定义诊断服务中可用的数据标识符（DID）范围，允许对一系列DID进行统一处理，而不是单独配置每个DID。 注意：在配置DcmDspDidRange时，确保DID范围内的每个DID都不与单独配置的DID冲突；DID范围的使用应遵循诊断协议标准，确保兼容性；AUTOSAR CP 4.4标准中对DID范围的支持可能有特定限制或要求，需要仔细检查标准文档。
          boolean DcmDspDidRangeHasGaps: scope=ECU, set at link in variant link-time / pre-compile in variant post-build+pre-compile  # Parameter specifying if there are gaps in the DID range (parameter set to TRUE) or not (parameter set to FALSE) / 概述：DcmDspDidRangeHasGaps配置项用于指示在诊断数据标识符（DID）范围定义中是否存在间隙，即非连续的DID区间。 注意：在定义DID范围时，需要明确指出区间是否连续；如果存在间隙，确保正确配置此属性以反映实际的DID布局；不正确的间隙配置可能会导致诊断服务的响应不符合预期。
          boolean DcmDspDidRangeUsePort: scope=ECU, set at pre-compile  # When the parameter DcmDspDidRangeUsePort is set to true the DCM will access the Data using an R-Port requiring a PortInteface DataServices_DIDRange. In that case, DcmDspDidRangeIsDidAvailableFnc, DcmDspDidRangeReadDidFnc and DcmDspDidRangeWriteDidFnc are ignored and the RTE APIs are used. When the parameter DcmDspDidRangeUsePort is false, the DCM calls the functions defined in DcmDspDidRangeIsDidAvailableFnc, DcmDspDidRangeReadDidFnc and DcmDspDidRangeWriteDidFnc. / 概述：DcmDspDidRangeUsePort配置项用于指定诊断数据标识符（DID）范围是否使用端口接口，以便为一组DID提供读取和写入服务。 注意：在AUTOSAR CP 4.4标准中，确保DcmDspDidRangeUsePort的配置与DID范围处理的实现方式相匹配；如果使用端口接口，则需要定义相应的端口API；若不使用端口接口，则应通过其他方式（如内部函数调用）实现DID范围的读写服务。
          function name DcmDspDidRangeIsDidAvailableFnc [0..1]: scope=ECU, multiplicity set at pre-compile, set at pre-compile  # Function name to request from application if a specific DID is available within the range or not. / 概述：DcmDspDidRangeIsDidAvailableFnc配置项用于定义一个函数，该函数决定一个动态定义的数据标识符（DID）范围内的特定DID是否可用。 注意：在配置动态DID范围时，必须确保此函数正确实现，以便DID范围检查能够正确执行；该函数的实现必须符合AUTOSAR CP 4.4标准中对DID可用性检查的要求；在实现时应注意性能影响，因为该函数可能会被频繁调用。 | Only relevant if DcmDspDidRangeUsePort is set to false. This parameter is related to the interface Xxx_IsDidAvailable.
          function name DcmDspDidRangeReadDataLengthFnc [0..1]: scope=ECU, multiplicity set at pre-compile, set at pre-compile  # Function name to request from application the length of the data of a range DID. / 概述：DcmDspDidRangeReadDataLengthFnc是一个配置项，用于定义在诊断通信管理器（Diagnostic Communication Manager）中，读取数据标识符（DID）范围时获取数据长度的函数名称。 注意：在AUTOSAR CP 4.4标准中，确保该函数名称与实际实现的函数名匹配；该函数需要正确处理数据长度的计算，以避免数据溢出或不一致问题；函数的实现必须符合AUTOSAR的模块接口标准。 | Only relevant if DcmDspDidRangeUsePort is set to false. This parameter is related to the interface Xxx_ReadDidRangeDataLength.
          function name DcmDspDidRangeReadDidFnc [0..1]: scope=ECU, multiplicity set at pre-compile, set at pre-compile  # Function name to request from application the data range value of a DID.(ReadData-function). / 概述：DcmDspDidRangeReadDidFnc配置项用于定义在诊断服务中，当请求读取数据标识符（DID）范围时，所调用的函数。 注意：在配置DcmDspDidRangeReadDidFnc时，需要确保所引用的函数符合AUTOSAR标准中对读取DID范围的函数原型要求；此外，该函数需要能够处理请求的DID范围内的所有可能值，并且要确保对应的数据权限和安全级别得到正确处理；在实现时还应考虑到函数的执行时间，以满足可能的实时性要求。 | Only relevant if DcmDspDidRangeUsePort is set to false. This parameter is related to the interface Xxx_ReadDidData.
          function name DcmDspDidRangeWriteDidFnc [0..1]: scope=ECU, multiplicity set at pre-compile, set at pre-compile  # Function name to request application to write the data range value of a DID.(WriteData-function). / 概述：DcmDspDidRangeWriteDidFnc配置项用于定义在诊断服务中，当写入数据标识符（DID）属于一个特定范围时，所调用的函数名称。 注意：在配置DcmDspDidRangeWriteDidFnc时，需要确保所引用的函数符合AUTOSAR标准中对服务处理函数的要求；函数需要能够处理请求的写入操作，并返回适当的诊断响应码；此配置项通常与DcmDspDidRange定义关联，确保DID范围与对应的处理函数匹配。 | Only relevant if DcmDspDidRangeUsePort is set to false. This parameter is related to the interface Xxx_WriteDidData.
          integer DcmDspDidRangeIdentifierLowerLimit: 0..65535, scope=ECU, set at link in variant link-time / pre-compile in variant post-build+pre-compile  # Lower limit of DID range. / 概述：DcmDspDidRangeIdentifierLowerLimit 用于定义诊断数据标识符（DID）范围的下限，这有助于确定哪些DID可以被访问和处理。 注意：确保设置的下限值不低于允许的最小DID值；在配置DID范围时，下限值应小于或等于上限值DcmDspDidRangeIdentifierUpperLimit；适当配置此值以避免数据访问冲突或安全问题。
          integer DcmDspDidRangeIdentifierUpperLimit: 0..65535, scope=ECU, set at link in variant link-time / pre-compile in variant post-build+pre-compile  # Upper limit of DID range. / 概述：DcmDspDidRangeIdentifierUpperLimit用于定义诊断数据标识符（DID）范围的上限，这是在配置诊断服务时，用于指定可接受的DID范围的最大值。 注意：该配置项的值必须大于或等于DcmDspDidRangeIdentifierLowerLimit的值；确保配置的DID范围不与其他已配置的DID范围重叠；在配置时考虑实际应用中可能需要的DID范围，避免将来的扩展需求导致配置修改。
          integer DcmDspDidRangeMaxDataLength: 0..65535, scope=ECU, set at link in variant link-time / pre-compile in variant post-build+pre-compile  # Maximum data length in bytes / 概述：DcmDspDidRangeMaxDataLength配置项用于定义在诊断服务中，动态定义数据标识符（DID）范围的最大数据长度，这是为了确保在读取或写入数据时，数据块的大小不会超过ECU处理能力。 注意：在配置此参数时，必须确保它反映了ECU的实际数据处理能力和存储限制；超出此长度的数据请求可能会被诊断服务拒绝；此参数的设置应与ECU的内存和性能特性相匹配，以避免潜在的通信或操作问题。
          reference DcmDspDidRangeInfoRef: scope=ECU, set at link in variant link-time / pre-compile in variant post-build+pre-compile, destination=DcmDspDidInfo  # Reference to DcmDspDidInfo containing information on this DID Range. / 概述：DcmDspDidRangeInfoRef配置项用于引用一个特定的DID范围信息，该信息定义了诊断服务处理动态定义的数据标识符（DID）范围的参数和行为。 注意：在配置DcmDspDidRangeInfoRef时，必须确保引用的DID范围信息已经在系统中定义；引用的DID范围必须与实际的诊断需求相匹配，以确保正确的诊断行为；在AUTOSAR CP 4.4标准中，DID范围的配置应遵循标准的模块定义和约束。
        container DcmDspEcuReset [0..1]  # This container contains the configuration for DcmDspEcuReset service / 概述：DcmDspEcuReset配置项用于定义诊断通信管理器（Diagnostic Communication Manager）中ECU复位服务的参数，包括复位类型、复位时间以及与之相关的诊断服务请求和响应行为。 注意：在配置DcmDspEcuReset时，需要确保复位类型与ECU支持的复位方式相匹配；复位时间参数应符合系统复位需求和诊断规范；此外，还需注意与安全访问服务的交互，确保在执行复位前满足安全级别要求。
          container DcmDspEcuResetRow [1..*]  # This container contains the configuration for each DcmDspEcuReset subservice. / 概述：DcmDspEcuResetRow配置项用于定义ECU重置类型及其相关属性，如重置服务的支持情况、安全访问级别和会话控制要求等，以便在诊断通信过程中正确处理ECU重置请求。 注意：确保为每种重置类型正确配置安全访问级别和会话控制要求，以避免未授权的重置操作；在配置时需考虑ECU的实际能力和安全要求，以确保配置的合理性和安全性；AUTOSAR CP 4.4标准中对ECU重置的处理和配置有明确规范，需遵循标准以保证兼容性。
            enumeration DcmResponseToEcuReset: {AFTER_RESET, BEFORE_RESET}, scope=ECU, set at pre-compile  # Defines the answer to EcuReset service should come: Before or after the reset. / 概述：DcmResponseToEcuReset配置项用于定义诊断通信管理器（Diagnostic Communication Manager）如何响应来自外部测试设备的ECU重置请求，包括重置类型和执行后的行为。 注意：在配置DcmResponseToEcuReset时，需要确保所选的重置类型与ECU支持的重置类型相匹配；对于安全相关的重置请求，应确保适当的安全措施被实施，以防止未授权的重置操作；AUTOSAR CP 4.4标准中，对于ECU重置的响应行为应详细定义，以避免在重置后出现不可预期的行为。
            integer DcmDspEcuResetId: 0..127, scope=ECU, multiplicity set at link in variant link-time / pre-compile in variant post-build+pre-compile, set at link in variant link-time / pre-compile in variant post-build+pre-compile  # Defines the subfunction ID / 概述：DcmDspEcuResetId 是用于定义诊断服务组件（Diagnostic Communication Manager）中ECU重置类型的标识符，它指定了执行ECU重置时所需的服务标识符和选项。 注意：在配置DcmDspEcuResetId时，需要确保其值与ISO 14229标准中定义的ECU重置服务标识符一致；此外，应当检查与该重置类型相关的所有依赖性和权限设置，以确保在执行重置时系统的安全性和一致性；在AUTOSAR CP 4.4标准中，还应注意与诊断事件管理和诊断操作周期的兼容性。
        container DcmDspMemory [0..1]  # This container contains the configuration of the memory access. / 概述：DcmDspMemory配置项用于定义诊断服务组件（Diagnostic Communication Manager）中与内存操作相关的属性，例如读取或写入ECU内存的权限、地址范围以及内存大小等。 注意：在配置DcmDspMemory时，需要确保内存地址范围和大小与ECU实际硬件资源相匹配；权限设置应符合安全和诊断策略要求；在AUTOSAR CP 4.4标准中，可能需要考虑与SecOC模块的安全通信集成。
          container DcmDspAddressAndLengthFormatIdentifier [0..1]  # This container contains the configuration of the supported AddressAndLengthFormatIdentifiers for memory access.
            integer DcmDspSupportedAddressAndLengthFormatIdentifier [1..*]: 0..255, scope=ECU, multiplicity set at link in variant link-time / pre-compile in variant post-build+pre-compile, set at link in variant link-time / pre-compile in variant post-build+pre-compile  # This parameter defines the supported AddressAndLengthFormatIdentifier of the request message.
          container DcmDspMemoryIdInfo [1..*]  # Provides the value of memory identifier used to select the desired memory device / 概述：DcmDspMemoryIdInfo配置项用于定义诊断服务中内存标识符的属性，包括内存地址范围和内存大小，用于支持读写内存服务（如服务10、3D）中对不同内存区域的访问控制。 注意：内存标识符必须唯一，以避免在诊断会话中对内存区域的访问冲突；配置的内存地址范围和大小应与实际硬件资源相匹配，确保诊断访问的有效性和安全性；在配置时需考虑不同安全访问级别对内存访问的限制。 | This container contains the configuration of the memory access requested through diagnostic services : ReadMemoryByAddress, WriteMemoryByAddress, and DynamicallyDefineDataIdentifier
            integer DcmDspMemoryIdValue [0..1]: 0..255, scope=ECU, multiplicity set at link in variant link-time / pre-compile in variant post-build+pre-compile, set at link in variant link-time / pre-compile in variant post-build+pre-compile, default-value=0  # Value of the memory device identifier used. | Each DcmDspMemoryIdInfo should have a unique ID. The MemoryIdValue is retrieved from the request messages (RMBA,WMBA,RD,RU,DDDI) according to ISO-14229-1 with the most significant byte of the request parameter memoryAddress.
            container DcmDspReadMemoryRangeByLabelInfo [0..*]  # Provides a memory range allowed for reading via labels (lower and higher address configured as strings). / 概述：DcmDspReadMemoryRangeByLabelInfo是一个配置项，用于定义诊断服务中读取内存范围的参数，包括内存地址、大小以及相关的访问权限标签。 注意：在配置时需确保内存地址和大小的正确性，以避免对系统的非法访问或潜在的内存损坏；访问权限标签应与系统的安全策略相匹配，确保只有授权的诊断会话能够访问对应的内存区域；AUTOSAR CP 4.4标准可能对内存读取服务的实现和配置有特定的要求，需要仔细参照标准文档进行配置。
              string DcmDspReadMemoryRangeByLabelHigh: set at pre-compile, regular-expression=[a-zA-Z0-9_]([a-zA-Z0-9\._])*  # High memory address as label (string) of a range allowed for reading. / 概述：DcmDspReadMemoryRangeByLabelHigh配置项用于定义诊断服务中读取内存范围的上限地址，这是在执行读取内存范围（ReadMemoryByAddress）服务时，通过标签指定的内存地址的最高可能值。 注意：在配置此项时，需确保上限地址不低于对应的DcmDspReadMemoryRangeByLabelLow配置的下限地址；地址范围应符合ECU内存布局和安全访问要求；此配置应与ECU的实际物理内存地址和访问权限相匹配，避免配置超出实际可访问的内存范围。
              string DcmDspReadMemoryRangeByLabelLow: set at pre-compile, regular-expression=[a-zA-Z0-9_]([a-zA-Z0-9\._])*  # Low memory address as label (string) of a range allowed for reading. / 概述：DcmDspReadMemoryRangeByLabelLow配置项用于定义诊断服务中读取内存范围请求的最低地址标签，它指定了允许读取的内存地址下限。 注意：在配置时需确保该地址低于或等于对应的DcmDspReadMemoryRangeByLabelHigh配置项中的地址，以保证内存读取范围的有效性和安全性；此外，地址应当符合ECU内存地址空间的实际分布，避免指向非法或保护区域；在AUTOSAR CP 4.4标准中，确保该配置与ECU的内存映射和安全访问权限设置一致。
              reference DcmDspReadMemoryRangeModeRuleRef [0..1]: scope=ECU, multiplicity set at link in variant link-time / pre-compile in variant post-build+pre-compile, set at link in variant link-time / pre-compile in variant post-build+pre-compile, destination=DcmModeRule  # Reference to DcmModeRule | Mode rule which controls read access on this memory address. If there is no reference, no check of the mode rule shall be done.
              reference DcmDspReadMemoryRangeSecurityLevelRef [0..*]: scope=ECU, multiplicity set at link in variant link-time / pre-compile in variant post-build+pre-compile, set at link in variant link-time / pre-compile in variant post-build+pre-compile, destination=DcmDspSecurityRow  # Link to the Security Access Levels needed for read access on this memory address. If there is no reference, no check of security level shall be done.
              reference DcmDspReadMemoryRangeSessionLevelRef [0..*]: scope=ECU, multiplicity set at link in variant link-time / pre-compile in variant post-build+pre-compile, set at link in variant link-time / pre-compile in variant post-build+pre-compile, destination=DcmDspSessionRow  # Link to the session level needed for access to this memory address range. | If there is no reference, no check of session level shall be done.
            container DcmDspReadMemoryRangeInfo [0..*]  # Provides the range of memory address allowed for reading / 概述：DcmDspReadMemoryRangeInfo配置项用于定义诊断服务组件（Diagnostic Communication Manager）中读取内存范围的参数，包括内存地址、大小以及相关的安全访问权限。 注意：在配置DcmDspReadMemoryRangeInfo时，需要确保内存地址和大小的定义不会超出实际的物理或应用程序内存范围；必须考虑到安全访问权限，以防止未授权的内存访问；此外，应当检查与ECU内存映射的一致性，确保诊断请求能够正确地访问指定的内存区域。
              integer DcmDspReadMemoryRangeHigh: 0..4294967294, scope=ECU, set at link in variant link-time / pre-compile in variant post-build+pre-compile  # High memory address of a range allowed for reading / 概述：DcmDspReadMemoryRangeHigh配置项用于定义诊断服务中读取内存范围的上限地址，确保诊断请求只能访问允许的内存区域。 注意：在配置时需确保上限地址不低于对应的DcmDspReadMemoryRangeLow配置项中的下限地址；地址范围应符合ECU内存布局和安全要求；在配置多个内存范围时，要避免地址范围重叠。
              integer DcmDspReadMemoryRangeLow: 0..4294967294, scope=ECU, set at link in variant link-time / pre-compile in variant post-build+pre-compile  # Low memory address of a range allowed for reading / 概述：DcmDspReadMemoryRangeLow配置项用于定义诊断服务读取内存范围的最低地址限制，确保内存读取操作在允许的地址范围内进行。 注意：在配置DcmDspReadMemoryRangeLow时，需要确保该地址低于或等于对应的DcmDspReadMemoryRangeHigh配置项以定义有效的地址范围；此外，应检查ECU内存映射和安全访问权限，以确保配置的地址是可访问和允许读取的；在AUTOSAR CP 4.4标准中，地址值应符合ECU的内存寻址能力和数据类型限制。
              reference DcmDspReadMemoryRangeModeRuleRef [0..1]: scope=ECU, multiplicity set at link in variant link-time / pre-compile in variant post-build+pre-compile, set at link in variant link-time / pre-compile in variant post-build+pre-compile, destination=DcmModeRule  # Reference to DcmModeRule / 概述：DcmDspReadMemoryRangeModeRuleRef配置项用于定义诊断服务读取内存范围时应用的模式规则引用，确保在执行读取内存操作时，满足特定的条件或权限限制。 注意：该配置项需要与Dcm的安全访问和会话控制策略相匹配，确保只有在适当的诊断会话和安全访问级别下才能读取特定的内存范围；在配置时需确保引用的模式规则存在且正确；AUTOSAR CP 4.4中对于权限管理和安全性有更加严格的要求，需要仔细检查与之相关的配置。 | Mode rule which controls read access on this memory address. If there is no reference, no check of the mode rule shall be done.
              reference DcmDspReadMemoryRangeSecurityLevelRef [0..*]: scope=ECU, multiplicity set at link in variant link-time / pre-compile in variant post-build+pre-compile, set at link in variant link-time / pre-compile in variant post-build+pre-compile, destination=DcmDspSecurityRow  # Link to the Security Access Levels needed for read access on this memory address. If there is no reference, no check of security level shall be done. / 概述：DcmDspReadMemoryRangeSecurityLevelRef配置项用于指定访问特定内存范围时所需的安全等级，确保只有在达到相应安全等级后才能读取特定的内存区域。 注意：在配置时需确保引用的安全等级已在系统中定义；不同的内存范围可以配置不同的安全等级要求，以满足不同安全需求；AUTOSAR CP 4.4标准中，安全等级的配置和管理是一个重要方面，需要仔细规划以确保系统安全。
              reference DcmDspReadMemoryRangeSessionLevelRef [0..*]: scope=ECU, multiplicity set at link in variant link-time / pre-compile in variant post-build+pre-compile, set at link in variant link-time / pre-compile in variant post-build+pre-compile, destination=DcmDspSessionRow  # Link to the session level needed for access to this memory address range. / 概述：DcmDspReadMemoryRangeSessionLevelRef配置项指定了在执行读取内存范围操作时，允许的诊断会话级别，用于控制不同诊断会话下哪些内存区域可以被访问。 注意：确保配置的会话级别与实际应用场景相匹配，避免在安全关键的会话中误配置允许访问敏感内存区域；在配置时考虑所有可能的会话级别，确保系统的安全性和数据保护；AUTOSAR CP 4.4标准中，对会话级别的定义和使用有严格规范，需要遵循这些规范以保证兼容性。 | If there is no reference, no check of session level shall be done.
            container DcmDspWriteMemoryRangeByLabelInfo [0..*]  # Provides a memory range allowed for writing via labels (lower and higher address configured as strings). / 概述：DcmDspWriteMemoryRangeByLabelInfo配置项用于定义诊断服务中写入内存范围的参数，包括内存地址、大小以及访问权限等信息，以支持对特定内存区域的写操作。 注意：在配置时需确保内存地址和大小的正确性，避免对系统的其他部分造成意外的影响；必须正确设置访问权限，以防止未授权的访问；该配置项在AUTOSAR CP 4.4中应与安全和诊断需求紧密结合，确保配置的安全性。
              string DcmDspWriteMemoryRangeByLabelHigh: set at pre-compile, regular-expression=[a-zA-Z0-9_]([a-zA-Z0-9\._])*  # High memory address as label (string) of a range allowed for writing. / 概述：DcmDspWriteMemoryRangeByLabelHigh配置项用于定义诊断服务中写入内存操作的上限地址标签，它指定了可以通过诊断服务写入的内存区域的最高地址。 注意：在配置时需确保该地址范围内的内存可被安全写入，且不会影响系统的稳定性；地址标签应与实际的内存布局相匹配，避免因地址错误导致潜在的内存损坏；在配置多个内存范围时，应保证它们之间不会重叠，以防止写入操作的冲突。
              string DcmDspWriteMemoryRangeByLabelLow: set at pre-compile, regular-expression=[a-zA-Z0-9_]([a-zA-Z0-9\._])*  # Low memory address as label (string) of a range allowed for writing. / 概述：DcmDspWriteMemoryRangeByLabelLow配置项用于定义诊断服务中写入内存操作的最低地址限制，确保内存写入操作不会超出预设的地址范围。 注意：在配置时需确保地址范围与实际可写入的内存区域相匹配，避免因地址错误导致系统不稳定或安全问题；此配置项应与DcmDspWriteMemoryRangeByLabelHigh一起使用，以定义一个完整的内存写入范围；在AUTOSAR CP 4.4标准中，如果该配置项的属性与标准定义不一致，可能会导致诊断服务无法正确执行内存写入操作。
              reference DcmDspWriteMemoryRangeModeRuleRef [0..1]: scope=ECU, multiplicity set at link in variant link-time / pre-compile in variant post-build+pre-compile, set at link in variant link-time / pre-compile in variant post-build+pre-compile, destination=DcmModeRule  # Reference to DcmModeRule | Mode rule which controls write access on this memory address. If there is no reference, no check of the mode rule shall be done.
              reference DcmDspWriteMemoryRangeSecurityLevelRef [0..*]: scope=ECU, multiplicity set at link in variant link-time / pre-compile in variant post-build+pre-compile, set at link in variant link-time / pre-compile in variant post-build+pre-compile, destination=DcmDspSecurityRow  # Link to the Security Access Levels needed for write access on this memory address. If there is no reference, no check of security level shall be done.
              reference DcmDspWriteMemoryRangeSessionLevelRef [0..*]: scope=ECU, multiplicity set at link in variant link-time / pre-compile in variant post-build+pre-compile, set at link in variant link-time / pre-compile in variant post-build+pre-compile, destination=DcmDspSessionRow  # Link to the session level needed for access to this memory address range. | If there is no reference, no check of session level shall be done.
            container DcmDspWriteMemoryRangeInfo [0..*]  # Provides the range of memory address allowed for writting. / 概述：DcmDspWriteMemoryRangeInfo配置项定义了诊断服务中写内存操作的范围信息，包括可写的内存地址范围和相关的安全访问级别。 注意：在配置时需确保内存地址范围不与其他服务或应用的内存使用冲突；必须正确配置安全访问级别，以防止未授权访问；该配置项在AUTOSAR CP 4.4中应与诊断安全需求相一致，确保配置的安全性。
              integer DcmDspWriteMemoryRangeHigh: 0..4294967294, scope=ECU, set at link in variant link-time / pre-compile in variant post-build+pre-compile  # High memory address of a range allowed for writing. / 概述：DcmDspWriteMemoryRangeHigh配置项用于定义诊断服务中写入内存操作的最高内存地址范围，确保诊断请求只能访问允许的内存区域。 注意：在配置时需确保该地址范围与实际可写内存区域相匹配，避免潜在的安全风险；该配置项通常与DcmDspWriteMemoryRangeLow一起使用，以定义一个完整的内存写入范围；在多内存区域的系统中，可能需要配置多个写内存范围对。
              integer DcmDspWriteMemoryRangeLow: 0..4294967294, scope=ECU, set at link in variant link-time / pre-compile in variant post-build+pre-compile  # Low memory address of a range allowed for writing / 概述：DcmDspWriteMemoryRangeLow配置项用于定义诊断服务中可写内存地址的最低边界，确保内存写入操作的地址范围在允许的区域内。 注意：在配置DcmDspWriteMemoryRangeLow时，必须确保该值不低于ECU内存地址空间的最小边界；同时，该值应与DcmDspWriteMemoryRangeHigh配合使用，以定义一个有效的写入内存范围；此外，应考虑ECU的安全策略，以防止未授权的内存写入操作。
              reference DcmDspWriteMemoryRangeModeRuleRef [0..1]: scope=ECU, multiplicity set at link in variant link-time / pre-compile in variant post-build+pre-compile, set at link in variant link-time / pre-compile in variant post-build+pre-compile, destination=DcmModeRule  # Reference to DcmModeRule / 概述：DcmDspWriteMemoryRangeModeRuleRef配置项用于引用特定的诊断会话和安全访问级别规则，这些规则定义了在哪些条件下允许对内存范围进行写操作。 注意：在配置DcmDspWriteMemoryRangeModeRuleRef时，需要确保引用的诊断会话和安全访问级别规则与实际的应用场景相匹配；引用的规则必须在Dcm配置中预先定义；违反这些规则可能导致诊断服务的写操作被不正确地限制或允许。 | Mode rule which controls write access on this memory address. If there is no reference, no check of the mode rule shall be done.
              reference DcmDspWriteMemoryRangeSecurityLevelRef [0..*]: scope=ECU, multiplicity set at link in variant link-time / pre-compile in variant post-build+pre-compile, set at link in variant link-time / pre-compile in variant post-build+pre-compile, destination=DcmDspSecurityRow  # Link to the Security Access Levels needed for write access on this memory address. If there is no reference, no check of security level shall be done. / 概述：DcmDspWriteMemoryRangeSecurityLevelRef配置项用于定义在执行写内存操作时必须满足的安全级别，确保只有在适当的安全级别下才能访问或修改特定的内存区域。 注意：必须确保引用的安全级别与系统的安全策略一致；在配置时应考虑所有潜在的安全风险，避免未授权的内存访问；该配置项应与Dcm的安全策略紧密集成，确保其有效性和一致性。
              reference DcmDspWriteMemoryRangeSessionLevelRef [0..*]: scope=ECU, multiplicity set at link in variant link-time / pre-compile in variant post-build+pre-compile, set at link in variant link-time / pre-compile in variant post-build+pre-compile, destination=DcmDspSessionRow  # Link to the session level needed for access to this memory address range. / 概述：DcmDspWriteMemoryRangeSessionLevelRef配置项用于指定在执行写内存范围操作时，允许的诊断会话级别，确保只有在特定的会话级别下才能执行写内存操作。 注意：在配置时需确保引用的会话级别与实际支持的诊断会话级别相匹配；若配置的会话级别不支持写内存操作，则在该会话级别下执行写内存操作将被拒绝；AUTOSAR CP 4.4标准中可能有特定的会话级别要求，需要根据标准进行配置。 | If there is no reference, no check of session level shall be done.
        container DcmDspMemoryTransfer [0..1]  # This container contains the configuration of the memory transfer. / 概述：DcmDspMemoryTransfer配置项是用于定义诊断服务组件（Diagnostic Communication Manager）中内存传输操作的参数，这包括读取、写入和擦除内存操作的相关配置。 注意：在配置DcmDspMemoryTransfer时，需要确保内存范围、访问权限和传输协议符合ECU的硬件和软件要求；此外，应当注意内存操作可能对系统的实时性和安全性产生影响，因此需要仔细规划和测试；AUTOSAR CP 4.4标准中可能对内存传输的数据大小、安全访问机制和传输协议有特定的要求或限制，需要遵守这些规范以确保兼容性。
          boolean DcmDspMemoryTransferUsePort: scope=ECU, set at pre-compile, default-value=false  # If this parameter is set to true, the Dcm uses a port requiring a PortInterface UploadDownload. / 概述：DcmDspMemoryTransferUsePort配置项用于指定诊断服务组件（Dcm）在执行内存传输操作时是否使用端口接口。 注意：在AUTOSAR CP 4.4标准中，应当确保该配置项与系统中实际使用的内存传输机制相匹配；如果系统设计要求通过端口接口与其他软件组件交互进行内存读写，该选项应配置为启用；反之，如果系统使用直接内存访问方式，则应配置为禁用。 | If the parameter is false, the DCM uses the according C-API callouts.
          function name DcmDspMemoryTransferFnc [0..1]: scope=ECU, multiplicity set at pre-compile, set at pre-compile  # Function name for memory transfer services. / 概述：DcmDspMemoryTransferFnc配置项用于定义诊断服务中的内存传输功能，它指定了用于读取、写入和擦除内存的函数指针，以便在诊断会话中执行内存操作。 注意：在配置DcmDspMemoryTransferFnc时，需要确保提供的函数指针与实际实现的内存操作函数相匹配；此配置项通常与Dcm的内存映射和安全访问权限设置紧密相关；在AUTOSAR CP 4.4标准中，应当遵循模块的内存和安全管理策略来配置此项，以确保诊断服务的正确性和安全性。 | Only relevant if DcmDspMemoryTransferUsePort is set to false.
          container DcmDspAddressAndLengthFormatIdentifier [0..1]  # This container contains the configuration of the supported AddressAndLengthFormatIdentifiers for memory access. / 概述：DcmDspAddressAndLengthFormatIdentifier配置项用于定义诊断服务中地址和长度信息的格式，这决定了如何解析从客户端接收到的数据以及如何构建响应消息。 注意：在配置此项时，需要确保所选格式与客户端期望的格式一致；格式标识符必须符合ISO 14229标准中定义的规范；在AUTOSAR CP 4.4中，应当检查该配置项是否支持新的或者已经废弃的格式标识符。
            integer DcmDspSupportedAddressAndLengthFormatIdentifier [1..*]: 0..255, scope=ECU, multiplicity set at link in variant link-time / pre-compile in variant post-build+pre-compile, set at link in variant link-time / pre-compile in variant post-build+pre-compile  # This parameter defines the supported AddressAndLengthFormatIdentifier of the request message. / 概述：DcmDspSupportedAddressAndLengthFormatIdentifier配置项用于定义诊断服务处理器（Diagnostic Service Processor）支持的地址和长度格式标识符，这有助于确保诊断请求和响应中的数据格式正确解析和处理。 注意：该配置项必须与车辆支持的诊断协议一致；不正确的配置可能导致诊断通信失败；在实现时需考虑诊断请求的多样性和兼容性。
          container DcmDspMemoryTransferIdInfo [1..*]  # Provides the value of memory identifier used to select the desired memory device / 概述：DcmDspMemoryTransferIdInfo配置项用于定义诊断服务中内存传输操作的标识符信息，这些信息用于支持不同的内存传输请求，如读取内存或写入内存。 注意：在配置DcmDspMemoryTransferIdInfo时，需要确保每个内存传输标识符与其对应的内存操作类型、地址范围和权限设置匹配；标识符应唯一，以避免在内存传输服务中的冲突；AUTOSAR CP 4.4标准可能对内存传输的数据大小、对齐和安全访问有特定要求，这些应在配置时考虑。 | This container contains the configuration of the memory access requested through diagnostic services : RequestDownload, RequestUpload, TransferData, RequestTransferExit
            integer DcmDspMemoryIdValue [0..1]: 0..255, scope=ECU, multiplicity set at link in variant link-time / pre-compile in variant post-build+pre-compile, set at link in variant link-time / pre-compile in variant post-build+pre-compile  # Value of the memory device identifier used. / 概述：DcmDspMemoryIdValue 是用于配置诊断服务组件（Diagnostic Communication Manager）中，内存标识符的值，该值用于区分不同的内存块，如EEPROM、闪存等，以便在执行读写内存服务时能够正确地访问对应的内存区域。 注意：在配置DcmDspMemoryIdValue时，需要确保内存标识符的值与实际硬件和ECU内存映射一致；标识符的值应该是唯一的，不应与其他内存块的标识符冲突；在AUTOSAR CP 4.4标准中，应遵循相关的诊断协议标准（如ISO 14229）中对内存标识符的规定。 | Each DcmDspMemoryIdInfo should have a unique ID. The MemoryIdValue is retrieved from the request messages (RMBA,WMBA,RD,RU,DDDI) according to ISO-14229-1 with the most significant byte of the request parameter memoryAddress.
        container DcmDspPeriodicTransmission [0..1]  # This container contains the configuration (parameters) for Periodic Transmission Scheduler. / 概述：DcmDspPeriodicTransmission配置项用于定义诊断通信管理器（Diagnostic Communication Manager）中的周期性数据传输属性，这包括周期性传输的数据和时间间隔等。 注意：在配置周期性传输时，需要确保数据的传输周期符合网络带宽和ECU处理能力的限制；应遵循相关的诊断协议标准，如ISO 14229；在AUTOSAR CP 4.4中，应确保配置与标准中定义的模块和参数兼容。
          float DcmDspPeriodicTransmissionFastRate [0..1]: 1E-4..0.255, multiplicity set at pre-compile, set at link in variant link-time / pre-compile in variant post-build+pre-compile  # This parameter give the transmission rate of the requested periodicDataIdentifiers to be used if the parameter transmissionMode given in the ReadDataByPeriodicID request is equal to 0x03 ("sendAtFastRate"). This parameter value in seconds have to be configured as a multiple of DcmTaskTime. / 概述：DcmDspPeriodicTransmissionFastRate配置项用于定义诊断通信管理器（Diagnostic Communication Manager）中，快速周期性数据传输的速率，即在快速周期性消息传输模式下，ECU发送周期性数据的时间间隔。 注意：该配置项的值应当符合车辆网络的带宽和ECU处理能力；过快的传输速率可能导致网络拥塞或ECU处理瓶颈；在配置时需遵循相关诊断协议标准和OEM的具体要求。 | min: A negative value and zero is not allowed.
          float DcmDspPeriodicTransmissionMediumRate [0..1]: 1E-4..0.255, multiplicity set at pre-compile, set at link in variant link-time / pre-compile in variant post-build+pre-compile  # This parameter give the transmission rate of the requested periodicDataIdentifiers to be used if the parameter transmissionMode given in the ReadDataByPeriodicID request is equal to 0x02 ("sendAtMediumRate"). This parameter value in seconds have to be configured as a multiple of DcmTaskTime. / 概述：DcmDspPeriodicTransmissionMediumRate配置项用于定义诊断通信管理（Diagnostic Communication Manager）中，周期性数据传输的中等速率，即在周期性传输控制中，中等速率的数据传输频率。 注意：该配置项的值需要根据网络带宽和ECU处理能力合理设置，以避免数据传输过程中的拥堵或丢失；在不同的车辆网络（如CAN、Ethernet等）中，合理的速率设置可能会有所不同，需要根据具体的网络特性进行调整；AUTOSAR CP 4.4标准中对于周期性传输的速率类别进行了定义，但具体数值需要根据实际应用场景和性能要求来确定。 | min: A negative value and zero is not allowed.
          float DcmDspPeriodicTransmissionSlowRate [0..1]: 1E-4..0.255, multiplicity set at pre-compile, set at link in variant link-time / pre-compile in variant post-build+pre-compile  # This parameter give the transmission rate of the requested periodicDataIdentifiers to be used if the parameter transmissionMode given in the ReadDataByPeriodicID request is equal to 0x01 ("sendAtSlowRate"). This parameter value in seconds have to be configured as a multiple of DcmTaskTime. / 概述：DcmDspPeriodicTransmissionSlowRate配置项用于定义诊断通信管理器（Diagnostic Communication Manager）中，慢速速率下的周期性数据传输的时间间隔，通常用于控制车辆诊断时数据更新的频率。 注意：该配置项的值应当根据车辆网络的带宽和诊断需求来设置，以确保网络不会因为过高的数据传输频率而过载；在设置时需要考虑到不同诊断会话模式下的数据传输要求，以及可能的诊断策略变化；如果配置的值与实际车辆网络的性能不匹配，可能会导致诊断响应时间延迟或通信失败。 | min: A negative value and zero is not allowed.
          integer DcmDspMaxPeriodicDidScheduler: 1..255, set at link in variant link-time / pre-compile in variant post-build+pre-compile  # Defines the maximum number of periodicDataIdentifiers that can be scheduled concurrently. / 概述：DcmDspMaxPeriodicDidScheduler配置项用于定义诊断通信管理器（Diagnostic Communication Manager）中，最大周期性数据标识符（DID）调度器的数量，这决定了可以同时激活的周期性DID传输的最大数量。 注意：在配置时需确保该值不超过ECU处理能力和网络带宽限制；该值应与实际应用中需要支持的周期性DID数量相匹配；超出此配置的周期性DID请求可能会被拒绝或导致系统性能下降。
