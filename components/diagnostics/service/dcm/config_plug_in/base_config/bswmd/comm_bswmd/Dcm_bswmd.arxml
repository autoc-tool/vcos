[part 2 of 2: packages /AUTOSAR/EcucDefs to /AUTOSAR/LifeCycleInfoSets]
AUTOSAR XML (schema 00046)
package /AUTOSAR/EcucDefs  (continued)
  module definition Dcm [0..1]: post-build-variant-support=true, variants link-time/post-build/pre-compile  (continued)
    container DcmConfigSet  (continued)
      container DcmDsp  (continued)
        container DcmDspPid [0..*]  # This container defines the availability of a PID to the DCM. / 概述：DcmDspPid配置项用于定义诊断服务中的参数标识符（PID），它指定了哪些数据可以通过诊断服务被读取或监控。 注意：PID的配置必须符合ISO 14229和ISO 15031标准中的要求；确保PID的唯一性，避免在同一诊断会话中重复配置；在配置PID时，应考虑数据的访问权限和安全级别，以保护敏感信息。
          boolean DcmDspPidUsed: scope=ECU, post-build-variant-value=true, set at link in variant link-time / post-build in variant post-build / pre-compile in variant pre-compile, default-value=true  # Allow to activate or deactivate the usage of a PID, for multi purpose ECUs / 概述：DcmDspPidUsed 是一个配置参数，用于指示是否使用了诊断服务组件（Diagnostic Service Component）中的参数标识符（Parameter Identifier，PID）。 注意：在配置Dcm模块时，如果需要支持OBD（On-Board Diagnostics）或UDS（Unified Diagnostic Services）中的某些PID，应将此参数设置为true；如果不使用任何PID，则可以设置为false以节省资源；确保配置与实际实现的诊断服务相匹配。 | true = PID is available false = PID is not available
          enumeration DcmDspPidService: {DCM_SERVICE_01, DCM_SERVICE_01_02, DCM_SERVICE_02}, scope=ECU, set at link in variant link-time / pre-compile in variant post-build+pre-compile, default-value=DCM_SERVICE_01  # Indicates if a PID is used with service $01 and/or $02 / 概述：DcmDspPidService配置项是用于定义诊断服务组件中的参数标识符（PID）服务的属性，这些服务允许访问车辆的数据，如发动机转速或车速等。 注意：在配置DcmDspPidService时，必须确保PID的唯一性和合法性，遵循OBD（On-Board Diagnostics）或制造商特定的诊断协议；配置的数据访问权限应符合安全访问要求，以防止未授权访问；AUTOSAR CP 4.4标准可能对PID服务的实现和配置有特定的要求，需要仔细遵守相关规范。
          integer DcmDspPidIdentifier: 0..255, scope=ECU, set at link in variant link-time / pre-compile in variant post-build+pre-compile  # 1 byte Identifier of the PID / 概述：DcmDspPidIdentifier配置项用于定义诊断服务中的参数标识符（PID），它指定了用于车辆诊断的特定参数ID，这些参数可以通过诊断服务被读取或监控。 注意：在配置DcmDspPidIdentifier时，必须确保PID符合ISO 15031-5定义的标准，并且在一个诊断会话中PID的值必须是唯一的；此外，与PID相关联的数据长度和格式应该符合预期的诊断协议要求；在AUTOSAR CP 4.4标准中，如果有新增的属性或者对现有属性有修改，需要确保配置项与标准保持一致。 | Within each DcmConfigSet all DcmDspPidIdentifier values shall be unique.
          integer DcmDspPidSize: 0..255, scope=ECU, set at link in variant link-time / pre-compile in variant post-build+pre-compile  # Length of a PID in byte(s). / 概述：DcmDspPidSize配置项用于定义诊断服务中参数标识符（PID）的大小，即PID数据的长度，这对于确保正确解析和响应车辆诊断请求是必要的。 注意：在AUTOSAR CP 4.4标准中，PID的大小应当符合诊断服务的规范要求；不正确的PID大小可能导致诊断通信失败或数据解析错误；在配置PID大小时，还需考虑与相关诊断请求和响应消息格式的兼容性。
          container DcmDspPidData  # This container defines the parameter for a Signal in the PID. / 概述：DcmDspPidData配置项用于定义诊断服务中参数标识符（PID）的数据属性，包括PID的长度、格式和存储位置，确保正确解析和响应PID请求。 注意：在配置DcmDspPidData时，必须确保PID的长度和格式与实际应用中的数据匹配；PID数据的存储位置应指向有效的内存或数据结构；AUTOSAR CP 4.4标准可能对PID的最大长度和支持的数据类型有具体要求，需要仔细核对。
            integer DcmDspPidByteOffset: 0..255, scope=ECU, set at link in variant link-time / pre-compile in variant post-build+pre-compile  # This is the position in bytes of the PID structure and will not start at position 0 in case a support information is available (for packeted PIDs). / 概述：DcmDspPidByteOffset配置项用于定义在诊断服务中，特定PID（Parameter Identifiers）数据的字节偏移量，确保数据能够被正确地解析和访问。 注意：该配置项的设置必须确保与实际PID数据结构的布局一致，避免数据解析错误；在配置多个PID时，需要注意各PID之间的字节偏移量设置不应该产生重叠；AUTOSAR CP 4.4标准中未对此配置项的具体属性做出特别限制，但实际应用时应根据具体的诊断需求和数据结构进行准确配置。
            integer DcmDspPidDataByteSize [0..1]: 0..255, scope=ECU, multiplicity set at link in variant link-time / pre-compile in variant post-build+pre-compile, set at link in variant link-time / pre-compile in variant post-build+pre-compile  # Defines the array length in bytes or the the maximum array length for variable datalengths. / 概述：DcmDspPidDataByteSize配置项用于定义诊断服务中参数标识符（PID）的数据字节大小，这决定了PID数据的长度，是诊断通信中重要的配置。 注意：在配置DcmDspPidDataByteSize时，必须确保其大小与实际PID所需的数据长度一致；超出或不足的数据字节大小可能导致诊断响应不正确；此外，该配置项应符合诊断标准和车辆制造商的具体要求。
            container DcmDspPidDataSupportInfo [0..1]  # This container defines the supported information. / 概述：DcmDspPidDataSupportInfo配置项用于定义诊断服务中参数标识符（PID）的支持信息，包括PID是否被支持以及如何读取PID的数据。 注意：在配置DcmDspPidDataSupportInfo时，需要确保PID符合车辆制造商的诊断需求；对于不支持的PID，应明确标记以避免诊断工具错误识别；配置信息应与ECU支持的实际能力相匹配，避免诊断通信中的数据不一致问题。
              integer DcmDspPidDataSupportInfoBit: 0..255, scope=ECU, set at link in variant link-time / pre-compile in variant post-build+pre-compile  # Referenced Bit of the SupportInfo / 概述：DcmDspPidDataSupportInfoBit配置项用于决定在诊断服务中，特定的PID（Parameter Identifiers）是否支持数据流的“支持信息位”。这通常用于指示一个数据标识符是否可用于车辆的诊断数据流。 注意：在配置DcmDspPidDataSupportInfoBit时，需要确保它与车辆支持的PID列表相匹配；此配置项的设置必须符合OBD（On-Board Diagnostics）要求，如果适用；在AUTOSAR CP 4.4标准中，应当遵循相关的诊断协议标准，如ISO 15031-5或ISO 14229-1，以确保兼容性。
              reference DcmDspPidDataSupportInfoRef: scope=ECU, set at link in variant link-time / pre-compile in variant post-build+pre-compile, destination=DcmDspPidSupportInfo  # Reference to DcmDspPidSupportInfo / 概述：DcmDspPidDataSupportInfoRef是一个配置项，用于引用支持特定诊断服务标识符（PID）的数据元素的信息，以便在诊断通信中正确处理和响应PID请求。 注意：确保引用的数据元素信息与实际支持的PID匹配，以保证诊断服务的正确性；在配置时需注意数据元素的访问权限和安全级别，以满足诊断安全要求；该配置项在AUTOSAR CP 4.4中应与诊断服务的需求和实现紧密相关，确保配置的一致性和准确性。
            container DcmDspPidService01 [0..1]  # Contains specific configuration parameter of PID for service $01. This container exists only if DcmDspPidService is set to DCM_SERVICE_01 or DCM_SERVICE_01_02. / 概述：DcmDspPidService01配置项是用于定义诊断服务$01（读取数据流）中的参数标识符（PID），它指定了哪些数据应当被读取并返回给诊断工具。 注意：在配置DcmDspPidService01时，需要确保PID符合车辆制造商的要求以及相关法规标准；PID的数据类型和长度必须与ECU提供的数据匹配；在配置过程中，还需注意PID之间的依赖关系和数据一致性。
              enumeration DcmDspPidDataEndianness [0..1]: {BIG_ENDIAN, LITTLE_ENDIAN, OPAQUE}, scope=ECU, multiplicity set at pre-compile, set at pre-compile, default-value=opaque  # Defines the endianness of the data belonging to a PID in a diagnostic response message. / 概述：DcmDspPidDataEndianness配置项用于定义诊断服务中参数标识符（PID）数据的字节序，确保数据的正确解析和交换。 注意：在配置时需确保字节序与ECU内部数据处理的字节序一致；不同平台间的数据交换可能需要考虑字节序转换；AUTOSAR CP 4.4标准支持大端和小端字节序，但具体选择应基于目标平台和应用需求。 | If no DcmDspPidDataEndianness is defined the value of DcmDspDataDefaultEndianness is applicable.
              enumeration DcmDspPidDataType: {BOOLEAN, SINT16, SINT32, SINT8, UINT16, UINT32, UINT8, UINT8_N}, scope=ECU, multiplicity set at link in variant link-time / pre-compile in variant post-build+pre-compile, set at link in variant link-time / pre-compile in variant post-build+pre-compile, default-value=UINT8_N  # Provide the implementation data type of data belonging to a PID. / 概述：DcmDspPidDataType用于定义诊断服务中参数标识符（PID）的数据类型，这有助于确保数据的正确解释和处理。 注意：在配置DcmDspPidDataType时，必须确保所选数据类型与PID的实际数据格式相匹配；不正确的数据类型配置可能导致数据解析错误或通信故障；AUTOSAR CP 4.4标准中对于诊断数据类型有明确的规范，需要遵循这些规范以保证兼容性。
              enumeration DcmDspPidDataUsePort: {USE_DATA_SYNCH_CLIENT_SERVER, USE_DATA_SYNCH_FNC}, scope=ECU, set at pre-compile, default-value=USE_DATA_SYNCH_CLIENT_SERVER  # If this parameter is set to USE_DATA_SYNCH_FNC, the Dcm will use the function defined in DcmDspPidDataReadFnc to get the PID data value. / 概述：DcmDspPidDataUsePort配置项指定了诊断服务组件（Diagnostic Service Component）中，用于处理特定PID（Parameter Identifiers）数据的端口类型，决定了数据如何从软件组件中获取。 注意：在AUTOSAR CP 4.4标准中，必须确保端口类型与实际的软件组件接口匹配；端口类型的选择会影响数据访问的实现方式和性能；不正确的端口配置可能导致诊断服务无法正确访问所需数据。 | If this parameter is set to USE_DATA_SYNCH_CLIENT_SERVER, the Dcm will have an R-Port requiring the interface DataServices_{Data}. If this parameter is set to USE_DATA_SENDER_RECEIVER or USE_DATA_SENDER_RECEIVER_AS_SERVICE, the DCM will have an R-Port requiring a SenderReceiverInterface. The R-Port is named DataServices_{Data} where {Data} is the name of the container DcmDspPidData.
              function name DcmDspPidDataReadFnc [0..1]: scope=ECU, multiplicity set at pre-compile, set at pre-compile  # Function name for reading PID data value. / 概述：DcmDspPidDataReadFnc配置项用于定义诊断服务组件（Diagnostic Communication Manager）中，用于读取特定参数标识符（Parameter Identifier, PID）数据的函数名称。 注意：函数名称应遵循AUTOSAR命名规范，确保与实际实现的函数名一致；该函数需要符合AUTOSAR规定的接口和行为模式，以确保正确的数据读取和错误处理；在配置时需注意PID数据的安全访问，防止未授权的数据读取。 | This is only relevant if DcmDspPidDataUsePort==USE_DATA_SYNCH_FNC. This parameter is related to the interface Xxx_ReadData.
              choice container DcmDspDiagnosisScaling [0..1]  # This container contains the configuration (parameters) of an alternative Diagnosis Representation. Out if this the scaling between Diagnosis and ECU internal representation and vice versa can be calculated. / 概述：DcmDspDiagnosisScaling配置项用于定义诊断服务中数据缩放的参数，这些参数决定了如何将内部数据值转换为对外报告的诊断值，或者反之，如何将诊断值转换回内部数据值。 注意：在配置DcmDspDiagnosisScaling时，需要确保缩放算法与实际应用场景相匹配；缩放参数必须与相关的数据类型和诊断需求一致；在AUTOSAR CP 4.4标准中，应当遵循相关规范来配置这些参数，以保证诊断服务的正确性和互操作性。
                container DcmDspAlternativeDataInterface [0..1]  # This container contains the configuration (parameters) of an alternative Diagnosis Representation by the means of a VariableDataPrototoype in a DataInterface. / 概述：DcmDspAlternativeDataInterface配置项用于定义诊断服务组件（Diagnostic Communication Manager）中，备选数据接口的属性，这些接口用于读取或写入数据，当标准数据接口不可用时。 注意：在AUTOSAR CP 4.4标准中，确保备选数据接口的配置与系统中实际可用的备选接口相匹配；备选数据接口应当仅在标准接口无法满足需求时使用；配置时需注意备选接口的权限和安全性要求，以防止未授权访问。 | Additionally a reference to PortInterfaceMapping can be defined which provide already the mapping rules between the VariableDataPrototoype in a DataInterface used by the software component (DcmDspExternalSRDataElementClass) and the intended Diagnosis Representation defined by DcmDataElement.
                  foreign reference DcmDataElement: set at pre-compile, destination-type=VARIABLE-DATA-PROTOTYPE  # Alternative Diagnosis Representation for the data defined by the means of a VariableDataPrototoype in a DataInterface. | The CompuMethod of the data type of the referenced VariableDataPrototype will be applied to the data type of the VariableDataPrototype in the interface used by the Dcm.
                  foreign reference DcmPortInterfaceMapping [0..1]: multiplicity set at pre-compile, set at pre-compile, destination-type=PORT-INTERFACE-MAPPING  # Optional reference to PortInterfaceMapping which defines the mapping rules. / 概述：DcmPortInterfaceMapping用于定义诊断通信管理器（Diagnostic Communication Manager）与软件组件之间的接口映射，确保诊断请求能够正确地传递给相应的软件组件进行处理。 注意：在配置DcmPortInterfaceMapping时，需要确保映射关系的正确性和一致性，避免诊断请求无法正确处理；此配置项对于实现车辆诊断功能至关重要，应仔细设计和验证；AUTOSAR CP 4.4标准中对诊断功能有详细规定，需遵守相关规范以保证兼容性。 | The PortInterfaceMapping is used to get the DataPrototypeMapping that describes a conversion between the data prototype referenced by DcmDataElement and the data prototype referenced from DcmDspExternalSRDataElementClass.
                container DcmDspAlternativeDataType [0..1]  # This container contains the configuration (parameters) of an alternative Diagnosis Representation by the means of an ApplicationDataType. | Additionally the definition of a text table mapping can be a defined for ApplicationDataTypes with a CompuMethod of category TEXTTABLE and SCALE_LINEAR_AND_TEXTTABLE.
                  foreign reference DcmApplicationDataType: set at pre-compile, destination-type=APPLICATION-DATA-TYPE  # Alternative Diagnosis Representation for the data defined by the means of a ApplicationDataType of category VALUE, BOOLEAN or ARRAY. | The CompuMethod that applies to the referenced ApplicationDataType in case of category VALUE or BOOLEAN will be applied to the data type of the VariableDataPrototype in the interface used by the Dcm.
                  container DcmDspTextTableMapping [0..*]  # The purpose of the DcmDspTextTableMapping is to associate a texttable value defined in the context of the Dcm to a texttable value defined in the context of a CompuMethod referenced by a DataType that shall be taken to create a dataElement in a SenderReceiverInterface. By this means it is possible to create a primitive version of a TexttableMapping (which can only be applied if a dataElement already exists). | In other words, the DcmDspTextTableMapping provides a similar mechanism to the TexttableMapping in a situation where the TexttableMapping cannot be applied since the SenderReceiverInterface for the PortPrototype on the Dcm ServiceComponent does not yet exist.
                    integer DcmDspDiagnosisRepresentationDataValue: 0..18446744073709551615, scope=ECU, set at pre-compile  # The data value in the diagnosis representation.
                    integer DcmDspInternalDataValue: 0..18446744073709551615, scope=ECU, set at pre-compile  # The ECU internal data value.
                container DcmDspAlternativeDiagnosticDataElement [0..1]  # This container contains the configuration (parameters) of an alternative Diagnosis Representation by the means of Diagnostic Extract.
                  foreign reference DcmDspDiagnosticDataElementRef: set at pre-compile, destination-type=DIAGNOSTIC-DATA-ELEMENT  # Alternative Diagnosis Representation for the data defined by the means of a DiagnosticDataElement in the Diagnostic Extract. | This EcucForeignReference enables the access to all SwDataDefProps, in particular BaseType, CompuMethod and DataConstr The CompuMethod and DataConstr that applies to the referenced DiagnosticDataElement will be applied to the data type of the VariableDataPrototype in the interface used by the Dcm. The mapped ImplementationDataType needs to match the given BaseType.
              choice container DcmDspPidService01ExternalSRDataElementClass [0..1]  # This container defines the source of data in a provided port which shall be read respectively the target of data in a required port which shall be written. / 概述：DcmDspPidService01ExternalSRDataElementClass配置项用于定义诊断服务$01（读取数据流）中外部信号表示的数据元素类别，这些数据元素通常来源于车辆信号或传感器，并且可以通过服务$01被读取。 注意：在配置DcmDspPidService01ExternalSRDataElementClass时，需要确保引用的数据元素与实际的车辆信号或传感器数据一致；此外，还需注意数据元素的访问权限和安全级别设置，以确保数据的安全性；AUTOSAR CP 4.4标准可能对数据元素的类型和大小有特定要求，因此在配置时应参照标准文档以保证兼容性。 | This container shall contain either one DcmSubElementInDataElementInstance OR DcmDataElementInstance OR DcmSubElementInImplDataElementInstance reference.
                container DcmDataElementInstance [0..1]  # Instance Reference to the primitive data in a port where the data element is typed with an ApplicationPrimitveDataType or an ImplementationDataType. / 概述：DcmDataElementInstance配置项用于定义诊断数据元素的实例，它指定了数据元素在诊断服务中的具体实现，如数据源和数据大小。 注意：在配置DcmDataElementInstance时，需要确保数据元素的类型、大小和对齐方式符合AUTOSAR标准和ECU的内存映射要求；数据元素的访问权限应与诊断服务的安全级别相匹配；在配置数据元素时，还应考虑到数据的实时性和一致性要求。
                  instance reference DcmDataElementInstanceRef: set at pre-compile, destination-context=ROOT-SW-COMPOSITION-PROTOTYPE SW-COMPONENT-PROTOTYPE PORT-PROTOTYPE, destination-type=AUTOSAR-DATA-PROTOTYPE  # Instance Reference to the primitive or array data which shall be read or written. / 概述：DcmDataElementInstanceRef配置项用于引用诊断数据元素实例，它指定了诊断服务中使用的具体数据元素，如车辆速度或引擎转速。 注意：在配置DcmDataElementInstanceRef时，需要确保引用的数据元素与诊断服务的需求相匹配；引用的数据元素必须在系统中定义且可访问；在配置过程中，还需注意数据元素的访问权限和安全级别设置，以确保数据的保护和合规性。 | Supported are VariableDataPrototypes in SenderReceiverInterfaces and NvDataInterfaces and ParameterDataPrototypes in ParameterInterfaces (read only). This reference is applicable if the AutosarDataPrototype is typed with a ApplicationPrimitiveDataType of category VALUE or BOOLEAN or ApplicationArrayDataType or if the AutosarDataPrototype is typed with a ImplementationDataType of category VALUE, ARRAY or TYPE_REFERENCE that in turn boils down to VALUE or ARRAY
                container DcmSubElementInDataElementInstance [0..1]  # Instance Reference to the primitve sub-element (at any level) of composite data in a port where the data element is typed with an ApplicationCompositeDataType. / 概述：DcmSubElementInDataElementInstance配置项用于定义诊断数据元素实例中的子元素，这些子元素可以是基本数据类型或者更复杂的数据结构，用于支持复杂的诊断通信需求。 注意：在定义子元素时，必须确保其数据类型与父数据元素兼容；子元素的顺序可能会影响诊断消息的解析和构造，因此需要仔细规划；此配置项在AUTOSAR CP 4.4中可能受到严格的数据封装和接口规范的约束。
                  instance reference DcmSubElementInDataElementInstanceRef: set at pre-compile, destination-context=ROOT-SW-COMPOSITION-PROTOTYPE SW-COMPONENT-PROTOTYPE PORT-PROTOTYPE AUTOSAR-DATA-PROTOTYPE APPLICATION-COMPOSITE-ELEMENT-DATA-PROTOTYPE*, destination-type=APPLICATION-COMPOSITE-ELEMENT-DATA-PROTOTYPE  # Instance Reference to the primitve sub-element (at any level) of composite data in a port which shall be read. / 概述：DcmSubElementInDataElementInstanceRef配置项用于定义诊断数据元素实例中子元素的引用，它指定了子元素在父数据元素中的位置，以便于在诊断通信中正确解析和访问这些子元素。 注意：在配置子元素引用时，需要确保引用的有效性和正确性，以免在诊断通信过程中出现数据不一致；子元素的定义必须与实际的数据结构相匹配，遵循AUTOSAR标准中对数据元素的规定；在多层嵌套的数据结构中，正确地识别和配置每个子元素的路径是关键，以确保诊断服务的准确性。 | Supported are VariableDataPrototypes in SenderReceiverInterfaces and NvDataInterfaces and ParameterDataPrototypes in ParameterInterfaces (read only). This reference is applicable if the AutosarDataPrototype is typed with a ApplicationCompositeDataType.
                container DcmSubElementInImplDataElementInstance [0..1]  # Instance Reference to the primitve sub-element (at any level) of composite data in a port where the data element is typed with an ImplementationDataType. / 概述：DcmSubElementInImplDataElementInstance配置项用于定义诊断通信管理器（Diagnostic Communication Manager）中实现数据元素实例的子元素，这些子元素是实现数据元素的一部分，用于处理车辆诊断过程中的数据交换。 注意：在配置DcmSubElementInImplDataElementInstance时，需要确保子元素与其父实现数据元素之间的关系正确无误；子元素的数据类型和大小必须与其在诊断数据标识符中定义的类型和大小相匹配；在配置过程中，应遵循AUTOSAR规范中关于诊断数据元素的定义和约束。
                  instance reference DcmSubElementInImplDataElementInstanceRef: set at pre-compile, destination-context=ROOT-SW-COMPOSITION-PROTOTYPE SW-COMPONENT-PROTOTYPE PORT-PROTOTYPE AUTOSAR-DATA-PROTOTYPE IMPLEMENTATION-DATA-TYPE-ELEMENT*, destination-type=IMPLEMENTATION-DATA-TYPE-ELEMENT  # Instance Reference to the primitve sub-element (at any level) of composite data in a port which shall be read. / 概述：DcmSubElementInImplDataElementInstanceRef 用于引用实现数据元素中的子元素，这有助于在诊断通信管理模块中精确地定位和处理数据。 注意：确保引用的子元素在实现数据元素中正确定义和存在；在配置时应遵循AUTOSAR的数据引用规则，以保证数据的一致性和正确性；在多层嵌套的数据结构中，路径引用需要特别小心以避免错误。 | Supported are VariableDataPrototypes in SenderReceiverInterfaces and NvDataInterfaces and ParameterDataPrototypes in ParameterInterfaces (read only). This reference is applicable if the AutosarDataPrototype is typed with a ImplementationDataType of category STRUCTURE or ARRAY. Please note that in case of ARRAY the index attribute in the target reference has to be set to select a single array element.
            container DcmDspPidService02 [0..1]  # Contains specific configuration parameter of PID for service $02. This container exists only if DcmDspPidService is set to DCM_SERVICE_02 or DCM_SERVICE_01_02. / 概述：DcmDspPidService02配置项用于定义诊断服务02（读取当前数据）中的参数标识符（PID）的处理方式，包括如何读取数据和响应请求。 注意：确保配置的PID符合车辆制造商的规范和诊断需求；在配置PID时，应注意数据的安全性和访问权限控制；此配置项应与车辆的实际硬件和软件资源相匹配，以确保正确的数据读取和响应速度。
              reference DcmDspPidDataDemRef [0..1]: scope=ECU, multiplicity set at link in variant link-time / pre-compile in variant post-build+pre-compile, set at link in variant link-time / pre-compile in variant post-build+pre-compile, destination=DemPidDataElement  # Reference to DemPidDataElement in DEM configuration. Allows to link the DCM PID and DEM PID configuration for Mode $02. / 概述：DcmDspPidDataDemRef配置项用于将诊断服务的参数标识符（PID）与数据元素管理（DEM）事件引用关联起来，以便在发生故障时记录和报告相关的故障码。 注意：确保每个PID正确地映射到相应的DEM事件，以保证故障诊断的准确性；DEM事件引用必须指向有效的DEM事件ID；在配置时应遵循AUTOSAR DEM模块的标准要求。
          container DcmDspPidSupportInfo [0..*]  # This container defines the support information (typically byte A) to declare the usability of the data bytes within the so-called packeted PIDs (e.g. PID$68). / 概述：DcmDspPidSupportInfo配置项用于定义诊断服务0x22（读取数据标识符）中支持的参数标识符（PID）及其相关属性，如PID的数据长度、访问权限和是否支持快速信息交换。 注意：在配置DcmDspPidSupportInfo时，需要确保PID符合ISO 14229和ISO 15031标准中定义的参数标识符；还需注意PID数据长度的正确性，以及与实际ECU支持的功能匹配；此外，配置时应考虑PID的访问权限设置，确保只有授权用户能够访问敏感或受限的数据。
            integer DcmDspPidSupportInfoLen: 0..255, scope=ECU, set at link in variant link-time / pre-compile in variant post-build+pre-compile  # Length of the support information in bytes. / 概述：DcmDspPidSupportInfoLen配置项用于定义诊断服务中支持的参数标识符（PID）的支持信息长度，即告诉诊断工具哪些PID是可用的。 注意：该配置项的值应当与实际支持的PID数量和格式相匹配；超出实际PID数量的支持信息长度可能会导致诊断工具解析错误；在AUTOSAR CP 4.4标准中，确保该配置项符合诊断通信管理器（Dcm）模块的规范要求。
            integer DcmDspPidSupportInfoPos: 0..255, scope=ECU, set at link in variant link-time / pre-compile in variant post-build+pre-compile  # Position of the support information in bytes. / 概述：DcmDspPidSupportInfoPos配置项用于定义在诊断服务中，特定PID（Parameter Identifiers）支持信息的位置，这有助于确定哪些PID是受支持的，以及它们的支持信息如何被组织和访问。 注意：在配置DcmDspPidSupportInfoPos时，必须确保其值与实际PID支持信息的存储位置相匹配；此配置项对于确保诊断服务正确识别和处理PID请求至关重要；不正确的配置可能导致诊断服务无法正确响应PID请求。
        container DcmDspReadDTCInformation [0..1]  # This container contains the configuration for the UDS service ReadDTCInformation (0x19). / 概述：DcmDspReadDTCInformation配置项用于定义诊断通信管理器（Diagnostic Communication Manager）中读取故障诊断代码（DTC）信息的参数和行为，包括支持的读取方式、过滤条件以及返回的信息内容。 注意：在配置时需确保所选的读取方式与车辆支持的诊断协议一致；对于返回信息内容的配置，需符合ISO 14229标准中定义的数据结构和格式；在多ECU系统中，应考虑DTC信息的来源和访问权限，避免数据冲突或泄露。
          container DcmDspReadDTCInformationUserDefinedFaultMemory [0..255]  # This container contains the configuration for user defined fault memories in DcmDspReadDTCInformation. / 概述：DcmDspReadDTCInformationUserDefinedFaultMemory配置项用于定义用户自定义的故障存储器，允许通过诊断服务读取特定的故障码信息。 注意：在使用此配置项时，需要确保定义的用户自定义故障存储器与AUTOSAR标准中定义的故障存储器兼容；此配置项可能需要与车辆制造商的特定诊断需求相匹配；在实现时应注意不同制造商可能有不同的实现要求和限制。
            integer DcmDspReadDTCInformationUserDefinedFaultMemoryId: 0..255, scope=ECU, set at pre-compile  # Identifier used by external tester to identify the User defined event Memory. / 概述：DcmDspReadDTCInformationUserDefinedFaultMemoryId用于定义用户自定义的故障存储器标识符，允许对特定的故障存储器进行读取故障码（DTC）操作。 注意：在配置时需确保标识符的唯一性，避免与标准故障存储器标识符冲突；AUTOSAR CP 4.4标准中未明确列出此配置项，用户需根据实际项目需求谨慎使用；在实现时应考虑与Dcm模块其他配置项的兼容性。
            integer DcmDspReadDTCInformationUserDefinedFaultMemoryRole [0..1]: 0..4294967295, scope=ECU, multiplicity set at link in variant link-time / post-build in variant post-build / pre-compile in variant pre-compile, post-build-variant-multiplicity=true, post-build-variant-value=true, set at link in variant link-time / post-build in variant post-build / pre-compile in variant pre-compile  # Bitfield were each bit represents one dedicated role. A user defined fault memory is granted access if the bit value is 1. If a bit value is 0, it is not allowed for that role. / 概述：DcmDspReadDTCInformationUserDefinedFaultMemoryRole配置项用于定义用户自定义的故障存储器角色，这将决定如何处理诊断通信管理器（Dcm）中的读取故障诊断码（DTC）信息服务。 注意：在配置用户定义的故障存储器时，需要确保它与AUTOSAR标准中定义的故障存储器类型兼容；此配置项应与Dcm的其他配置参数协同工作，以确保正确的故障码读取行为；在实现时，应注意用户定义的故障存储器角色是否满足特定项目的需求和法规要求。
        container DcmDspRequestControl [0..*]  # This container contains the configuration (parameters) of the "Request control of on-board system, test or component" service (Service $08). / 概述：DcmDspRequestControl配置项用于定义诊断服务组件（Diagnostic Communication Manager）中请求控制服务的属性，这些属性包括请求控制服务的支持情况、安全性访问级别以及会话控制等。 注意：在配置DcmDspRequestControl时，需要确保配置的安全访问级别和会话控制与实际的诊断需求相匹配；此外，AUTOSAR CP 4.4标准可能对支持的服务代码和子功能代码有特定的要求或限制，因此需要根据标准进行配置；最后，确保配置的参数与ECU支持的诊断功能一致，避免因配置错误导致诊断服务无法正常工作。 | The DCM will request the control using an R-Port requiring a PortInteface RequestControlServices_{Tid}. The R-Port is named RequestControlServices_{Tid} where {Tid} is the name of the container DcmDspRequestControl.
          integer DcmDspRequestControlInBufferSize: 0..255, scope=ECU, set at link in variant link-time / pre-compile in variant post-build+pre-compile  # Number of bytes to be provided in the input buffer of the interface RequestControlServices_{Tid} for OBD Service $08 / 概述：DcmDspRequestControlInBufferSize配置项用于定义诊断服务处理请求时，输入缓冲区的大小，这个缓冲区用于存储来自诊断测试仪的请求数据。 注意：缓冲区大小需要根据实际支持的诊断服务和数据长度来配置，以确保能够处理最大可能的请求；过小的缓冲区可能导致无法处理大的诊断请求，而过大的缓冲区可能会浪费系统资源；在AUTOSAR CP 4.4标准中，应确保该配置项与ECU的内存和处理能力相匹配。
          integer DcmDspRequestControlInfoByte [0..1]: 0..255, scope=ECU, set at link in variant link-time / pre-compile in variant post-build+pre-compile  # Manufacturer specific value reported to the tester for the record identifiers 0xE000 to OxE1FF. (WWH-OBD use cases) / 概述：DcmDspRequestControlInfoByte配置项用于定义诊断服务请求中控制信息字节的属性，这通常包括控制参数的类型和大小，用于控制ECU行为。 注意：在配置DcmDspRequestControlInfoByte时，必须确保控制参数的类型和大小符合ECU的实际需求和诊断标准；此配置项的属性应与实际的诊断请求匹配，避免诊断通信中的错误；AUTOSAR CP 4.4标准中对诊断服务的定义非常严格，因此在配置时应仔细参考相关规范文档。
          integer DcmDspRequestControlOutBufferSize: 0..255, scope=ECU, set at link in variant link-time / pre-compile in variant post-build+pre-compile  # Number of bytes to be provided in the output buffer of the interface RequestControlServices_{Tid} for OBD Service $08 / 概述：DcmDspRequestControlOutBufferSize 定义了诊断控制服务（如重置或控制ECU操作）的输出缓冲区大小，用于存储响应数据。 注意：缓冲区大小应足以容纳最大可能的响应数据；过小的缓冲区可能导致数据截断，影响诊断服务的执行；在配置时需考虑ECU的处理能力和响应时间。
          integer DcmDspRequestControlTestId: 0..255, scope=ECU, set at link in variant link-time / pre-compile in variant post-build+pre-compile  # Test Id for Service $08 / 概述：DcmDspRequestControlTestId用于定义诊断服务中请求控制操作的测试标识符，它指定了在执行控制操作时需要使用的特定测试ID。 注意：该标识符必须在Dcm配置中唯一，以确保诊断请求的正确处理；在配置时需遵循ISO 14229标准中定义的服务标识符和参数要求；AUTOSAR CP 4.4中并未对此项进行特殊的修改或限制，但实现时应确保与整体诊断策略和架构兼容。
        container DcmDspRequestFileTransfer [0..1]  # This container contains the configuration for RequestFileTransfer. / 概述：DcmDspRequestFileTransfer配置项用于定义诊断服务中请求文件传输的参数，包括文件传输的模式、内存地址、大小等信息，以支持文件的上传或下载过程。 注意：在配置时需确保文件传输请求的参数与实际应用场景相匹配，避免因参数不当导致传输失败；AUTOSAR CP 4.4标准中对文件传输服务的支持可能受限于ECU的硬件能力和网络带宽，需谨慎评估；配置应遵循安全传输原则，确保数据在传输过程中的安全性。 | This container only exists if RequestFileTransfer is configured.
          boolean DcmRequestFileTransferUsePort: scope=ECU, set at pre-compile, default-value=false  # Defines if a C/S or C function call shall be used for RequestFileTransfer processing. / 概述：DcmRequestFileTransferUsePort配置项用于定义诊断通信管理器（Diagnostic Communication Manager）中，文件传输请求的使用端口，以便在诊断会话中支持文件的上传或下载功能。 注意：该配置项需要与诊断服务的实现紧密配合，确保端口配置正确以支持预期的文件传输操作；在配置时需考虑安全性，确保数据传输过程中的数据保护；此配置项在AUTOSAR CP 4.4标准中未明确列出，用户需参考相关诊断通信服务的配置要求。
          integer DcmRequestFileTransferFileSizeOrDirInfoParameterLength: 1..4, scope=ECU, set at pre-compile, default-value=4  # Defines the length (number of bytes, i.e. the value of fileSizeOrDirInfoParameterLength) of the fileSizeUncompressedOrDirInfoLength and fileSizeCompressed in the response of RequestFileTransfer. / 概述：DcmRequestFileTransferFileSizeOrDirInfoParameterLength配置项用于定义在文件传输或目录信息请求中，文件大小或目录信息参数的长度。 注意：在配置此参数时，需要确保其长度符合实际应用中文件大小或目录信息的表示需求；长度配置应遵循相关诊断协议标准；在AUTOSAR CP 4.4标准中，应检查此参数是否与最新的诊断服务要求保持一致。
          integer DcmRequestFileTransferLengthFormatIdentifier: 1..4, scope=ECU, set at pre-compile, default-value=4  # Defines the length (number of bytes) of the maxNumberOfBlockLength parameter in the response of RequestFileTransfer. / 概述：DcmRequestFileTransferLengthFormatIdentifier用于定义在诊断通信中，文件传输请求的长度字段的格式，确保文件传输过程中长度信息的准确传递。 注意：该配置项的值应根据实际的文件传输协议和需求来设置，以确保兼容性和正确性；在AUTOSAR CP 4.4标准中，需注意与其他诊断服务的兼容性和整体诊断策略的一致性；长度格式标识符的选择直接影响到传输效率和协议的灵活性。
          integer DcmRequestFileTransferMaxFileAndDirName [0..1]: 1..65535, scope=ECU, set at pre-compile, default-value=1  # Defines the maximum size allowed for the FileAndDirName parameter with RTE interfaces used for RequestFileTransfer. / 概述：DcmRequestFileTransferMaxFileAndDirName配置项定义了在使用诊断通信管理器（Diagnostic Communication Manager）进行文件传输请求时，允许的最大文件和目录名长度。 注意：该配置项的值需要根据实际应用场景和系统资源进行合理设置，以避免因名称过长导致的内存溢出或处理失败；超出此长度的文件或目录名将导致文件传输请求被拒绝；在AUTOSAR CP 4.4标准中，确保该配置项的设置符合诊断协议要求。
        container DcmDspRoe [0..1]  # Provide the configuration of the ResponseOnEvent mechanism. / 概述：DcmDspRoe配置项用于定义诊断通信管理器（Diagnostic Communication Manager）中的响应式事件（Response On Event）功能，该功能允许在预定义的车辆事件发生时自动触发诊断响应。 注意：在配置DcmDspRoe时，必须确保与车辆的事件检测系统兼容；此功能的实现必须遵守相关的安全和隐私标准；AUTOSAR CP 4.4标准中对此功能的支持可能有特定的限制或要求，需要详细查阅标准文档。
          float DcmDspRoeInterMessageTime: 0..5, set at link in variant link-time / pre-compile in variant post-build+pre-compile  # Provide the minimum time in seconds between two transmissions of ROE event. It is used for the delay between two different consecutive Roe transmissions. / 概述：DcmDspRoeInterMessageTime配置项用于定义诊断通信中，响应输出扩展(ROE)服务之间消息的最大允许时间间隔。 注意：该时间间隔必须足够短，以确保系统能够及时响应ROE服务请求；过长的时间间隔可能导致诊断通信效率降低或超时错误；该配置项的具体值需根据系统性能和网络带宽合理设置。
          container DcmDspRoeEvent [1..255]  # This container contains a list of all supported Roe eventTypeRecords which are accepted by this ECU. / 概述：DcmDspRoeEvent配置项用于定义诊断通信管理器（Diagnostic Communication Manager）中的响应On事件（Response On Event）功能，它指定了在特定条件下触发的诊断响应事件。 注意：ROE功能需要确保ECU支持并且已经激活；在配置ROE事件时，必须确保事件的唯一性和与诊断需求的一致性；AUTOSAR CP 4.4标准中对ROE的支持可能受限于具体的ECU硬件和软件能力，需仔细核对。 | At most one DcmDspRoeEvent container is allowed to define a DcmDspRoeEventProperties container with the choice DcmDspRoeOnDTCStatusChange.
            enumeration DcmDspRoeInitialEventStatus: {DCM_ROE_CLEARED, DCM_ROE_STOPPED}, set at link in variant link-time / pre-compile in variant post-build+pre-compile, default-value=DCM_ROE_CLEARED  # Initial Roe status of this RoeEvent / 概述：DcmDspRoeInitialEventStatus配置项用于定义诊断事件在系统启动时的初始状态，这决定了诊断事件是否在系统启动后立即激活。 注意：该配置项的设置对系统的诊断响应行为有直接影响；确保与系统的安全和诊断需求相匹配；在AUTOSAR CP 4.4标准中，该配置项的属性应与系统设计文档中的要求一致，否则可能导致诊断功能不符合预期。
            integer DcmDspRoeEventId: 0..254, set at pre-compile, symbolic-name-value=true  # EventId for a global identification of this ROE event it is used within APIs Dcm_TriggerOnEvent() and the ModeDeclarationGroup. / 概述：DcmDspRoeEventId配置项用于定义诊断通信管理器（Diagnostic Communication Manager）中的响应OnEvent（ROE）功能的事件标识符，这是用于区分不同ROE事件的唯一标识。 注意：在配置DcmDspRoeEventId时，必须确保事件标识符的唯一性，以避免在诊断会话中对事件的混淆；此外，ROE事件标识符的范围和分配应符合ISO 14229标准中定义的要求；在AUTOSAR CP 4.4标准中，应当检查与ROE相关的其他配置参数，如DcmDspRoeEventLogic和DcmDspRoeEventWindowTime，以确保ROE功能的正确实现。 | The ratio Ids should be sequentially ordered beginning with 0 and no gaps in between.
            choice container DcmDspRoeEventProperties  # This container contains the properties of Roe eventTypeRecords. / 概述：DcmDspRoeEventProperties配置项定义了诊断通信管理器（Diagnostic Communication Manager）中响应On Event（ROE）服务的事件属性，包括事件类型、事件窗口时间以及事件记录的相关参数。 注意：在配置ROE事件时，需要确保事件类型与诊断需求相匹配；事件窗口时间必须设置在合理范围内，以避免对系统性能造成不利影响；此外，应当注意存储空间的分配，确保事件记录能够被正确保存和处理。 | In one DcmDspRoeEventProperties container one DcmDspRoeOnDTCStatusChange or DcmDspRoeOnChangeOfDataIdentifier container shall be defined.
              container DcmDspRoeOnChangeOfDataIdentifier [0..1]  # This container contains the eventTypeRecord supported for onChangeOfDataIdentifier eventType. / 概述：DcmDspRoeOnChangeOfDataIdentifier 用于定义诊断通信管理系统中，当数据标识符发生变化时，如何响应和执行相关的诊断服务。 注意：确保数据标识符的变化能够被正确监测和识别；配置应符合车辆制造商的诊断策略和安全要求；在实现时需考虑系统资源和响应时间的优化。
                reference DcmDspRoeDidRef: set at link in variant link-time / pre-compile in variant post-build+pre-compile, destination=DcmDspDid  # Reference to a Did which is watched. / 概述：DcmDspRoeDidRef配置项用于定义诊断通信管理器（Diagnostic Communication Manager）中，与事件相关数据标识符（DID）相关联的参考，这使得在诊断事件发生时能够报告特定的DID。 注意：在配置DcmDspRoeDidRef时，需要确保引用的DID已在诊断系统中定义并且有效；此配置项通常与诊断事件管理相关，因此需要与DcmDspRoeEvent配置项协同工作；AUTOSAR CP 4.4标准中对于诊断服务的配置有严格的规范，因此在配置时应遵循标准的要求以确保诊断服务的正确性。
              container DcmDspRoeOnDTCStatusChange [0..1]  # This container contains the eventTypeRecord supported for onDTCStatusChange eventType. / 概述：DcmDspRoeOnDTCStatusChange配置项用于定义诊断通信管理器（Diagnostic Communication Manager）中，当故障诊断码（DTC）的状态发生变化时是否启动响应式事件报告（Response On Event, ROE）功能。 注意：该配置项需要确保与车辆的故障管理策略相一致；在实现时需考虑对网络带宽和ECU处理能力的影响；AUTOSAR CP 4.4标准中，对ROE的支持和配置要求可能与早期版本有所不同，需要仔细核对标准文档。
                integer DcmDspRoeDTCStatusMask [0..1]: 0..255, set at pre-compile  # Value of the relevant DTCStatusMask / 概述：DcmDspRoeDTCStatusMask配置项用于定义诊断事件记录器（DTC）的状态掩码，这个掩码决定了哪些DTC状态变化会触发响应事件的记录。 注意：在配置DcmDspRoeDTCStatusMask时，需要确保掩码与实际应用中需要监控的DTC状态相匹配；AUTOSAR标准可能对可用的DTC状态掩码值有具体要求，需仔细参考相关文档；错误配置可能导致某些DTC状态变化未能正确触发事件记录，影响诊断准确性。
          container DcmDspRoeEventWindowTime [1..*]  # This container configures the available EventWindowTime in this Ecu. | This container contains a sub-set of EventWindowTimes supported by the Dcm, to limit the Ecu resources.
            enumeration DcmDspRoeEventWindowTime: {DCM_ROE_EVENT_WINDOW_CURRENT_AND_FOLLOWING_CYCLE, DCM_ROE_EVENT_WINDOW_CURRENT_CYCLE, DCM_ROE_EVENT_WINDOW_INFINITE}, set at pre-compile  # Value of the EventWindowTime / 概述：DcmDspRoeEventWindowTime配置项用于定义诊断事件记录功能中，响应事件触发后的时间窗口，在此时间窗口内的事件将被记录或处理。 注意：该配置项的时间单位和精度应符合项目具体要求；在配置时需考虑系统的实时性和处理能力，避免设置过长的时间窗口导致系统资源紧张；AUTOSAR CP 4.4标准中对于DcmDspRoeEventWindowTime的具体数值范围没有强制要求，但建议根据实际应用场景合理配置。
        container DcmDspRoutine [0..*]  # This container contains the configuration (parameters) for Routines / 概述：DcmDspRoutine配置项用于定义诊断服务组件中的例行控制服务，它指定了例行控制服务的属性，如例行控制操作的标识符、支持的子功能以及相关的执行条件。 注意：在配置DcmDspRoutine时，需要确保例行控制标识符的唯一性，避免与其他服务或例行控制冲突；根据AUTOSAR标准，应正确配置支持的子功能，如启动、停止、请求结果等；还需注意与实际的硬件和应用层软件的兼容性，确保例行控制操作能够正确执行。
          boolean DcmDspRoutineUsed: scope=ECU, post-build-variant-value=true, set at link in variant link-time / post-build in variant post-build / pre-compile in variant pre-compile, default-value=true  # Allow to activate or deactivate the usage of a Routine, for multi purpose ECUs / 概述：DcmDspRoutineUsed配置项用于指定诊断例程是否在诊断通信管理器（Dcm）中被使用，以支持车辆诊断服务中的特定功能。 注意：确保只有必要的诊断例程被标记为使用，以优化资源和性能；在配置时需遵循OEM的诊断策略和标准；不正确的配置可能导致诊断服务不可用或行为异常。 | True = Routine is available False = Routine is not available
          boolean DcmDspRoutineUsePort: scope=ECU, multiplicity set at pre-compile, set at pre-compile, default-value=true  # If this parameter is set to true, the DCM uses a port requiring a PortInterface RoutineServices_{RoutineName}. / 概述：DcmDspRoutineUsePort配置项用于定义诊断服务组件（Dcm）中的诊断例程是否使用端口（Port）与其他软件组件进行通信，以实现特定的诊断功能。 注意：在AUTOSAR CP 4.4中，确保当诊断例程需要与其他软件组件交互时，正确配置DcmDspRoutineUsePort为true；如果诊断例程不需要与其他组件交互，则可以将其设置为false以减少系统开销；配置时需考虑诊断例程的实际需求，避免不必要的端口通信开销。 | The R-Port is named RoutineServices_{RoutineName} where {RoutineName} is the name of the container DcmDspRoutine In that case, the configuration must not provide function names in DcmDspStartRoutineFnc, DcmDspStopRoutineFnc or DcmDspRequestResultsRoutineFnc. If this is false, the DCM expects to find the names of the functions to be used in DcmDspStartRoutineFnc, DcmDspStopRoutineFnc or DcmDspRequestResultsRoutineFnc.
          integer DcmDspRoutineIdentifier: 0..65535, scope=ECU, set at link in variant link-time / pre-compile in variant post-build+pre-compile  # 2 bytes Identifier of the RID / 概述：DcmDspRoutineIdentifier配置项用于定义诊断服务组件（Diagnostic Communication Manager）中的例程标识符，它关联了特定的诊断例程，允许对车辆的ECU执行特定的测试和操作。 注意：在配置DcmDspRoutineIdentifier时，必须确保例程标识符的唯一性，避免与其他诊断例程冲突；应当遵循OEM的诊断规范来分配例程标识符；在实施例程控制时，还需考虑例程的权限管理和安全访问要求。 | Within each DcmConfigSet all DcmDspRoutineIdentifier values shall be unique.
          integer DcmDspRoutineInfoByte [0..1]: 0..255, scope=ECU, set at link in variant link-time / pre-compile in variant post-build+pre-compile  # Manufacturer specific value reported to the tester for the record identifiers 0xE000 to OxE1FF. (OBD use cases) / 概述：DcmDspRoutineInfoByte配置项用于定义诊断例程中的信息字节，这些信息字节用于在执行诊断服务时传递额外的参数或返回状态信息。 注意：在配置DcmDspRoutineInfoByte时，需要确保信息字节的定义与实际诊断例程的要求相匹配；此配置项在AUTOSAR CP 4.4中应遵循诊断服务的标准格式和规范；配置错误可能导致诊断通信失败或信息解析错误。
          container DcmDspRequestRoutineResults [0..1]  # Provides the configuration of RequestResult subservice for RoutineControl service. / 概述：DcmDspRequestRoutineResults配置项用于定义诊断服务处理过程中，如何请求和获取诊断例程的执行结果，这是诊断通信管理（Diagnostic Communication Manager）的一部分。 注意：在配置DcmDspRequestRoutineResults时，需要确保诊断例程标识符与实际例程匹配，避免数据不一致；此配置项应与DcmDspRoutine控制选项一起考虑，以确保例程的正确执行和结果获取；AUTOSAR CP 4.4标准中，对于诊断例程结果的请求和报告方式有明确规范，需要遵守这些规范以保证诊断通信的兼容性和准确性。 | Existence indicates that the RequestRoutineResults in the RoutineControl is supported.
            boolean DcmDspRequestRoutineResultsConfirmationEnabled [0..1]: scope=ECU, multiplicity set at pre-compile, set at pre-compile, default-value=false  # Allows to enable/disable the confirmation function to indicate the transmission of a response to a RequestRoutineResults request / 概述：DcmDspRequestRoutineResultsConfirmationEnabled配置项用于启用或禁用诊断例程结果的确认，这是在执行诊断服务时，用于控制是否需要对例程结果进行确认的配置。 注意：在AUTOSAR CP 4.4标准中，确保在使用此配置项时，已经根据项目需求和诊断通信需求明确是否需要例程结果确认；此配置项的启用可能会影响诊断响应时间和网络带宽，因此需要谨慎考虑；如果项目中不需要对诊断例程结果进行确认，可以禁用此选项以优化性能。
            function name DcmDspRequestRoutineResultsConfirmationFnc [0..1]: scope=ECU, multiplicity set at pre-compile, set at pre-compile  # C-function to call if a transmission confirmation is needed by the issuer (BSW module) / 概述：DcmDspRequestRoutineResultsConfirmationFnc 是用于定义诊断服务组件中，请求例行检查结果确认的函数。 注意：该函数需要确保能处理从ECU接收到的所有可能的例行检查结果；函数实现应遵循AUTOSAR CP 4.4标准中对诊断服务的安全和时间要求；确保该函数在系统中的唯一性和正确性，避免与其他诊断服务功能冲突。
            function name DcmDspRequestRoutineResultsFnc [0..1]: scope=ECU, multiplicity set at pre-compile, set at pre-compile  # Function name for request to application the results of a routine. (Routine_RequestResults-function) / 概述：DcmDspRequestRoutineResultsFnc配置项用于定义诊断服务组件（Diagnostic Communication Manager）中，请求例行检查结果的函数名称，该函数负责获取例行诊断检查的结果数据。 注意：函数名称应遵循C语言命名规则且不应与现有系统中的其他函数名称冲突；确保该函数实现与AUTOSAR标准中定义的例行诊断结果请求服务的要求一致；在配置时，需要注意与DcmDspRequestRoutineResults的其他属性设置相匹配，以确保正确的服务响应。 | This parameter is related to the interface Xxx_RequestResults.
            integer DcmDspRequestRoutineResultsRole [0..1]: 0..4294967295, scope=ECU, multiplicity set at link in variant link-time / post-build in variant post-build / pre-compile in variant pre-compile, post-build-variant-multiplicity=true, post-build-variant-value=true, set at link in variant link-time / post-build in variant post-build / pre-compile in variant pre-compile  # Bitfield were each bit represents one dedicated role. A RoutineControl with sub-function requestResults is granted access if the bit value is 1. If a bit value is 0, the routine is not allowed for that role. / 概述：DcmDspRequestRoutineResultsRole配置项用于定义诊断服务组件（Dcm）中，特定例程请求结果的角色和权限，确保只有授权的客户端可以请求和接收诊断例程的执行结果。 注意：在配置时需确保角色与权限设置符合系统安全要求；不同的诊断例程可能需要不同的权限设置，以满足不同安全级别的需求；AUTOSAR CP 4.4标准中对于诊断服务的安全要求较高，需要特别注意权限配置的合规性。
            reference DcmDspRequestRoutineResultsCommonAuthorizationRef [0..1]: scope=ECU, multiplicity set at link in variant link-time / pre-compile in variant post-build+pre-compile, set at link in variant link-time / pre-compile in variant post-build+pre-compile, destination=DcmDspCommonAuthorization  # Reference to DcmDspCommonAuthorization / 概述：DcmDspRequestRoutineResultsCommonAuthorizationRef 是一个配置项，用于引用授权配置，该配置定义了对诊断例程结果请求的访问权限。 注意：在配置时，需要确保引用的授权配置与所需的安全级别相匹配；如果配置了不正确的授权引用，可能会导致安全访问控制不当，从而允许未授权的访问；AUTOSAR CP 4.4标准中，应当遵循相关的安全和访问控制规范来配置此项。 | Common authorization configuration taken from the referenced DcmDspRequestRoutineResultsCommonAuthorizationRef. If there is no reference, no check on the commonly defined authorization conditions shall be done to get the routine result.
            container DcmDspRequestRoutineResultsIn [0..1]  # Provide description of input parameter of RequestResult subservice for RoutineControl service. / 概述：DcmDspRequestRoutineResultsIn配置项用于定义诊断服务处理过程中，如何获取和返回例行检查的结果给请求者。 注意：在配置DcmDspRequestRoutineResultsIn时，需要确保返回的数据格式和内容符合ISO 14229标准中定义的UDS服务要求；此配置项对于实现诊断例行控制服务（如10 03服务）至关重要，需要精确配置以避免诊断通信错误；AUTOSAR CP 4.4标准中并未对此配置项的属性做出具体的限制或要求，但实现时应考虑与其他诊断服务的兼容性和一致性。
              container DcmDspRequestRoutineResultsInSignal [1..*]: requires-index=true  # Provides description of a routine signal used in RoutineControl service. / 概述：DcmDspRequestRoutineResultsInSignal配置项用于定义诊断服务组件（Dcm）中，请求例行检查结果时所使用的信号，这些信号用于从ECU获取例行检查的结果数据。 注意：在配置此项时，必须确保信号与ECU中例行检查结果的数据格式和长度相匹配；此配置项应与DcmDspRequestRoutineResults接口一致，以确保正确的数据交换；在配置过程中，还应注意信号的更新频率和访问权限，以满足实时性和安全性要求。 | The ordering defined via the index attribute of the subcontainers in this list represents the order of the dataIn_n elements in the XXX_RequestResult function call.
                enumeration DcmDspRoutineSignalEndianness [0..1]: {BIG_ENDIAN, LITTLE_ENDIAN, OPAQUE}, scope=ECU, multiplicity set at link in variant link-time / pre-compile in variant post-build+pre-compile, set at link in variant link-time / pre-compile in variant post-build+pre-compile, default-value=opaque  # Defines the endianness of the data belonging to a Routine In Signal for RequestResult subfunction.
                enumeration DcmDspRoutineSignalType: {UINT8, UINT8_N}, scope=ECU, set at link in variant link-time / pre-compile in variant post-build+pre-compile, default-value=UINT8  # Provide the type of the signal in the RoutineControl request/response.
                integer DcmDspRoutineParameterSize [0..1]: 0..65535, scope=ECU, multiplicity set at link in variant link-time / pre-compile in variant post-build+pre-compile, set at link in variant link-time / pre-compile in variant post-build+pre-compile  # Provide the size of a RoutineControl parameter in bytes
                integer DcmDspRoutineSignalPos: 0..65535, scope=ECU, set at link in variant link-time / pre-compile in variant post-build+pre-compile, default-value=0  # Provide the position of the signal in the RoutineControl request/response. | The position is defined in bits.
                choice container DcmDspArgumentScaling [0..1]  # This container contains the configuration (arguments) of an alternative Diagnosis Representation. Out if this the scaling between Diagnosis and ECU internal representation and vice versa can be calculated.
                  container DcmDspAlternativeArgumentData [0..1]  # This container contains the configuration (parameters) of an alternative Diagnosis Representation by the means of a ArgumentDataPrototype.
                    foreign reference DcmDataElement: set at pre-compile, destination-type=ARGUMENT-DATA-PROTOTYPE  # Alternative Diagnosis Representation for the data defined by the means of a ArgumentDataPrototype. | The CompuMethod of the data type of the referenced ArgumentDataPrototype will be applied to the data type of the ArgumentDataPrototype in the interface used by the Dcm.
                  container DcmDspAlternativeDataType [0..1]  # This container contains the configuration (parameters) of an alternative Diagnosis Representation by the means of an ApplicationDataType. | Additionally the definition of a text table mapping can be a defined for ApplicationDataTypes with a CompuMethod of category TEXTTABLE and SCALE_LINEAR_AND_TEXTTABLE.
                    foreign reference DcmApplicationDataType: set at pre-compile, destination-type=APPLICATION-DATA-TYPE  # Alternative Diagnosis Representation for the data defined by the means of a ApplicationDataType of category VALUE, BOOLEAN or ARRAY. | The CompuMethod that applies to the referenced ApplicationDataType in case of category VALUE or BOOLEAN will be applied to the data type of the VariableDataPrototype in the interface used by the Dcm.
                    container DcmDspTextTableMapping [0..*]  # The purpose of the DcmDspTextTableMapping is to associate a texttable value defined in the context of the Dcm to a texttable value defined in the context of a CompuMethod referenced by a DataType that shall be taken to create a dataElement in a SenderReceiverInterface. By this means it is possible to create a primitive version of a TexttableMapping (which can only be applied if a dataElement already exists). | In other words, the DcmDspTextTableMapping provides a similar mechanism to the TexttableMapping in a situation where the TexttableMapping cannot be applied since the SenderReceiverInterface for the PortPrototype on the Dcm ServiceComponent does not yet exist.
                      integer DcmDspDiagnosisRepresentationDataValue: 0..18446744073709551615, scope=ECU, set at pre-compile  # The data value in the diagnosis representation.
                      integer DcmDspInternalDataValue: 0..18446744073709551615, scope=ECU, set at pre-compile  # The ECU internal data value.
                  container DcmDspAlternativeDiagnosticDataElement [0..1]  # This container contains the configuration (parameters) of an alternative Diagnosis Representation by the means of Diagnostic Extract.
                    foreign reference DcmDspDiagnosticDataElementRef: set at pre-compile, destination-type=DIAGNOSTIC-DATA-ELEMENT  # Alternative Diagnosis Representation for the data defined by the means of a DiagnosticDataElement in the Diagnostic Extract. | This EcucForeignReference enables the access to all SwDataDefProps, in particular BaseType, CompuMethod and DataConstr The CompuMethod and DataConstr that applies to the referenced DiagnosticDataElement will be applied to the data type of the VariableDataPrototype in the interface used by the Dcm. The mapped ImplementationDataType needs to match the given BaseType.
            container DcmDspRequestRoutineResultsOut [0..1]  # Provide description of output parameter of RequestResult subservice for RoutineControl service. / 概述：DcmDspRequestRoutineResultsOut配置项用于定义诊断服务组件（Diagnostic Communication Manager）中请求例行控制结果输出的参数，这涉及到UDS服务的例行控制功能，特别是服务$31的子功能"请求结果"。 注意：在配置DcmDspRequestRoutineResultsOut时，需要确保其与例行控制操作的其他参数和设置相匹配；此配置项应与车辆制造商的诊断需求和规范一致；AUTOSAR CP 4.4标准中对于诊断服务的配置应遵循标准的数据结构和参数定义，以确保诊断通信的正确性和互操作性。
              container DcmDspRequestRoutineResultsOutSignal [1..*]: requires-index=true  # Provides description of a routine signal used in RoutineControl service. / 概述：DcmDspRequestRoutineResultsOutSignal 用于定义诊断服务中请求例程结果的输出信号，这些信号用于通知外部设备或系统例程的执行结果。 注意：确保信号与ECU的实际输出能力相匹配；在设计时考虑信号的实时性和可靠性；遵循AUTOSAR CP 4.4标准中对诊断信号的具体要求和格式。 | The ordering defined via the index attribute of the subcontainers in this list represents the order of the dataOutN elements in the XXX_RequestResult function call.
                enumeration DcmDspRoutineSignalEndianness [0..1]: {BIG_ENDIAN, LITTLE_ENDIAN, OPAQUE}, scope=ECU, multiplicity set at link in variant link-time / pre-compile in variant post-build+pre-compile, set at link in variant link-time / pre-compile in variant post-build+pre-compile, default-value=opaque  # Defines the endianness of the data belonging to a Routine Out Signal for RequestResult subfunction.
                enumeration DcmDspRoutineSignalType: {UINT8, UINT8_N}, scope=ECU, set at link in variant link-time / pre-compile in variant post-build+pre-compile, default-value=UINT8  # Provide the type of the signal in the RoutineControl request/response.
                integer DcmDspRoutineParameterSize [0..1]: 0..65535, scope=ECU, multiplicity set at link in variant link-time / pre-compile in variant post-build+pre-compile, set at link in variant link-time / pre-compile in variant post-build+pre-compile  # Provide the size of a RoutineControl parameter in bytes
                integer DcmDspRoutineSignalPos: 0..65535, scope=ECU, set at link in variant link-time / pre-compile in variant post-build+pre-compile, default-value=0  # Provide the position of the signal in the RoutineControl request/response. | The position is defined in bits.
                choice container DcmDspArgumentScaling [0..1]  # This container contains the configuration (arguments) of an alternative Diagnosis Representation. Out if this the scaling between Diagnosis and ECU internal representation and vice versa can be calculated.
                  container DcmDspAlternativeArgumentData [0..1]  # This container contains the configuration (parameters) of an alternative Diagnosis Representation by the means of a ArgumentDataPrototype.
                    foreign reference DcmDataElement: set at pre-compile, destination-type=ARGUMENT-DATA-PROTOTYPE  # Alternative Diagnosis Representation for the data defined by the means of a ArgumentDataPrototype. | The CompuMethod of the data type of the referenced ArgumentDataPrototype will be applied to the data type of the ArgumentDataPrototype in the interface used by the Dcm.
                  container DcmDspAlternativeDataType [0..1]  # This container contains the configuration (parameters) of an alternative Diagnosis Representation by the means of an ApplicationDataType. | Additionally the definition of a text table mapping can be a defined for ApplicationDataTypes with a CompuMethod of category TEXTTABLE and SCALE_LINEAR_AND_TEXTTABLE.
                    foreign reference DcmApplicationDataType: set at pre-compile, destination-type=APPLICATION-DATA-TYPE  # Alternative Diagnosis Representation for the data defined by the means of a ApplicationDataType of category VALUE, BOOLEAN or ARRAY. | The CompuMethod that applies to the referenced ApplicationDataType in case of category VALUE or BOOLEAN will be applied to the data type of the VariableDataPrototype in the interface used by the Dcm.
                    container DcmDspTextTableMapping [0..*]  # The purpose of the DcmDspTextTableMapping is to associate a texttable value defined in the context of the Dcm to a texttable value defined in the context of a CompuMethod referenced by a DataType that shall be taken to create a dataElement in a SenderReceiverInterface. By this means it is possible to create a primitive version of a TexttableMapping (which can only be applied if a dataElement already exists). | In other words, the DcmDspTextTableMapping provides a similar mechanism to the TexttableMapping in a situation where the TexttableMapping cannot be applied since the SenderReceiverInterface for the PortPrototype on the Dcm ServiceComponent does not yet exist.
                      integer DcmDspDiagnosisRepresentationDataValue: 0..18446744073709551615, scope=ECU, set at pre-compile  # The data value in the diagnosis representation.
                      integer DcmDspInternalDataValue: 0..18446744073709551615, scope=ECU, set at pre-compile  # The ECU internal data value.
                  container DcmDspAlternativeDiagnosticDataElement [0..1]  # This container contains the configuration (parameters) of an alternative Diagnosis Representation by the means of Diagnostic Extract.
                    foreign reference DcmDspDiagnosticDataElementRef: set at pre-compile, destination-type=DIAGNOSTIC-DATA-ELEMENT  # Alternative Diagnosis Representation for the data defined by the means of a DiagnosticDataElement in the Diagnostic Extract. | This EcucForeignReference enables the access to all SwDataDefProps, in particular BaseType, CompuMethod and DataConstr The CompuMethod and DataConstr that applies to the referenced DiagnosticDataElement will be applied to the data type of the VariableDataPrototype in the interface used by the Dcm. The mapped ImplementationDataType needs to match the given BaseType.
          container DcmDspStartRoutine [0..1]  # Provides the configuration of Start subservice for RoutineControl service. / 概述：DcmDspStartRoutine配置项用于定义诊断服务组件中启动例程的参数，包括例程标识符、例程选项和例程状态管理等，以支持对车辆控制单元进行诊断和配置。 注意：在配置DcmDspStartRoutine时，必须确保例程标识符的唯一性，避免与其他诊断例程冲突；根据AUTOSAR CP 4.4标准，需要正确配置例程的权限和安全访问级别，以保证只有授权的诊断会话能够启动特定例程；此外，对于支持异步执行的例程，应正确处理例程执行状态和结果报告，以避免诊断通信中的数据不一致。
            boolean DcmDspStartRoutineConfirmationEnabled [0..1]: scope=ECU, multiplicity set at pre-compile, set at pre-compile, default-value=false  # Allows to enable/disable the confirmation function to indicate the transmission of a response to a StartRoutine request / 概述：DcmDspStartRoutineConfirmationEnabled 是一个配置项，用于确定是否启用诊断服务组件（Diagnostic Service Component）中的启动例行控制操作的确认响应。 注意：在AUTOSAR CP 4.4标准中，确保此配置项与诊断例行控制需求相匹配；如果不需要确认响应，可以禁用以节省资源；正确配置此项对于满足诊断通信规范至关重要。
            function name DcmDspStartRoutineConfirmationFnc [0..1]: scope=ECU, multiplicity set at pre-compile, set at pre-compile  # C-function to call if a transmission confirmation is needed by the issuer (BSW module) / 概述：DcmDspStartRoutineConfirmationFnc配置项用于定义诊断服务组件（Diagnostics Communication Manager）中启动例程确认函数的名称，该函数用于确认启动例程是否成功执行。 注意：函数名称需要遵循C语言命名规则且不应与其他函数名冲突；确保该函数实现与AUTOSAR标准中定义的启动例程确认函数的接口一致；在配置时需注意与DcmDspStartRoutine函数的配合使用，以确保例程控制逻辑的正确性。
            function name DcmDspStartRoutineFnc [0..1]: scope=ECU, multiplicity set at pre-compile, set at pre-compile  # Function name for request to application to start a routine. (Routine_Start-function) / 概述：DcmDspStartRoutineFnc配置项用于定义诊断服务中启动例程的函数，这是在诊断会话中执行特定服务例程的入口点。 注意：确保该函数与实际的硬件或软件服务例程兼容；在配置时应遵循AUTOSAR CP 4.4的标准接口规范；在多任务环境中，注意该函数的执行时间和资源竞争问题。 | This parameter is related to the interface Xxx_Start.
            integer DcmDspStartRoutineRole [0..1]: 0..4294967295, scope=ECU, multiplicity set at link in variant link-time / post-build in variant post-build / pre-compile in variant pre-compile, post-build-variant-multiplicity=true, post-build-variant-value=true, set at link in variant link-time / post-build in variant post-build / pre-compile in variant pre-compile  # Bitfield were each bit represents one dedicated role. A RoutineControl with sub-function startRoutine is granted access if the bit value is 1. If a bit value is 0, the routine is not allowed for that role. / 概述：DcmDspStartRoutineRole配置项用于定义诊断服务组件（Diagnostic Communication Manager）中启动例程的角色，它指定了例程控制服务（RoutineControl）中启动例程的功能和行为。 注意：在AUTOSAR CP 4.4标准中，确保DcmDspStartRoutineRole的配置与例程控制请求的实际需求相匹配；例程的角色应当与实际的车辆控制策略和诊断需求一致；在配置时，应注意与其他诊断例程的角色配置不冲突，以保证诊断服务的正确执行。
            reference DcmDspStartRoutineCommonAuthorizationRef [0..1]: scope=ECU, multiplicity set at link in variant link-time / pre-compile in variant post-build+pre-compile, set at link in variant link-time / pre-compile in variant post-build+pre-compile, destination=DcmDspCommonAuthorization  # Reference to DcmDspCommonAuthorization / 概述：DcmDspStartRoutineCommonAuthorizationRef 是一个配置项，用于引用在启动诊断例程之前必须满足的授权条件，以确保只有在得到适当授权后才能执行诊断服务。 注意：在配置时，必须确保引用的授权条件已经定义在系统中；授权机制应与安全访问需求相匹配，以防止未授权的访问；在AUTOSAR CP 4.4标准中，如果该配置项的属性或使用方式与标准不一致，需要检查并更新以确保符合标准要求。 | Common authorization configuration taken from the referenced DcmDspStartRoutineCommonAuthorizationRef. If there is no reference, no check on the commonly defined authorization conditions shall be done to start the routine.
            container DcmDspStartRoutineIn [0..1]  # Provide description of input parameter of Start subservice for RoutineControl service / 概述：DcmDspStartRoutineIn配置项用于定义诊断服务中启动例行控制操作的输入参数，这些参数指定了例行控制服务（RoutineControl）的启动条件和所需数据。 注意：在配置DcmDspStartRoutineIn时，必须确保输入参数与例行控制服务的要求相匹配；参数类型和大小应符合AUTOSAR标准和具体例行控制服务的定义；在多例行控制服务中，应注意不同服务的输入参数可能会有不同的配置需求。
              container DcmDspStartRoutineInSignal [1..*]: requires-index=true  # Provide description of a routine signal used in RoutineControl service. / 概述：DcmDspStartRoutineInSignal配置项用于定义启动诊断例程时的输入信号，它指定了在启动诊断服务例程时需要传递给例程的输入参数。 注意：在配置DcmDspStartRoutineInSignal时，需要确保信号的数据类型、大小和格式与例程的输入参数要求相匹配；此配置项通常与DcmDspRoutineInfo相关联，需要保证它们之间的一致性；在配置过程中，还应注意AUTOSAR标准中对服务例程输入信号的任何特定要求或限制。 | The ordering defined via the index attribute of the subcontainers in this list represents the order of the dataInN elements in the XXX_Start function call.
                enumeration DcmDspRoutineSignalEndianness [0..1]: {BIG_ENDIAN, LITTLE_ENDIAN, OPAQUE}, scope=ECU, multiplicity set at link in variant link-time / pre-compile in variant post-build+pre-compile, set at link in variant link-time / pre-compile in variant post-build+pre-compile, default-value=opaque  # Defines the endianness of the data belonging to a Routine In Signal for Start subfunction.
                enumeration DcmDspRoutineSignalType: {UINT8, UINT8_N}, scope=ECU, set at link in variant link-time / pre-compile in variant post-build+pre-compile, default-value=UINT8  # Provide the type of the signal in the RoutineControl request/response.
                integer DcmDspRoutineParameterSize [0..1]: 0..65535, scope=ECU, multiplicity set at link in variant link-time / pre-compile in variant post-build+pre-compile, set at link in variant link-time / pre-compile in variant post-build+pre-compile  # Provide the size of a RoutineControl parameter in bytes
                integer DcmDspRoutineSignalPos: 0..65535, scope=ECU, set at link in variant link-time / pre-compile in variant post-build+pre-compile, default-value=0  # Provide the position of the signal in the RoutineControl request/response. | The position is defined in bits.
                choice container DcmDspArgumentScaling [0..1]  # This container contains the configuration (arguments) of an alternative Diagnosis Representation. Out if this the scaling between Diagnosis and ECU internal representation and vice versa can be calculated.
                  container DcmDspAlternativeArgumentData [0..1]  # This container contains the configuration (parameters) of an alternative Diagnosis Representation by the means of a ArgumentDataPrototype.
                    foreign reference DcmDataElement: set at pre-compile, destination-type=ARGUMENT-DATA-PROTOTYPE  # Alternative Diagnosis Representation for the data defined by the means of a ArgumentDataPrototype. | The CompuMethod of the data type of the referenced ArgumentDataPrototype will be applied to the data type of the ArgumentDataPrototype in the interface used by the Dcm.
                  container DcmDspAlternativeDataType [0..1]  # This container contains the configuration (parameters) of an alternative Diagnosis Representation by the means of an ApplicationDataType. | Additionally the definition of a text table mapping can be a defined for ApplicationDataTypes with a CompuMethod of category TEXTTABLE and SCALE_LINEAR_AND_TEXTTABLE.
                    foreign reference DcmApplicationDataType: set at pre-compile, destination-type=APPLICATION-DATA-TYPE  # Alternative Diagnosis Representation for the data defined by the means of a ApplicationDataType of category VALUE, BOOLEAN or ARRAY. | The CompuMethod that applies to the referenced ApplicationDataType in case of category VALUE or BOOLEAN will be applied to the data type of the VariableDataPrototype in the interface used by the Dcm.
                    container DcmDspTextTableMapping [0..*]  # The purpose of the DcmDspTextTableMapping is to associate a texttable value defined in the context of the Dcm to a texttable value defined in the context of a CompuMethod referenced by a DataType that shall be taken to create a dataElement in a SenderReceiverInterface. By this means it is possible to create a primitive version of a TexttableMapping (which can only be applied if a dataElement already exists). | In other words, the DcmDspTextTableMapping provides a similar mechanism to the TexttableMapping in a situation where the TexttableMapping cannot be applied since the SenderReceiverInterface for the PortPrototype on the Dcm ServiceComponent does not yet exist.
                      integer DcmDspDiagnosisRepresentationDataValue: 0..18446744073709551615, scope=ECU, set at pre-compile  # The data value in the diagnosis representation.
                      integer DcmDspInternalDataValue: 0..18446744073709551615, scope=ECU, set at pre-compile  # The ECU internal data value.
                  container DcmDspAlternativeDiagnosticDataElement [0..1]  # This container contains the configuration (parameters) of an alternative Diagnosis Representation by the means of Diagnostic Extract.
                    foreign reference DcmDspDiagnosticDataElementRef: set at pre-compile, destination-type=DIAGNOSTIC-DATA-ELEMENT  # Alternative Diagnosis Representation for the data defined by the means of a DiagnosticDataElement in the Diagnostic Extract. | This EcucForeignReference enables the access to all SwDataDefProps, in particular BaseType, CompuMethod and DataConstr The CompuMethod and DataConstr that applies to the referenced DiagnosticDataElement will be applied to the data type of the VariableDataPrototype in the interface used by the Dcm. The mapped ImplementationDataType needs to match the given BaseType.
            container DcmDspStartRoutineOut [0..1]  # Provide description of output parameter of Start subservice for RoutineControl service. / 概述：DcmDspStartRoutineOut配置项用于定义诊断服务中启动例程的输出参数，它指定了在执行启动例程服务（如ECU重置或激活某些操作）后返回给客户端（通常是诊断工具）的数据。 注意：在配置DcmDspStartRoutineOut时，必须确保输出参数与实际启动例程的预期输出匹配；对于不同的启动例程，可能需要配置不同的输出参数；AUTOSAR CP 4.4标准中对诊断服务的参数有详细规范，需要遵守这些规范以确保诊断服务的兼容性和正确性。
              container DcmDspStartRoutineOutSignal [1..*]: requires-index=true  # Provide description of a routine signal used in RoutineControl service. / 概述：DcmDspStartRoutineOutSignal 用于定义诊断服务中启动例程的输出信号，这些信号用于向客户端报告例程的执行结果。 注意：确保输出信号与诊断例程的实际功能和预期输出一致；在配置时需考虑信号的数据类型和范围，以确保正确的数据传输；在AUTOSAR CP 4.4中，应遵循标准的诊断信号配置规范。 | The ordering defined via the index attribute of the subcontainers in this list represents the order of the dataOutN elements in the XXX_Start function call.
                enumeration DcmDspRoutineSignalEndianness [0..1]: {BIG_ENDIAN, LITTLE_ENDIAN, OPAQUE}, scope=ECU, multiplicity set at link in variant link-time / pre-compile in variant post-build+pre-compile, set at link in variant link-time / pre-compile in variant post-build+pre-compile, default-value=opaque  # Defines the endianness of the data belonging to a Routine Out Signal for Start subfunction.
                enumeration DcmDspRoutineSignalType: {UINT8, UINT8_N}, scope=ECU, set at link in variant link-time / pre-compile in variant post-build+pre-compile, default-value=UINT8  # Provide the type of the signal in the RoutineControl request/response.
                integer DcmDspRoutineParameterSize [0..1]: 0..65535, scope=ECU, multiplicity set at link in variant link-time / pre-compile in variant post-build+pre-compile, set at link in variant link-time / pre-compile in variant post-build+pre-compile  # Provide the size of a RoutineControl parameter in bytes
                integer DcmDspRoutineSignalPos [0..1]: 0..65535, scope=ECU, multiplicity set at link in variant link-time / pre-compile in variant post-build+pre-compile, set at link in variant link-time / pre-compile in variant post-build+pre-compile, default-value=0  # Provide the position of the signal in the RoutineControl request/response. | The position is defined in bits.
                choice container DcmDspArgumentScaling [0..1]  # This container contains the configuration (arguments) of an alternative Diagnosis Representation. Out if this the scaling between Diagnosis and ECU internal representation and vice versa can be calculated.
                  container DcmDspAlternativeArgumentData [0..1]  # This container contains the configuration (parameters) of an alternative Diagnosis Representation by the means of a ArgumentDataPrototype.
                    foreign reference DcmDataElement: set at pre-compile, destination-type=ARGUMENT-DATA-PROTOTYPE  # Alternative Diagnosis Representation for the data defined by the means of a ArgumentDataPrototype. | The CompuMethod of the data type of the referenced ArgumentDataPrototype will be applied to the data type of the ArgumentDataPrototype in the interface used by the Dcm.
                  container DcmDspAlternativeDataType [0..1]  # This container contains the configuration (parameters) of an alternative Diagnosis Representation by the means of an ApplicationDataType. | Additionally the definition of a text table mapping can be a defined for ApplicationDataTypes with a CompuMethod of category TEXTTABLE and SCALE_LINEAR_AND_TEXTTABLE.
                    foreign reference DcmApplicationDataType: set at pre-compile, destination-type=APPLICATION-DATA-TYPE  # Alternative Diagnosis Representation for the data defined by the means of a ApplicationDataType of category VALUE, BOOLEAN or ARRAY. | The CompuMethod that applies to the referenced ApplicationDataType in case of category VALUE or BOOLEAN will be applied to the data type of the VariableDataPrototype in the interface used by the Dcm.
                    container DcmDspTextTableMapping [0..*]  # The purpose of the DcmDspTextTableMapping is to associate a texttable value defined in the context of the Dcm to a texttable value defined in the context of a CompuMethod referenced by a DataType that shall be taken to create a dataElement in a SenderReceiverInterface. By this means it is possible to create a primitive version of a TexttableMapping (which can only be applied if a dataElement already exists). | In other words, the DcmDspTextTableMapping provides a similar mechanism to the TexttableMapping in a situation where the TexttableMapping cannot be applied since the SenderReceiverInterface for the PortPrototype on the Dcm ServiceComponent does not yet exist.
                      integer DcmDspDiagnosisRepresentationDataValue: 0..18446744073709551615, scope=ECU, set at pre-compile  # The data value in the diagnosis representation.
                      integer DcmDspInternalDataValue: 0..18446744073709551615, scope=ECU, set at pre-compile  # The ECU internal data value.
                  container DcmDspAlternativeDiagnosticDataElement [0..1]  # This container contains the configuration (parameters) of an alternative Diagnosis Representation by the means of Diagnostic Extract.
                    foreign reference DcmDspDiagnosticDataElementRef: set at pre-compile, destination-type=DIAGNOSTIC-DATA-ELEMENT  # Alternative Diagnosis Representation for the data defined by the means of a DiagnosticDataElement in the Diagnostic Extract. | This EcucForeignReference enables the access to all SwDataDefProps, in particular BaseType, CompuMethod and DataConstr The CompuMethod and DataConstr that applies to the referenced DiagnosticDataElement will be applied to the data type of the VariableDataPrototype in the interface used by the Dcm. The mapped ImplementationDataType needs to match the given BaseType.
          container DcmDspStopRoutine [0..1]  # Provides the configuration of Stop subservice for RoutineControl service. / 概述：DcmDspStopRoutine配置项用于定义诊断服务组件（Diagnostic Communication Manager）中的停止例程服务，它指定了当接收到停止例程请求时，应该执行的函数或操作。 注意：在配置DcmDspStopRoutine时，需要确保引用的停止例程与实际的诊断需求和功能实现相匹配；还需注意与DcmDspStartRoutine和DcmDspRequestResultRoutine的配置一致性，以确保例程控制服务的完整性；此外，应考虑例程执行的权限管理，确保只有授权的诊断会话和安全访问级别可以执行停止例程。 | Existence indicates that the StopRoutine in the RoutineControl is supported.
            boolean DcmDspStopRoutineConfirmationEnabled [0..1]: scope=ECU, multiplicity set at pre-compile, set at pre-compile, default-value=false  # Allows to enable/disable the confirmation function to indicate the transmission of a response to a StopRoutine request / 概述：DcmDspStopRoutineConfirmationEnabled 是一个配置项，用于确定是否启用诊断例程（Routine）停止操作的确认响应，这通常用于确保例程被正确停止。 注意：在AUTOSAR CP 4.4标准中，此配置项应当与诊断例程的需求和实现保持一致；如果例程停止操作不需要额外的确认，可能不需要启用此选项；在配置时应考虑与客户端的交互和诊断通信流程的一致性。
            function name DcmDspStopRoutineConfirmationFnc [0..1]: scope=ECU, multiplicity set at pre-compile, set at pre-compile  # C-function to call if a transmission confirmation is needed by the issuer (BSW module) / 概述：DcmDspStopRoutineConfirmationFnc配置项用于定义诊断服务中停止例程确认函数的属性，这是在执行诊断例程停止操作后用于确认操作成功与否的函数。 注意：确保该函数能正确处理所有可能的停止例程结果，并返回适当的诊断响应码；该函数的实现必须符合AUTOSAR CP 4.4标准中对诊断服务的要求；在多核或多任务环境中，注意该函数的线程安全和重入性。
            function name DcmDspStopRoutineFnc [0..1]: scope=ECU, multiplicity set at pre-compile, set at pre-compile  # Function name for request to application to stop a routine. (Routine_Stop-function) / 概述：DcmDspStopRoutineFnc配置项用于定义诊断服务中用于停止诊断例程的函数指针，该函数在例程控制服务请求停止例程时被调用。 注意：确保所引用的函数符合AUTOSAR标准中对停止诊断例程的要求；函数需要能够安全地停止例程并返回正确的诊断响应；在配置时，应注意与DcmDspStartRoutineFnc和DcmDspRequestResultRoutineFnc的关联性和一致性。 | This parameter is related to the interface Xxx_Stop.
            integer DcmDspStopRoutineRole [0..1]: 0..4294967295, scope=ECU, multiplicity set at link in variant link-time / post-build in variant post-build / pre-compile in variant pre-compile, post-build-variant-multiplicity=true, post-build-variant-value=true, set at link in variant link-time / post-build in variant post-build / pre-compile in variant pre-compile  # Bitfield were each bit represents one dedicated role. A RoutineControl with sub-function stopRoutine is granted access if the bit value is 1. If a bit value is 0, the routine is not allowed for that role. / 概述：DcmDspStopRoutineRole配置项定义了诊断服务中停止例程的角色和行为，用于控制和管理车辆诊断过程中的特定服务例程的停止操作。 注意：在配置DcmDspStopRoutineRole时，需要确保其与例程标识符（Routine Identifier）匹配，以便正确实现停止例程的功能；此配置项在AUTOSAR CP 4.4中应遵循诊断例程管理规范，确保诊断通信管理逻辑的一致性；配置时还需考虑与其他诊断服务的交互和依赖关系，避免潜在的服务冲突。
            reference DcmDspStopRoutineCommonAuthorizationRef [0..1]: scope=ECU, multiplicity set at link in variant link-time / pre-compile in variant post-build+pre-compile, set at link in variant link-time / pre-compile in variant post-build+pre-compile, destination=DcmDspCommonAuthorization  # Reference to DcmDspCommonAuthorization / 概述：DcmDspStopRoutineCommonAuthorizationRef配置项用于引用授权方法，这些方法用于在执行诊断停止例程前验证是否有权限执行该操作。 注意：确保引用的授权方法与实际的安全需求相匹配；在配置时需注意引用的授权方法必须已在系统中定义；不正确的授权配置可能导致安全风险。 | Common authorization configuration taken from the referenced DcmDspStopRoutineCommonAuthorizationRef. If there is no reference, no check on the commonly defined authorization conditions shall be done to stop the routine.
            container DcmDspStopRoutineIn [0..1]  # Provide description of input parameter of Stop subservice for RoutineControl service. / 概述：DcmDspStopRoutineIn配置项用于定义诊断服务中停止例程的输入参数，确保正确的参数被传递以执行停止操作。 注意：输入参数应与相应的服务文档或标准一致；参数类型和长度必须正确配置以避免数据解析错误；在AUTOSAR CP 4.4中，确保该配置项的使用符合诊断通信管理器（DCM）模块的规范要求。
              container DcmDspStopRoutineInSignal [1..*]: requires-index=true  # Provide description of a routine signal used in RoutineControl service. / 概述：DcmDspStopRoutineInSignal配置项用于定义诊断服务中停止例程的信号，它指定了在执行停止例程操作时，哪些信号应当被发送给ECU以停止相应的诊断例程。 注意：在配置DcmDspStopRoutineInSignal时，必须确保信号与所需停止的诊断例程匹配且符合ECU的处理能力；此配置项对于实现诊断服务的正确性至关重要，错误的配置可能导致诊断例程无法正确停止；AUTOSAR CP 4.4标准中对于诊断例程的信号处理有明确规范，需要确保配置符合标准要求。 | The ordering defined via the index attribute of the subcontainers in this list represents the order of the dataInN elements in the XXX_Stop function call.
                enumeration DcmDspRoutineSignalEndianness [0..1]: {BIG_ENDIAN, LITTLE_ENDIAN, OPAQUE}, scope=ECU, multiplicity set at link in variant link-time / pre-compile in variant post-build+pre-compile, set at link in variant link-time / pre-compile in variant post-build+pre-compile, default-value=opaque  # Defines the endianness of the data belonging to a Routine In Signal for Stop subfunction.
                enumeration DcmDspRoutineSignalType: {UINT8, UINT8_N}, scope=ECU, set at link in variant link-time / pre-compile in variant post-build+pre-compile, default-value=UINT8  # Provide the type of the signal in the RoutineControl request/response.
                integer DcmDspRoutineParameterSize [0..1]: 0..65535, scope=ECU, multiplicity set at link in variant link-time / pre-compile in variant post-build+pre-compile, set at link in variant link-time / pre-compile in variant post-build+pre-compile  # Provide the size of a RoutineControl parameter in bytes
                integer DcmDspRoutineSignalPos: 0..65535, scope=ECU, set at link in variant link-time / pre-compile in variant post-build+pre-compile, default-value=0  # Provide the position of the signal in the RoutineControl request/response. | The position is defined in bits.
                choice container DcmDspArgumentScaling [0..1]  # This container contains the configuration (arguments) of an alternative Diagnosis Representation. Out if this the scaling between Diagnosis and ECU internal representation and vice versa can be calculated.
                  container DcmDspAlternativeArgumentData [0..1]  # This container contains the configuration (parameters) of an alternative Diagnosis Representation by the means of a ArgumentDataPrototype.
                    foreign reference DcmDataElement: set at pre-compile, destination-type=ARGUMENT-DATA-PROTOTYPE  # Alternative Diagnosis Representation for the data defined by the means of a ArgumentDataPrototype. | The CompuMethod of the data type of the referenced ArgumentDataPrototype will be applied to the data type of the ArgumentDataPrototype in the interface used by the Dcm.
                  container DcmDspAlternativeDataType [0..1]  # This container contains the configuration (parameters) of an alternative Diagnosis Representation by the means of an ApplicationDataType. | Additionally the definition of a text table mapping can be a defined for ApplicationDataTypes with a CompuMethod of category TEXTTABLE and SCALE_LINEAR_AND_TEXTTABLE.
                    foreign reference DcmApplicationDataType: set at pre-compile, destination-type=APPLICATION-DATA-TYPE  # Alternative Diagnosis Representation for the data defined by the means of a ApplicationDataType of category VALUE, BOOLEAN or ARRAY. | The CompuMethod that applies to the referenced ApplicationDataType in case of category VALUE or BOOLEAN will be applied to the data type of the VariableDataPrototype in the interface used by the Dcm.
                    container DcmDspTextTableMapping [0..*]  # The purpose of the DcmDspTextTableMapping is to associate a texttable value defined in the context of the Dcm to a texttable value defined in the context of a CompuMethod referenced by a DataType that shall be taken to create a dataElement in a SenderReceiverInterface. By this means it is possible to create a primitive version of a TexttableMapping (which can only be applied if a dataElement already exists). | In other words, the DcmDspTextTableMapping provides a similar mechanism to the TexttableMapping in a situation where the TexttableMapping cannot be applied since the SenderReceiverInterface for the PortPrototype on the Dcm ServiceComponent does not yet exist.
                      integer DcmDspDiagnosisRepresentationDataValue: 0..18446744073709551615, scope=ECU, set at pre-compile  # The data value in the diagnosis representation.
                      integer DcmDspInternalDataValue: 0..18446744073709551615, scope=ECU, set at pre-compile  # The ECU internal data value.
                  container DcmDspAlternativeDiagnosticDataElement [0..1]  # This container contains the configuration (parameters) of an alternative Diagnosis Representation by the means of Diagnostic Extract.
                    foreign reference DcmDspDiagnosticDataElementRef: set at pre-compile, destination-type=DIAGNOSTIC-DATA-ELEMENT  # Alternative Diagnosis Representation for the data defined by the means of a DiagnosticDataElement in the Diagnostic Extract. | This EcucForeignReference enables the access to all SwDataDefProps, in particular BaseType, CompuMethod and DataConstr The CompuMethod and DataConstr that applies to the referenced DiagnosticDataElement will be applied to the data type of the VariableDataPrototype in the interface used by the Dcm. The mapped ImplementationDataType needs to match the given BaseType.
            container DcmDspStopRoutineOut [0..1]  # Provide description of output parameter of Stop subservice for RoutineControl service. / 概述：DcmDspStopRoutineOut配置项用于定义诊断服务中停止例程的输出参数，这些参数用于控制和监视停止例程的执行。 注意：在配置DcmDspStopRoutineOut时，必须确保输出参数与ECU支持的停止例程相匹配；此配置项应与DcmDspStopRoutine相关配置一致，以确保正确的例程控制；在AUTOSAR CP 4.4中，确保使用正确的数据类型和长度以符合标准的要求。
              container DcmDspStopRoutineOutSignal [1..*]: requires-index=true  # Provide description of a routine signal used in RoutineControl service. / 概述：DcmDspStopRoutineOutSignal配置项用于定义诊断服务中停止例程输出信号的属性，这些属性包括信号的标识符、大小和字节顺序等。 注意：在配置DcmDspStopRoutineOutSignal时，需要确保信号的标识符与ECU中实际信号的标识符相匹配；信号大小和字节顺序必须与ECU中信号的实际定义一致；此外，应当注意该配置项与DcmDspRoutineInfoRef的关联性，确保正确的例程信号被引用。 | The ordering defined via the index attribute of the subcontainers in this list represents the order of the dataOutN elements in the XXX_Stop function call.
                enumeration DcmDspRoutineSignalEndianness [0..1]: {BIG_ENDIAN, LITTLE_ENDIAN, OPAQUE}, scope=ECU, multiplicity set at link in variant link-time / pre-compile in variant post-build+pre-compile, set at link in variant link-time / pre-compile in variant post-build+pre-compile, default-value=opaque  # Defines the endianness of the data belonging to a Routine Out Signal for Stop subfunction. / 概述：DcmDspRoutineSignalEndianness配置项用于定义诊断例程信号的字节序，确保数据在不同系统间正确交换，可以是大端（Big Endian）或小端（Little Endian）。 注意：在配置时需确保与ECU硬件架构的字节序一致；若ECU支持多字节序，则还需确保与诊断客户端的字节序匹配；在跨平台通信时特别注意字节序的一致性以避免数据解释错误。
                enumeration DcmDspRoutineSignalType: {UINT8, UINT8_N}, scope=ECU, set at link in variant link-time / pre-compile in variant post-build+pre-compile, default-value=UINT8  # Provide the type of the signal in the RoutineControl request/response. / 概述：DcmDspRoutineSignalType配置项用于定义诊断例程中信号的类型，这些信号可以是输入信号、输出信号或者输入/输出信号，用于支持诊断服务中的例程控制。 注意：在配置DcmDspRoutineSignalType时，需要确保信号类型与实际的例程参数匹配；此外，对于每个信号，还需要定义相应的数据长度和格式；在AUTOSAR CP 4.4标准中，应当遵循诊断服务的规范来配置这些信号类型。
                integer DcmDspRoutineParameterSize [0..1]: 0..65535, scope=ECU, multiplicity set at link in variant link-time / pre-compile in variant post-build+pre-compile, set at link in variant link-time / pre-compile in variant post-build+pre-compile  # Provide the size of a RoutineControl parameter in bytes / 概述：DcmDspRoutineParameterSize配置项用于定义诊断例程中参数的大小，这个参数可以是输入参数、输出参数或者输入/输出参数。 注意：在配置参数大小时，需要确保与实际诊断例程中使用的参数大小一致；超出定义大小的参数值可能会导致数据截断或者缓冲区溢出；在AUTOSAR CP 4.4标准中，应当遵循诊断服务的规范来定义参数大小。
                integer DcmDspRoutineSignalPos: 0..65535, scope=ECU, set at link in variant link-time / pre-compile in variant post-build+pre-compile, default-value=0  # Provide the position of the signal in the RoutineControl request/response. / 概述：DcmDspRoutineSignalPos配置项用于定义诊断例程中信号的位置，确保在诊断通信过程中正确解析和处理信号数据。 注意：该配置项需要与DcmDspRoutine信号定义一致，确保信号位置的正确性；在配置时需注意信号的顺序和偏移，避免数据解析错误；AUTOSAR CP 4.4标准中对于诊断信号的处理和位置有明确规范，需要遵守相关规定以保证兼容性。 | The position is defined in bits.
                choice container DcmDspArgumentScaling [0..1]  # This container contains the configuration (arguments) of an alternative Diagnosis Representation. Out if this the scaling between Diagnosis and ECU internal representation and vice versa can be calculated. / 概述：DcmDspArgumentScaling配置项用于定义诊断服务参数的缩放信息，包括缩放比例、偏移量等，以支持不同的参数表示方法和单位转换。 注意：在定义参数缩放时，需确保缩放比例和偏移量与实际物理量和ECU内部处理逻辑相匹配；缩放配置应遵循ECU支持的精度和范围限制；AUTOSAR CP 4.4标准中，此配置项的使用应结合具体的诊断服务需求和ECU能力进行详细规划。
                  container DcmDspAlternativeArgumentData [0..1]  # This container contains the configuration (parameters) of an alternative Diagnosis Representation by the means of a ArgumentDataPrototype. / 概述：DcmDspAlternativeArgumentData配置项用于定义诊断服务中备选参数数据的属性，这些备选参数数据可以在诊断请求消息中替代标准定义的参数数据。 注意：在配置备选参数数据时，需要确保它们与诊断服务请求的数据格式和长度兼容；备选参数数据应当仅在必要时使用，以避免诊断通信中的混淆；AUTOSAR CP 4.4标准中对备选参数数据的使用可能有特定的限制或要求，需要仔细参考相关文档以确保合规。
                    foreign reference DcmDataElement: set at pre-compile, destination-type=ARGUMENT-DATA-PROTOTYPE  # Alternative Diagnosis Representation for the data defined by the means of a ArgumentDataPrototype. / 概述：DcmDataElement配置项用于定义诊断服务中的数据元素，它指定了数据元素的类型、大小以及如何从车辆中读取或写入这些数据。 注意：在配置DcmDataElement时，必须确保数据元素的类型和大小与实际应用中的数据类型相匹配；对于读取或写入操作的实现，需要遵循ECU软件架构中的数据访问机制；此外，应注意数据元素的安全性和访问权限设置，以防止未授权访问。 | The CompuMethod of the data type of the referenced ArgumentDataPrototype will be applied to the data type of the ArgumentDataPrototype in the interface used by the Dcm.
                  container DcmDspAlternativeDataType [0..1]  # This container contains the configuration (parameters) of an alternative Diagnosis Representation by the means of an ApplicationDataType. / 概述：DcmDspAlternativeDataType配置项用于定义诊断服务中使用的替代数据类型，允许在不同上下文中使用不同的数据表示形式，以适应特定的数据处理需求。 注意：在定义替代数据类型时，需要确保它与原始数据类型兼容；此配置项的使用应遵循AUTOSAR标准中对数据类型替换的规定；在实际应用中，应仔细考虑替代数据类型的转换逻辑，以防止数据精度损失或解释错误。 | Additionally the definition of a text table mapping can be a defined for ApplicationDataTypes with a CompuMethod of category TEXTTABLE and SCALE_LINEAR_AND_TEXTTABLE.
                    foreign reference DcmApplicationDataType: set at pre-compile, destination-type=APPLICATION-DATA-TYPE  # Alternative Diagnosis Representation for the data defined by the means of a ApplicationDataType of category VALUE, BOOLEAN or ARRAY. / 概述：DcmApplicationDataType配置项用于定义诊断服务中使用的应用数据类型，这些数据类型是诊断通信中所需的参数或数据结构的类型。 注意：在定义DcmApplicationDataType时，需要确保数据类型与实际应用程序中使用的数据类型相匹配；此外，数据类型的定义应遵循AUTOSAR标准中规定的数据类型约束和格式；在配置过程中，还应注意数据类型的内存对齐和大小，以确保数据的正确传输和处理。 | The CompuMethod that applies to the referenced ApplicationDataType in case of category VALUE or BOOLEAN will be applied to the data type of the VariableDataPrototype in the interface used by the Dcm.
                    container DcmDspTextTableMapping [0..*]  # The purpose of the DcmDspTextTableMapping is to associate a texttable value defined in the context of the Dcm to a texttable value defined in the context of a CompuMethod referenced by a DataType that shall be taken to create a dataElement in a SenderReceiverInterface. By this means it is possible to create a primitive version of a TexttableMapping (which can only be applied if a dataElement already exists). / 概述：DcmDspTextTableMapping配置项用于定义诊断服务组件（Diagnostic Communication Manager）中，文本表的映射关系，它将特定的文本代码映射到相应的文本字符串上，以便在诊断通信中使用。 注意：在配置DcmDspTextTableMapping时，需要确保文本代码与文本字符串的映射是唯一的，避免同一代码映射到多个字符串；此外，应当注意文本字符串的长度不应超过诊断协议允许的最大长度限制；在国际化设计中，还需考虑不同语言环境下的文本映射问题。 | In other words, the DcmDspTextTableMapping provides a similar mechanism to the TexttableMapping in a situation where the TexttableMapping cannot be applied since the SenderReceiverInterface for the PortPrototype on the Dcm ServiceComponent does not yet exist.
                      integer DcmDspDiagnosisRepresentationDataValue: 0..18446744073709551615, scope=ECU, set at pre-compile  # The data value in the diagnosis representation. / 概述：DcmDspDiagnosisRepresentationDataValue 用于定义诊断服务中数据的表示方式，确保数据按照预定格式正确显示或传输。 注意：该配置项需要与诊断请求和响应格式严格匹配；在配置时需考虑数据的大小和类型，以确保数据的准确性和完整性；在AUTOSAR CP 4.4标准中，确保遵循相关的数据表示规范。
                      integer DcmDspInternalDataValue: 0..18446744073709551615, scope=ECU, set at pre-compile  # The ECU internal data value. / 概述：DcmDspInternalDataValue配置项用于定义诊断服务处理过程中，需要访问的内部数据的值，这些数据值可能用于控制策略决定或状态监测。 注意：在配置DcmDspInternalDataValue时，需要确保引用的内部数据与实际应用程序中的数据保持一致；对于敏感或安全相关的数据，应考虑访问权限和保护机制；AUTOSAR CP 4.4标准中对于诊断数据的访问和管理有详细规定，需要遵守相关规范以确保兼容性和安全性。
                  container DcmDspAlternativeDiagnosticDataElement [0..1]  # This container contains the configuration (parameters) of an alternative Diagnosis Representation by the means of Diagnostic Extract. / 概述：DcmDspAlternativeDiagnosticDataElement配置项用于定义诊断服务中备选的数据元素，这些备选元素可以在原始数据元素不可用时被使用，以支持诊断服务的灵活性和可靠性。 注意：在配置备选数据元素时，必须确保它们与原始数据元素兼容，并且满足相同的诊断需求；备选数据元素的使用可能需要根据车辆的配置或状态条件来决定；在实施时应注意备选数据元素的访问权限和安全策略，以防止未授权的访问。
                    foreign reference DcmDspDiagnosticDataElementRef: set at pre-compile, destination-type=DIAGNOSTIC-DATA-ELEMENT  # Alternative Diagnosis Representation for the data defined by the means of a DiagnosticDataElement in the Diagnostic Extract. / 概述：DcmDspDiagnosticDataElementRef 用于引用诊断数据元素，这些元素用于存储和传输诊断信息，如故障码或车辆状态信息。 注意：确保引用的数据元素与诊断服务的需求相匹配；引用的数据元素需要在Dcm配置中正确定义；在多服务或多客户端环境中，注意数据元素的访问冲突和同步问题。 | This EcucForeignReference enables the access to all SwDataDefProps, in particular BaseType, CompuMethod and DataConstr The CompuMethod and DataConstr that applies to the referenced DiagnosticDataElement will be applied to the data type of the VariableDataPrototype in the interface used by the Dcm. The mapped ImplementationDataType needs to match the given BaseType.
        container DcmDspSecurity  # This container contains the configuration ( DSP parameter) for security level configuration (per security level) / 概述：DcmDspSecurity配置项用于定义诊断通信管理器（Diagnostic Communication Manager）中安全访问的参数，包括安全访问级别、种子/密钥算法、延时时间等，以控制对敏感操作或数据的访问权限。 注意：在配置DcmDspSecurity时，需要确保安全级别与项目需求相匹配，避免设置过低的安全级别导致潜在的安全风险；种子/密钥算法应确保足够的复杂度，以防止未授权访问；AUTOSAR CP 4.4标准中对于安全延时的处理可能与早期版本有所不同，需要特别注意版本间的兼容性。 | Description This container contains Rows of DcmDspSecurityRow
          float DcmDspSecurityMaxAttemptCounterReadoutTime: 0..65535, set at link in variant link-time / pre-compile in variant post-build+pre-compile, default-value=0  # Delay, in seconds, from startup (measured from the first call of the Dcm_MainFunction()), allowed for all AttemptCounter values to be obtained from the Application. / 概述：DcmDspSecurityMaxAttemptCounterReadoutTime配置项用于定义在诊断会话中，读取安全访问尝试计数器的最大时间。 注意：该时间值应足够允许系统处理安全相关的数据，但也不应过长以避免延迟；确保设置的时间符合具体应用的安全要求；在AUTOSAR CP 4.4标准中，该配置项的具体数值应根据实际安全策略来设定，无默认值。 | Must be a multiple of the DcmTaskTime. min: A value equal to the DcmTaskTime
          container DcmDspSecurityRow [0..31]  # Definition of a single Row of configuration for security level configuration (per security level) / 概述：DcmDspSecurityRow配置项定义了诊断安全访问的安全级别和相关属性，用于控制对车辆敏感数据和功能的访问。 注意：确保每个安全级别的设置符合车辆制造商的安全要求；配置时需注意与DcmDspSecurityTable的一致性；在AUTOSAR CP 4.4标准中，安全级别的配置和管理应严格遵守标准规定，以防止未授权的访问。 | The name of this container is used to define the name of the R-Port through which the DCM accesses the interface SecurityAccess_{SecurityLevel}. The R-Port is named SecurityAccess_{SecurityLevel} where {SecurityLevel} is the name of the container DcmDspSecurityRow. If there is no reference, no check of security level shall be done.
            boolean DcmDspSecurityAttemptCounterEnabled: scope=ECU, set at link in variant link-time / pre-compile in variant post-build+pre-compile, default-value=false  # This configuration parameter controls the existence of the APIs to set / get the attempt counter values towards application (Xxx_SetSecurityAttemptCounter() / Xxx_GetSecurityAttemptCounter()). / 概述：DcmDspSecurityAttemptCounterEnabled配置项用于启用或禁用诊断通信管理器（Diagnostic Communication Manager）中安全访问服务的尝试次数计数器，该计数器用于跟踪安全访问尝试的次数。 注意：在配置此项时，需要确保它与系统的安全策略一致；如果启用了尝试次数计数器，还需要配置相应的最大尝试次数和延时策略；在不同的安全级别可能需要不同的尝试次数限制。 | In case of enabled, the security attempt counter values are passed to application, whenever there is a change in the value. This allows storing the values in nonvolatile RAM and restoring them at ECU startup.
            enumeration DcmDspSecurityUsePort: {USE_ASYNCH_CLIENT_SERVER, USE_ASYNCH_FNC}, set at pre-compile, default-value=USE_ASYNCH_CLIENT_SERVER  # Defines which kind of interface shall be used for security access. / 概述：DcmDspSecurityUsePort配置项用于定义诊断组件（Dcm）中安全服务（Security）的端口使用情况，指定安全算法和密钥管理机制如何通过端口与其他软件组件交互。 注意：在AUTOSAR CP 4.4中，确保安全服务的端口配置与实际的安全需求和实现机制相匹配；端口配置应支持所需的安全算法和密钥管理策略；不正确的端口配置可能导致安全功能不符合预期，影响系统的安全性。
            float DcmDspSecurityDelayTime: 0..65535, set at link in variant link-time / pre-compile in variant post-build+pre-compile, default-value=10  # Delay time after failed security access in seconds. / 概述：DcmDspSecurityDelayTime配置项用于定义诊断安全访问时，客户端在发送错误的安全访问请求后，需要等待的延迟时间才能再次尝试。 注意：该延迟时间用于防止恶意攻击，确保系统安全性；应根据项目的安全需求合理设置延迟时间；在AUTOSAR CP 4.4标准中，需确保该配置与安全策略和法规要求相符。 | This is started after DcmDspSecurityNumAttDelay number of failed security accesses. min: A negative value is not allowed.
            float DcmDspSecurityDelayTimeOnBoot: 0..65535, origin=AUTOSAR_ECUC V1.0.0, set at link in variant link-time / pre-compile in variant post-build+pre-compile, default-value=0  # Value of the delay timer in case of 'power on' in seconds. / 概述：DcmDspSecurityDelayTimeOnBoot配置项用于定义车辆启动后，诊断安全访问服务（Security Access Service）在允许再次尝试之前必须等待的延迟时间。 注意：该值应根据系统安全需求设定，以防止恶意攻击；在AUTOSAR CP 4.4标准中，该配置项的时间单位和最大值可能有具体要求，需要遵守这些规定；如果设置的延迟时间太长，可能会影响用户体验，因此需要在安全性和便利性之间做出平衡。 | This delay indicates the time at ECU boot power-on time during which the Dcm does not accept a security access. min: A negative value is not allowed.
            function name DcmDspSecurityCompareKeyFnc [0..1]: multiplicity set at link in variant link-time / pre-compile in variant post-build+pre-compile, set at link in variant link-time / pre-compile in variant post-build+pre-compile  # Function name to request the result of a key comparison. / 概述：DcmDspSecurityCompareKeyFnc是一个配置项，用于定义诊断安全访问时，用于比较密钥是否正确的函数。 注意：该函数需要用户实现，确保其能够正确比较从客户端接收的密钥与系统存储的密钥；在实现时需考虑安全性，避免潜在的安全漏洞；该配置项在AUTOSAR CP 4.4中应确保与安全策略和需求相一致。 | Parameter is only relevant if DcmDspSecurityUsePort=="USE_ ASYNCH_FNC". This parameter is related to the interface Xxx_CompareKey.
            function name DcmDspSecurityGetAttemptCounterFnc [0..1]: multiplicity set at link in variant link-time / pre-compile in variant post-build+pre-compile, set at link in variant link-time / pre-compile in variant post-build+pre-compile  # Function name to request the value of an attempt counter. / 概述：DcmDspSecurityGetAttemptCounterFnc配置项用于指定一个函数，该函数负责获取当前安全访问尝试次数的计数器值，通常用于防止未授权访问。 注意：该函数需要能够可靠地返回剩余的尝试次数，并且应当在多次调用间保持一致性；在实现时应确保对尝试次数的存储是安全的，以防止潜在的篡改；根据AUTOSAR CP 4.4标准，该函数的实现应遵循模块的定义和安全要求。 | This parameter is related to the interface Xxx_ GetSecurityAttemptCounter.
            function name DcmDspSecurityGetSeedFnc [0..1]: multiplicity set at link in variant link-time / pre-compile in variant post-build+pre-compile, set at link in variant link-time / pre-compile in variant post-build+pre-compile  # Callout function name used to request a seed. / 概述：DcmDspSecurityGetSeedFnc是一个配置项，用于定义在诊断通信管理（Diagnostic Communication Manager）中，当请求安全访问时，用于生成安全种子（Seed）的函数。 注意：该函数的实现必须确保生成的种子具有足够的随机性，以防止未授权访问；在AUTOSAR CP 4.4中，确保该函数与安全算法的兼容性和性能要求相匹配；考虑到响应时间和系统资源，该函数的执行效率也需优化。 | This parameter is related to the interface Xxx_GetSeed.
            function name DcmDspSecuritySetAttemptCounterFnc [0..1]: multiplicity set at link in variant link-time / pre-compile in variant post-build+pre-compile, set at link in variant link-time / pre-compile in variant post-build+pre-compile  # Function name to set the value of an attempt counter. / 概述：DcmDspSecuritySetAttemptCounterFnc配置项用于指定一个函数，该函数负责设置诊断安全访问（Security Access）服务中的尝试计数器，用于跟踪安全访问尝试的次数。 注意：在配置该函数时，需要确保它能够正确地管理尝试计数器的值，包括增加尝试次数和在成功访问后重置计数器；此外，该函数应当能够处理非易失性存储，以防止断电后尝试次数丢失；最后，确保该函数与ECU的安全策略一致，遵循AUTOSAR的安全访问规范。 | This parameter is related to the interface Xxx_ SetSecurityAttemptCounter.
            integer DcmDspSecurityADRSize [0..1]: 0..4294967295, multiplicity set at link in variant link-time / pre-compile in variant post-build+pre-compile, set at link in variant link-time / pre-compile in variant post-build+pre-compile, default-value=0  # Size in bytes of the AccessDataRecord used in GetSeed / 概述：DcmDspSecurityADRSize配置项用于定义诊断安全访问请求消息中的ADR（AccessDataRecord）字段的大小，即客户端发送给服务器的安全密钥的长度。 注意：在AUTOSAR CP 4.4标准中，安全访问的密钥长度应该与ECU支持的安全算法和密钥长度相匹配；配置的ADR大小必须能够容纳足够的数据以满足安全算法的要求；不正确的ADR大小配置可能导致安全访问功能不正常或安全漏洞。
            integer DcmDspSecurityKeySize: 1..4294967295, set at link in variant link-time / pre-compile in variant post-build+pre-compile, default-value=4  # size of the security key (in Bytes). / 概述：DcmDspSecurityKeySize配置项用于定义诊断安全访问（Security Access）服务中使用的密钥的大小，通常以字节为单位，这个参数决定了安全算法处理的密钥长度。 注意：在AUTOSAR CP 4.4标准中，密钥大小应该与实际使用的安全算法和车辆制造商的安全要求相匹配；密钥长度的选择会影响到安全性和性能，因此需要仔细考虑；如果配置的密钥大小不支持所选的安全算法，可能会导致诊断安全访问服务无法正常工作。
            integer DcmDspSecurityLevel: 0..63, set at pre-compile, symbolic-name-value=true  # Value of Security level. / 概述：DcmDspSecurityLevel配置项定义了诊断服务中的安全访问级别，用于控制对敏感操作或数据的访问权限，确保只有经过授权的用户才能执行特定的诊断服务。 注意：在配置DcmDspSecurityLevel时，必须确保安全级别的唯一性和递增性，避免安全级别之间的冲突；应根据实际应用需求合理设置安全级别，以满足系统的安全要求；AUTOSAR CP 4.4标准中对安全级别的具体数值和含义有明确规定，配置时需遵循这些规定以保证兼容性。 | The locked state cannot be configured explicitly. 1,2,3...63: configuration dependent - Conversion formula to calculate SecurityLevel out of tester requested SecurityAccessType parameter: SecurityLevel = (SecurityAccessType (requestSeed) + 1) / 2 Type: Dcm_SecLevelType
            integer DcmDspSecurityNumAttDelay [0..1]: 1..255, set at link in variant link-time / pre-compile in variant post-build+pre-compile, default-value=3  # Number of failed security accesses after which the delay time is activated / 概述：DcmDspSecurityNumAttDelay配置项用于定义在Diagnostics Communication Manager (DCM) 模块中，当安全访问请求失败达到一定次数后，需要等待的延迟时间才能再次尝试安全访问。 注意：该延迟时间用于防止恶意攻击，确保车辆的诊断安全；配置的延迟时间应符合具体应用场景的安全要求；AUTOSAR CP 4.4标准中，该配置项的使用应确保与安全策略和法规要求相一致。
            integer DcmDspSecuritySeedSize: 1..4294967295, set at link in variant link-time / pre-compile in variant post-build+pre-compile, default-value=4  # size of the security seed (in Bytes). / 概述：DcmDspSecuritySeedSize配置项定义了诊断安全服务中种子（Seed）的大小，这是用于车辆诊断安全认证过程中的关键参数。 注意：种子大小应符合车辆制造商的安全要求和标准；不正确的种子大小可能导致安全认证失败；在AUTOSAR CP 4.4中，种子大小应确保与安全算法兼容。
        container DcmDspSession  # Parent container holding single rows to configure particular sessions / 概述：DcmDspSession配置项用于定义诊断会话控制服务（Diagnostic Session Control, Service ID 0x10）中的会话类型，包括会话的名称、时间参数以及与会话相关的安全访问级别。 注意：在配置DcmDspSession时，需要确保会话类型符合ISO 14229标准中定义的会话层次结构；每个会话类型应有唯一的会话控制类型标识符；还需注意会话之间的切换条件和对应的安全访问级别，以确保诊断功能的正确性和安全性。
          container DcmDspSessionRow [0..31]  # This container holds all parameters needed to configure a single session / 概述：DcmDspSessionRow配置项定义了诊断会话控制服务（Diagnostic Session Control service）中的会话类型及其属性，用于控制诊断会话的行为和访问权限。 注意：确保每个会话类型的配置与实际应用需求相匹配，避免配置不当导致诊断功能异常；会话类型的切换应考虑到安全性和权限管理，防止未授权访问；AUTOSAR CP 4.4中对会话的管理和配置有详细规定，需要遵守相关规范以确保兼容性。
            enumeration DcmDspSessionForBoot: {DCM_NO_BOOT, DCM_OEM_BOOT}, origin=AUTOSAR_ECUC V1.0.0, set at link in variant link-time / pre-compile in variant post-build+pre-compile, default-value=DCM_NO_BOOT  # This parameter defines whether this diagnostic session allows to jump to Bootloader (OEM Bootloader or System Supplier Bootloader) and determines, from which unit the final response will be sent. / 概述：DcmDspSessionForBoot配置项用于定义诊断会话控制服务（Diagnostic Session Control service）中，用于启动引导会话的会话级别。 注意：在AUTOSAR CP 4.4标准中，确保配置的会话级别与系统支持的引导加载器会话一致；引导会话通常用于ECU编程，因此需要特别注意安全和授权机制；此配置项的使用应符合ECU的引导和编程策略。 | If this diagnostic session doesn't allow to jump to Bootloader the value DCM_NO_BOOT shall be chosen.
            float DcmDspSessionP2ServerMax: 0..1, set at link in variant link-time / pre-compile in variant post-build+pre-compile  # This is the session value for P2ServerMax in seconds (per Session). / 概述：DcmDspSessionP2ServerMax配置项定义了诊断通信控制器（Diagnostic Communication Manager）在非默认会话中等待客户端（tester）请求的最大时间（P2ServerMax时间），超过这个时间没有收到请求则会认为通信超时。 注意：该时间值应根据具体的车辆网络环境和诊断需求进行配置；超时时间设置过短可能导致正常请求被错误地判定为超时，设置过长可能影响系统的响应性能；在AUTOSAR CP 4.4标准中，该配置项的单位通常是毫秒，确保与标准一致。 | The AUTOSAR configuration standard is to use SI units, so this parameter is defined as a float value in seconds. DCM configuration tools must convert this float value to the appropriate value format for the use in the software implementation of DCM. This value is reported to the tester within the response to the 'Session Control' service.
            float DcmDspSessionP2StarServerMax: 0..100, set at link in variant link-time / pre-compile in variant post-build+pre-compile  # This is the session value for P2*ServerMax in seconds (per Session). / 概述：DcmDspSessionP2StarServerMax配置项定义了在非默认会话中，服务器最大的P2*定时器时间，即服务器在接收到请求后，最长可以等待多久来发送响应。 注意：该时间必须大于或等于DcmDspSessionP2ServerMax的值；配置值应考虑网络延迟和处理时间，以避免通信超时；在配置时需确保符合具体项目或标准的要求，避免设置过短导致通信失败。 | The AUTOSAR configuration standard is to use SI units, so this parameter is defined as a float value in seconds. DCM configuration tools must convert this float value to the appropriate value format for the use in the software implementation of DCM. This value is reported to the tester within the response to the 'Session Control' service.
            integer DcmDspSessionLevel: 1..126, set at pre-compile, symbolic-name-value=true  # subFunction value of the DiagnosticSession. / 概述：DcmDspSessionLevel配置项用于定义诊断会话控制服务（Diagnostic Session Control service）中支持的会话级别，这些级别决定了在特定会话中可以执行的诊断服务集合。 注意：在配置DcmDspSessionLevel时，需要确保定义的会话级别与ISO 14229标准中定义的会话级别相匹配；每个会话级别应该有唯一的标识符，以避免在诊断通信中的混淆；还需要注意会话级别之间的切换条件和权限，确保诊断安全性。 | 0, 127 and all values above 127 are reserved by ISO
            function name DcmDspSessionResponseMultiplePendingFnc [0..1]: multiplicity set at link in variant link-time / pre-compile in variant post-build+pre-compile, set at link in variant link-time / pre-compile in variant post-build+pre-compile  # Function name to support responsing multiple pendings of service 0x10 02. / 概述：DcmDspSessionResponseMultiplePendingFnc配置项用于指定一个函数，该函数负责0x10 02服务支持多个0x78响应的回调函数。 注意：该函数需要支持对应的协议号，在实现时应确保对协议号的使用是合法的，以防止异常的发生；根据AUTOSAR CP 4.4标准，该函数的实现应遵循模块的定义和安全要求。 | This parameter is related to the interface DspUdsDiagnosticSessionControl.
        container DcmDspVehInfo [0..*]  # This container contains the configuration (parameters) for one single VehicleInfoType of service $09 / 概述：DcmDspVehInfo配置项用于定义车辆信息服务（Vehicle Information Service）的参数，这些参数包括车辆制造商的信息、车辆型号、VIN码等，它们通常在诊断通信管理器（Diagnostic Communication Manager）模块中使用。 注意：在配置DcmDspVehInfo时，需要确保所提供的车辆信息符合相关法规和标准要求；配置的信息应当与车辆实际参数一致，以避免诊断通信中的错误；此外，应注意保护车辆信息的安全性，防止通过诊断接口泄露敏感信息。
          boolean DcmDspVehInfoNODIProvResp [0..1]: set at pre-compile, default-value=false  # Indicate the Dcm, which side is responsible to fill the number of data items (NODI), Dcm or the provider of the InfoType data. In case the responsibility is on provider side, only one DcmDspVehInfoData container is allowed. / 概述：DcmDspVehInfoNODIProvResp配置项用于定义诊断通信管理器（Diagnostic Communication Manager）在处理车辆信息请求时，如果没有可提供的数据项（NODI），应如何响应。 注意：根据AUTOSAR CP 4.4标准，必须确保在配置此项时考虑到系统的安全性和隐私要求；配置应遵循OEM的具体策略和法规要求；在设计响应策略时，应考虑到可能的网络带宽和性能影响。 | * true: Provider is responsible for providing the number of data items parameter * false or not existing: Dcm is responsible for providing the number of data items parameter
          integer DcmDspVehInfoInfoType: 0..255, scope=ECU, set at link in variant link-time / pre-compile in variant post-build+pre-compile  # value of InfoType. / 概述：DcmDspVehInfoInfoType 用于定义车辆信息服务中的信息类型，这些信息类型用于诊断通信中的车辆信息请求。 注意：在配置DcmDspVehInfoInfoType时，确保信息类型符合ISO 14229标准中定义的车辆信息服务要求；此配置项应与车辆制造商的诊断需求一致；在AUTOSAR CP 4.4中，应注意其与DcmDspVehInfo服务的兼容性和正确实现。 | Within each DcmConfigSet all DcmDspVehInfoInfoType values shall be unique.
          container DcmDspVehInfoData [1..*]  # Data Item of an InfoType; ShortName is post-fix of the port interface name. / 概述：DcmDspVehInfoData配置项用于定义车辆信息服务（Vehicle Information Service）中，特定信息类型的数据属性，如数据长度和格式，它指定了诊断服务如何读取和报告车辆的特定信息。 注意：在配置DcmDspVehInfoData时，必须确保数据长度和格式与车辆实际可提供的信息相匹配；此配置项对于实现诊断通信中的车辆信息服务至关重要，错误的配置可能导致诊断通信失败；AUTOSAR CP 4.4标准中对于诊断数据的处理和传输有严格规定，需要仔细遵守。
            boolean DcmDspVehInfoDataUsePort: scope=ECU, set at pre-compile, default-value=true  # When this parameter is set to true the DCM will access the Data using an R-Port requiring a PortInterface IInfotypeServices_{VehInfoData}. / 概述：DcmDspVehInfoDataUsePort配置项用于定义诊断服务组件（Dcm）中，车辆信息服务（Vehicle Information Service）获取数据的接口方式，指定是通过端口（Port）还是直接从内部或外部数据源读取。 注意：在AUTOSAR CP 4.4标准中，确保选择的数据接口方式与系统架构和数据源兼容；配置时需考虑数据实时性和安全性要求；若使用端口方式，需确保端口配置正确且与数据源接口匹配。 | The R-Port is named InfotypeServices_{VehInfoData} where {VEHINFODATA} is the name of the container DcmDspVehInfoData. In that case, the DcmDspVehInfoDataReadFnc is ignored and the RTE APIs are used. When this parameter is set to false, the DCM calls the function defined in DcmDspVehInfoDataReadFnc.
            function name DcmDspVehInfoDataReadFnc [0..1]: scope=ECU, multiplicity set at pre-compile, set at pre-compile  # Callout function name for reading InfoType data item. Only required in case parameter 'DcmDspVehInfoDataUsePort' is set to 'false' / 概述：DcmDspVehInfoDataReadFnc配置项用于定义诊断通信管理器（Diagnostic Communication Manager）中，读取车辆信息数据的函数。 注意：确保实现的函数符合OEM的车辆信息数据要求；函数应处理可能的错误和异常情况；在AUTOSAR CP 4.4中，该函数的接口和行为应严格遵循标准规范。
            integer DcmDspVehInfoDataOrder: 0..255, scope=ECU, set at pre-compile, default-value=0  # Defines the order of the data item in the InfoType; values: 0..255; first data item having the order number 0; the next 1 and so on. / 概述：DcmDspVehInfoDataOrder配置项用于定义车辆信息服务（Vehicle Information Service）中，请求的数据元素的返回顺序。 注意：在配置DcmDspVehInfoDataOrder时，必须确保数据元素的顺序与客户端的期望和标准文档中定义的顺序一致；如果顺序配置错误，可能会导致客户端解析数据时出现问题；AUTOSAR CP 4.4标准中对于车辆信息服务的数据顺序有明确的规定，需要遵守这些规定以保证兼容性。 | The configuration of order needs to be unique per InfoType.
            integer DcmDspVehInfoDataSize: 0..255, scope=ECU, set at pre-compile  # Size in bytes of the InfoType data item. / 概述：DcmDspVehInfoDataSize配置项用于定义车辆信息服务（Vehicle Information Service）中，每个车辆信息类型（Vehicle Information Type）的数据大小。 注意：在配置DcmDspVehInfoDataSize时，需要确保数据大小与实际车辆信息类型的数据长度一致；超出或低于实际数据长度的配置可能导致数据读取错误或内存溢出；此配置项应与车辆制造商的规范和诊断需求文档保持一致。
        container DcmDspVehicleSystemGroup [0..1]  # This container includes all Dcm related Vehicle System Groups (VSGs) / 概述：DcmDspVehicleSystemGroup配置项用于定义诊断服务组件中，与车辆系统相关的组配置信息，它允许对不同的车辆系统进行分组管理，以便在执行诊断服务时能够针对特定的系统组进行操作。 注意：在配置DcmDspVehicleSystemGroup时，需要确保每个系统组的标识符（ID）是唯一的，以避免在诊断会话中的冲突；此配置项在AUTOSAR CP 4.4标准中可能对系统组的属性有特定要求，需仔细参考标准文档以确保兼容性；在实际应用中，应根据具体的诊断需求合理划分系统组，以优化诊断效率和准确性。
          container DcmDspVehicleSystemGroupRow [1..255]  # Represents a single Vehicle System Group (VSG) related to Dcm / 概述：DcmDspVehicleSystemGroupRow配置项用于定义诊断服务组件中，车辆系统组的属性，包括系统组的标识符和对应的服务处理函数。 注意：确保每个DcmDspVehicleSystemGroupRow配置项中的系统组标识符唯一，以避免在诊断会话中的冲突；该配置项应与车辆的实际系统架构相匹配，确保诊断功能的正确实现；在配置时需考虑系统的安全性要求，避免未授权访问敏感系统组。
            integer DcmDspVehicleSystemGroupId: 1..255, set at pre-compile, symbolic-name-value=true  # Specifies an abstract ID of the corresponding Vehicle System Group. / 概述：DcmDspVehicleSystemGroupId配置项用于定义诊断通信管理器（Diagnostic Communication Manager）中，车辆系统组的唯一标识符，这有助于在执行诊断服务时区分不同的车辆系统组。 注意：在配置DcmDspVehicleSystemGroupId时，必须确保每个系统组的标识符是唯一的，以避免在诊断过程中出现标识符冲突；此外，标识符应与车辆制造商的诊断规范保持一致，以确保诊断工具能够正确识别和访问相应的系统组；在AUTOSAR CP 4.4标准中，应当遵循相关的模块配置规则和数据约束，以保证系统的兼容性和互操作性。
      container DcmPageBufferCfg  # This container contains the configuration (parameters) for Page Buffer handling / 概述：DcmPageBufferCfg是用于配置诊断通信管理器（Diagnostic Communication Manager）中分页缓冲区的属性，这些属性包括缓冲区的大小和地址，用于存储和管理诊断服务的响应数据，特别是在需要分页发送大量数据时。 注意：在配置DcmPageBufferCfg时，必须确保缓冲区大小足够存储预期的最大响应数据量；同时，缓冲区的地址应当避免与其他系统模块的内存区域冲突；根据AUTOSAR CP 4.4标准，还需要确保配置的属性与ECU的内存管理策略和硬件能力相匹配。
        boolean DcmPagedBufferEnabled: scope=ECU, set at pre-compile  # Allow to enable or disable the Paged buffer mechanism. / 概述：DcmPagedBufferEnabled 是一个配置项，用于启用或禁用诊断通信管理器（Diagnostic Communication Manager）中的分页缓冲区功能，该功能允许在发送大量诊断响应数据时进行分页处理。 注意：在AUTOSAR CP 4.4标准中，确保在需要传输大数据量的诊断服务中启用此功能；如果ECU的资源有限，需要评估开启分页缓冲区对内存和处理能力的影响；在配置时应考虑与Dcm的其他配置参数的兼容性和依赖性。 | true = Paged buffer handling enabled false = Paged Buffer handling disabled
      container DcmProcessingConditions [0..1]  # This container contains the configuration for mode arbitration functionality of the Dcm / 概述：DcmProcessingConditions配置项用于定义诊断通信管理器（Diagnostic Communication Manager）中处理不同诊断请求的条件，包括但不限于车辆速度、引擎状态等条件，以确保在适当的车辆状态下执行诊断服务。 注意：在配置DcmProcessingConditions时，必须确保所有条件与实际车辆状态检测机制相匹配，避免因条件设置不当导致诊断服务无法执行；此外，AUTOSAR CP 4.4标准中对于处理条件的具体实现和支持程度可能有所不同，需要参考具体的AUTOSAR实现文档；在多条件组合时，应注意条件之间的逻辑关系，确保逻辑判断的准确性。
        container DcmModeCondition [1..*]  # This container contains the configuration of a mode condition or an environmental conditions which can be used as argument in DcmModeRules. / 概述：DcmModeCondition配置项用于定义诊断通信管理（Diagnostic Communication Manager）中的模式条件，这些条件决定了诊断会话是否可以被激活或维持。 注意：确保DcmModeCondition与车辆的操作模式和状态兼容；在设计时需考虑所有可能的车辆状态和模式转换，以避免诊断会话在不适当的时间被激活；AUTOSAR CP 4.4标准中对于模式条件的定义和使用应严格遵守，以保证系统的安全性和可靠性。 | One DcmModeCondition shall contain either one DcmSwcModeRef or one DcmBswModeRef or one DcmSwcSRDataElementRef. Please note that the Dcm acts as well as mode manager. Therefore the references DcmSwcModeRef or one DcmBswModeRef. might point to provided ModeDeclarationGroupPrototypes of the Dcm itself as well as to provided ModeDeclarationGroupPrototypes of other Bsw Modules or software components. In case of a configured DcmSwcModeRef or DcmBswModeRef only the DcmConditionType DCM_EQUALS or DCM_EQUALS_NOT are applicable. In case of DcmSwcSRDataElementRef all literals of DcmConditionType are possible.
          enumeration DcmConditionType: {DCM_EQUALS, DCM_EQUALS_NOT}, set at pre-compile, default-value=DCM_EQUALS  # This parameter specifies what kind of comparison that is made for the evaluation of the mode condition. / 概述：DcmConditionType 用于定义诊断通信管理（Diagnostic Communication Manager）中的不同条件类型，这些条件决定了诊断会话是否可以被启动或继续。 注意：在配置DcmConditionType时，需要确保所有条件类型与系统的安全和诊断需求相匹配；此配置项应与具体的诊断需求和策略紧密相关，避免设置不恰当的条件导致诊断功能失效；AUTOSAR CP 4.4标准中对于DcmConditionType的具体实现细节有严格规定，需遵循标准指导。
          enumeration DcmProcessingConditionMode [0..1]: {E_OK, E_NOT_OK}, set at pre-compile, default-value=E_OK  # This parameter specifies what kind of comparison that is made for the evaluation of the mode condition. / 概述：DcmProcessingConditionMode配置项用于定义诊断通信管理器（Diagnostic Communication Manager）中的处理条件模式，它决定了在特定条件下，诊断请求是否被接受或拒绝。 注意：在配置DcmProcessingConditionMode时，需要确保它与系统中的安全性和诊断策略相匹配；此外，应考虑到不同诊断会话模式下的处理条件，以及与其他模块的交互可能对处理条件产生的影响；AUTOSAR CP 4.4标准中可能有具体的枚举值和参数要求，需要根据标准文档进行准确配置。
          function name DcmSwcModeRef: multiplicity set at pre-compile, set at pre-compile  # Specifies the function to be called on check mode condition. / 概述：DcmSwcModeRef配置项用于定义诊断通信管理器（Diagnostic Communication Manager）中软件组件（Software Component）的模式引用，允许软件组件根据不同的诊断模式改变其行为。 注意：在配置DcmSwcModeRef时，确保引用的模式与软件组件的实际需求相匹配；此配置项对于实现基于模式的诊断服务至关重要；在AUTOSAR CP 4.4标准中，对模式管理的支持和定义可能与早期版本有所不同，需要特别注意版本间的兼容性。
          choice reference DcmSwcSRDataElementRef [0..1]: multiplicity set at pre-compile, set at pre-compile, destination=[DcmDspExternalSRDataElementClass, DcmDspPidService01ExternalSRDataElementClass]  # Reference to environmental conditions. | It is possible to reference a S/R Receiver-Port to read physical values and compare (equal, greater, less,...) them with a configured value that is defined by DcmSwcDataElementValue.
          instance reference DcmBswModeRef [0..1]: multiplicity set at pre-compile, set at pre-compile, destination-context=MODE-DECLARATION-GROUP-PROTOTYPE, destination-type=MODE-DECLARATION  # This parameter references a mode of a ModeDeclarationGroupPrototype provided by a Basic Software Module used for the condition. | Please note that such ModeDeclarationGroupPrototype are owned by a Basic Software Module Description in the role providedModeGroup.
          reference DcmModeConditionCertificateCompareElementRef [0..1]: scope=ECU, multiplicity set at pre-compile, set at pre-compile, requires-symbolic-name-value=true, destination=KeyMCertificateElement  # Reference to a certificate data element that provides the compare value.
          choice container DcmSwcDataElementValue  # This container contains the configuration of a compare value. / 概述：DcmSwcDataElementValue配置项用于定义诊断服务中软件组件（Swc）数据元素的值，这些值可以是静态的或者通过诊断会话动态改变。 注意：在配置DcmSwcDataElementValue时，确保数据元素的类型与期望的诊断服务匹配；对于动态数据，需要实现适当的接口以在诊断会话中更新值；此配置项在AUTOSAR CP 4.4中应确保与诊断数据标识符（DID）管理和映射机制兼容。
            container DcmSwcDataElementArray [0..1]  # This container contains the configuration of a array compare value. / 概述：DcmSwcDataElementArray配置项用于定义诊断通信管理器（Diagnostic Communication Manager）中软件组件（Software Component, Swc）的数据元素数组，这些数据元素用于读取或更新车辆的诊断信息。 注意：在AUTOSAR CP 4.4标准中，需要确保数据元素的类型、大小和结构与诊断需求相匹配；数组中的数据元素应当遵循诊断服务的规范，例如UDS（统一诊断服务）；在配置数据元素数组时，应注意数据的内存映射和对齐要求，以确保诊断通信的正确性和效率。
              container DcmSwcDataElementArrayElement [0..*]  # This container contains the configuration of a array element compare value. / 概述：DcmSwcDataElementArrayElement配置项用于定义诊断通信管理器（Diagnostic Communication Manager）中软件组件数据元素的数组元素属性，这些属性包括数组元素的数据类型、大小和诊断访问权限等。 注意：在配置DcmSwcDataElementArrayElement时，需要确保数组元素的数据类型与实际软件组件中定义的类型一致；数组的大小和索引范围必须正确定义，以避免访问越界；诊断访问权限应根据安全和功能需求合理设置。
                integer DcmSwcDataElementArrayElementIndex: 0..18446744073709551615, set at pre-compile  # Index to an element of the compare value array. / 概述：DcmSwcDataElementArrayElementIndex配置项用于定义诊断服务中，软件组件数据元素数组的特定元素索引，以便于访问数组中的单个数据项。 注意：在配置时需确保索引值在数组的有效范围内；对于非数组类型的数据元素，此配置项不应使用；在AUTOSAR CP 4.4标准中，应当遵循诊断服务的数据访问规则，确保配置的一致性和正确性。
                integer DcmSwcDataElementArrayElementValue: 0..18446744073709551615, set at pre-compile  # Value of an array element compare value. / 概述：DcmSwcDataElementArrayElementValue配置项用于定义诊断通信管理器（Diagnostic Communication Manager）中，软件组件（Software Component）数据元素数组的具体元素值，它允许对数组中每个元素进行精确的值设定。 注意：在配置时需确保数组索引与实际软件组件中定义的数组大小一致，避免索引越界；该配置项的使用应符合诊断数据交换的具体需求，确保数据的准确性和有效性；在AUTOSAR CP 4.4标准中，对于诊断数据的管理和配置有详细规范，需确保配置项的使用与标准一致。
            container DcmSwcDataElementPrimitive [0..1]  # This container contains the configuration of a primitive compare value. / 概述：DcmSwcDataElementPrimitive配置项用于定义诊断通信管理器（Diagnostic Communication Manager）中，软件组件（Software Component）的基本数据元素。 注意：确保数据类型与实际应用需求一致，避免数据类型不匹配导致的运行时错误；在配置时应关注数据元素的访问权限和安全性需求；AUTOSAR CP 4.4标准中对此配置项的具体属性和使用方式有详细规定，应严格遵守。
              integer DcmSwcDataElementPrimitiveValue: 0..18446744073709551615, set at pre-compile  # Primitive compare value. / 概述：DcmSwcDataElementPrimitiveValue配置项用于定义诊断服务中，软件组件数据元素的原始值，这些值通常用于读取或设置ECU中的数据。 注意：在配置DcmSwcDataElementPrimitiveValue时，需要确保数据类型与软件组件中定义的数据类型一致；此外，还需注意数据的取值范围和精度要求，以避免在诊断通信过程中出现数据不匹配的问题；AUTOSAR CP 4.4标准中对于诊断数据元素的配置有详细的规范，需要遵循这些规范来确保诊断服务的正确性和可靠性。
        container DcmModeRule [1..*]  # This container contains the configuration of a mode rule which represents a logical expression with DcmModeConditions or other DcmModeRules as arguments. / 概述：DcmModeRule配置项用于定义诊断会话控制和安全访问等模式下，诊断服务是否可用的规则，确保在特定的诊断会话层次或安全访问级别下，只有授权的诊断服务被允许执行。 注意：在配置DcmModeRule时，需要确保规则与诊断服务的实际需求相匹配；对于每个诊断服务，都应该定义相应的模式规则，以避免在不适当的会话或安全级别下执行服务；AUTOSAR CP 4.4标准中可能对模式规则的表达方式和可用参数有具体的要求，需要遵循标准文档中的定义。 | All arguments are processed with the operator defined by DcmLogicalOperator, for instance: Argument_A AND Argument_B AND Argument_C
          enumeration DcmLogicalOperator [0..1]: {DCM_AND, DCM_OR}, multiplicity set at pre-compile, set at pre-compile, default-value=DCM_AND  # This parameter specifies the logical operator to be used in the logical expression. If the expression only consists of a single condition this parameter shall not be used. / 概述：DcmLogicalOperator 是一个配置项，用于定义诊断服务请求中多个条件之间的逻辑关系，例如“与”（AND）、“或”（OR）等，以支持复杂的服务请求条件组合。 注意：在配置DcmLogicalOperator时，确保逻辑运算符的使用与服务请求的条件逻辑相匹配；逻辑运算符的组合需要遵循AUTOSAR规范中定义的语法和语义；不当的逻辑运算符配置可能导致诊断服务无法正确执行或者产生不预期的行为。
          integer DcmModeRuleNrcValue [0..1]: 1..255, scope=ECU, multiplicity set at link in variant link-time / pre-compile in variant pre-compile, set at link in variant link-time / pre-compile in variant pre-compile  # Optional parameter which defines the NRC to be sent in case the mode rule condition is not valid. / 概述：DcmModeRuleNrcValue 用于定义在诊断通信控制模块（Dcm）中，当特定模式规则不满足时返回的负面响应代码（NRC）。 注意：确保每个模式规则关联的NRC符合ISO 14229标准中定义的错误代码；不正确的NRC设置可能导致诊断工具无法正确识别错误，影响车辆诊断过程；在配置时需考虑所有可能的模式规则和相应的诊断会话状态。
          choice reference DcmArgumentRef [1..*]: multiplicity set at pre-compile, requires-index=true, set at pre-compile, destination=[DcmModeCondition, DcmModeRule]  # This is a choice reference either to a mode condition or a an other mode rule serving as sub-expression.
    container DcmGeneral  # Contains general configuration parameters valid for the entire Dcm module. / 概述：DcmGeneral是AUTOSAR Diagnostic Communication Manager (DCM) 模块的一部分，它包含了DCM模块的通用配置参数，例如诊断会话控制、安全访问、响应时间等。 注意：在配置DcmGeneral时，需要确保所有参数与项目的诊断需求相符合；参数的设置应遵循AUTOSAR CP 4.4标准的规范；在多个ECU中实现DCM时，应保持一致性以确保网络级诊断的互操作性。
      boolean DcmDDDIDStorage [0..1]: multiplicity set at pre-compile, set at pre-compile, default-value=false  # This configuration switch defines, whether DDDID definition is stored non-volatile or not. / 概述：DcmDDDIDStorage配置项用于定义诊断动态定义数据标识符（Dynamic Defined Data Identifier，DDDID）的存储属性，包括存储位置和存储条件，确保动态定义的数据可以在车辆诊断会话中被正确存储和访问。 注意：在AUTOSAR CP 4.4标准中，需要确保DDDID的存储机制符合诊断服务的要求；存储位置应当保证数据的持久性和安全性；在设计存储策略时，应考虑到可能的内存限制和对存储介质的写入次数限制。 | true: DDDID are stored non-volatile false: DDDID are only maintained volatile
      boolean DcmDevErrorDetect: set at pre-compile, default-value=false  # Switches the development error detection and notification on or off. / 概述：DcmDevErrorDetect 是一个配置参数，用于启用或禁用诊断通信管理器（Diagnostic Communication Manager）模块内部的开发错误检测机制。 注意：在生产环境中通常禁用此功能以节省资源和提高性能；在开发和测试阶段，应启用此功能以便检测和报告潜在的错误；根据AUTOSAR CP 4.4标准，此配置项应当与系统的调试和诊断策略保持一致。 | * true: detection and notification is enabled. * false: detection and notification is disabled.
      boolean DcmRespondAllRequest: scope=ECU, set at pre-compile, default-value=false  # If set to FALSE the Dcm will not respond to diagnostic request that contains a service ID which is in the range from 0x40 to 0x7F or in the range from 0xC0 to 0xFF (Response IDs). / 概述：DcmRespondAllRequest配置项用于定义诊断通信管理器（Diagnostic Communication Manager）是否应对所有接收到的诊断请求进行响应，无论它们的来源或状态。 注意：在配置DcmRespondAllRequest时，需要考虑安全和隐私问题，确保不会因响应所有请求而暴露敏感信息或功能；此配置项在AUTOSAR CP 4.4中应谨慎使用，以避免违反任何特定的通信协议规定；确保系统资源和性能在响应所有请求时不会受到影响。
      boolean DcmVersionInfoApi: set at pre-compile, default-value=false  # Preprocessor switch to enable or disable the output Version info of the functionality. / 概述：DcmVersionInfoApi 是一个配置选项，用于启用或禁用诊断通信管理器（Diagnostic Communication Manager）中的版本信息API，允许软件组件提供其版本信息。 注意：在AUTOSAR CP 4.4标准中，确保在配置时考虑到系统的诊断需求和兼容性；不恰当的启用或禁用可能影响诊断工具的功能；版本信息API的使用应遵循项目的软件开发指南和规范。
      float DcmTaskTime: 0..Inf, set at link in variant link-time / pre-compile in variant post-build+pre-compile, default-value=0.01  # Allow to configure the time for the periodic cyclic task. Please note: This configuration value shall be equal to the value in the RTE module. / 概述：DcmTaskTime配置项定义了诊断通信管理器（Diagnostic Communication Manager）模块中任务的调用周期，即Dcm主任务的执行频率。 注意：该值必须与实际操作系统任务的调度周期相匹配；配置值过小可能导致系统过载，过大可能影响诊断响应时间；在多任务系统中，需要确保DcmTaskTime与其他任务的调度策略协调一致。 | The AUTOSAR configuration standard is to use SI units, so this parameter is defined as float value in seconds. Dcm configuration tools must convert this float value to the appropriate value format for the use in the software implementation of Dcm. min: A negative value and zero is not allowed. upperMultiplicity: Exactly one TaskTime must be specified per configuration. lowerMultiplicity: Exactly one TaskTime must be specified per configuration.
      string DcmHeaderFileInclusion [0..*]: scope=ECU, multiplicity set at pre-compile, set at pre-compile, regular-expression=[a-zA-Z0-9_]([a-zA-Z0-9\._])*  # Name of the header file(s) to be included by the Dcm module containing the used C-callback declarations. Dcm_Callout_Stubs.h is generated by default and does not need to be configured separately. / 概述：DcmHeaderFileInclusion配置项用于指定在Diagnostics Communication Manager (DCM) 模块中包含的额外头文件，这些头文件可能包含用户定义的宏、类型定义或者外部函数声明。 注意：在配置DcmHeaderFileInclusion时，确保包含的头文件与AUTOSAR标准兼容，不会引入非标准的依赖；头文件应当存在于项目的包含路径中，以避免编译错误；如果项目中使用了特定的编译器或者特殊的编译设置，需要确保这些头文件在这些环境下也能正确编译。
      reference DcmVinRef [0..1]: multiplicity set at pre-compile, set at pre-compile, destination=DcmDspDid  # Reference to the Did containing the VIN Information. / 概述：DcmVinRef配置项用于定义诊断通信管理器（Diagnostic Communication Manager）中车辆识别号（Vehicle Identification Number, VIN）的引用，确保在执行诊断服务时能够正确地访问和报告VIN信息。 注意：在配置DcmVinRef时，需要确保引用的数据元素与实际存储VIN的内存或数据结构相匹配；此外，应当注意数据元素的访问权限，以确保在诊断会话中可以被合法访问；根据AUTOSAR CP 4.4标准，还应确保VIN的格式和长度符合相关法规和标准要求。 | This parameter is needed for function Dcm_GetVin
package /AUTOSAR/EcucDestinationUriDefSets
  ecuc destination uri def set RteRipsUriDefSet
    ecuc destination uri def RteRipsInvocationHandler
      destination-uri-policy destination-uri-nesting-contract=TARGET-CONTAINER:
        container RteRipsInvocationHandlerFnc [0..*]  # This container describes an invocation handler function implemented by an RTE Implementation Plug-In to handle the invocation of server runnables and triggered runnables via a transformer. Tags: atp.Status=draft / 概述：RteRipsInvocationHandlerFnc是用于定义RTE生成代码中，如何调用RIPS（Remote Invocation Proxy Stubs）的函数，主要用于实现跨ECU的通信。 注意：该配置项需要确保与通信接口的定义一致，以保证跨ECU通信的正确性；在配置时需考虑通信的安全性和实时性要求；AUTOSAR CP 4.4标准中未明确定义此配置项，需参考具体的RTE生成工具和通信中间件的支持情况。
          function name RteRipsInvocationHandlerFncSymbol  # C-Symbol of the Rte_Rips_FillFlushRoutine function. Tags: atp.Status=draft / 概述：RteRipsInvocationHandlerFncSymbol 是用于定义RTE与软件组件间接口调用的函数符号，这个符号用于链接时解析到正确的函数实现。 注意：在配置时需要确保该符号的唯一性和正确性，以便于链接器能够正确地将符号解析到对应的函数实现；符号名称应遵循项目的命名规范，以便于代码的可读性和可维护性；在多供应商环境中，需要特别注意避免命名冲突。
    ecuc destination uri def RteRipsPlugin
      destination-uri-policy destination-uri-nesting-contract=TARGET-CONTAINER:
        container RteRipsPluginProps  # This container defines the identity of the Rte Implementation Plug-in and provides the RTE relevant parameters of the Rte Implementation Plug-in. Tags: atp.Status=draft / 概述：RteRipsPluginProps 是一个配置项，用于定义RTE生成代码时所使用的插件属性，这些属性可能会影响代码生成的特定方面，例如优化级别、代码风格或者特定编译器的支持。 注意：在配置RteRipsPluginProps时，需要确保所选插件与AUTOSAR CP 4.4标准兼容；插件的属性设置应与项目需求和编译环境相匹配；不当的插件配置可能会导致生成的代码无法满足性能要求或者无法在目标硬件上正确运行。 | The shortName of the container defines the name of the Rte Implementation Plug-in used for the API infixes.
          boolean RtePluginSupportsIReadIWrite: default-value=false  # Denotes if or if not the plug-in supports the Rte_Rips_IRead/IWrite macros for primitive data. Tags: atp.Status=draft / 概述：RtePluginSupportsIReadIWrite配置项指示RTE是否支持IRead和IWrite接口，这些接口用于简化数据元素的读写操作。 注意：在AUTOSAR CP 4.4标准中，IRead和IWrite接口的支持是可选的，因此需要根据项目需求决定是否启用；如果启用，需要确保相关代码生成插件或工具链支持这些接口；在不同的AUTOSAR版本中，对这些接口的支持可能有所不同，需要检查具体版本的兼容性。
          enumeration RteRipsGlobalCopyInstantiationPolicy: {RTE_RIPS_INSTANTIATION_BY_PLUGIN, RTE_RIPS_INSTANTIATION_BY_RTE}, default-value=RTE_RIPS_INSTANTIATION_BY_RTE  # Globally enables or disables the support for Rte Implementation Plug-Ins (RIPS) Tags: atp.Status=draft / 概述：RteRipsGlobalCopyInstantiationPolicy配置项用于定义RTE在实例化全局拷贝（Inter-Partition Communication, IPC）数据时的策略，这涉及到跨分区通信时数据一致性和内存使用的权衡。 注意：在AUTOSAR CP 4.4中，需要确保该配置与系统内存管理策略和分区间通信需求相匹配；不当的配置可能会影响系统性能和数据一致性；应根据项目具体需求和资源限制来选择合适的实例化策略。
    ecuc destination uri def RteRipsPluginFillFlushRoutine
      destination-uri-policy destination-uri-nesting-contract=TARGET-CONTAINER:
        container RteRipsPluginFillFlushRoutineFnc [0..*]  # This container describes a Fill-Flush Routine function implemented by a RTE Implementation Plug-In to handle the buffering for implicit communication. Tags: atp.Status=draft / 概述：RteRipsPluginFillFlushRoutineFnc 是一个配置项，用于指定RTE与底层硬件交互时，填充和刷新数据缓冲区的插件函数。 注意：该配置项需要与底层硬件的数据处理能力相匹配；确保插件函数的实现符合AUTOSAR CP 4.4标准的要求；在配置时应注意函数的实时性和可靠性，避免数据丢失或处理延迟。
          enumeration RteRipsModeDisablingHandling: {RTE_RIPS_CONSIDER_MODE_DISABLINGS, RTE_RIPS_IGNORE_MODE_DISABLINGS}  # This parameter configures whether mode disabling dependencies are considered for the invocation of Rte_Rips_FillFlushRoutines. Tags: atp.Status=draft / 概述：RteRipsModeDisablingHandling配置项用于定义在特定模式下，如何处理与模式相关的接口或实体的禁用。 注意：在配置此项时，必须确保与系统的模式管理策略一致；此配置项在AUTOSAR CP 4.4中应详细考虑模式切换时的资源管理和错误处理；不正确的配置可能导致系统在模式切换时出现不稳定或不预期的行为。
          enumeration RteRipsOsSchedulePoint [0..1]: {NONE, UNCONDITIONAL}  # Introduce a schedule point by explicitly calling Os Schedule service after the execution of the Rte_Rips_FillFlushRoutine. Tags: atp.Status=draft / 概述：RteRipsOsSchedulePoint配置项用于定义AUTOSAR RTE（Runtime Environment）中的调度点，这些调度点是RTE与操作系统（OS）交互的同步点，用于控制任务的执行和调度。 注意：在配置RteRipsOsSchedulePoint时，需要确保它与操作系统的任务和中断调度策略相协调；此配置项的设置应遵循系统的实时性和性能要求；在多核或多任务环境中，应特别注意调度点的配置，以避免资源竞争和优先级反转问题。
          function name RteRipsPluginFillFlushRoutineFncSymbol  # C-Symbol of the Rte_Rips_FillFlushRoutine function. Tags: atp.Status=draft / 概述：RteRipsPluginFillFlushRoutineFncSymbol配置项用于指定RTE与底层硬件交互时，填充和刷新数据的插件函数符号名称，这些函数通常用于优化数据交换过程。 注意：该配置项的值应当与实际实现的插件函数名称一致；确保所引用的函数符号在链接时可解析，否则会导致编译错误；在多核或多分区系统中，应考虑函数的可访问性和数据一致性。
package /AUTOSAR/LifeCycleInfoSets
  life cycle info set AUTOSARParameterDefinition
    life-cycle-infos:
      lc-object=AdcGroupEcucPartitionRef, lc-state=draft
      lc-object=AdcEcucPartitionRef, lc-state=draft
      lc-object=AdcKernelEcucPartitionRef, lc-state=draft
      lc-object=ArtiConstant, lc-state=draft
      lc-object=ArtiConstantString, lc-state=draft
      lc-object=ArtiExpression, lc-state=draft
      lc-object=ArtiExpressionString, lc-state=draft
      lc-object=ArtiHook, lc-state=draft
      lc-object=ArtiHookClass, lc-state=draft
      lc-object=ArtiHookEventName, lc-state=draft
      lc-object=ArtiHookInstance, lc-state=draft
      lc-object=ArtiHookEventParameterTypeRef, lc-state=draft
      lc-object=ArtiHookInstanceParameterTypeRef, lc-state=draft
      lc-object=ArtiObjectClassParameter, lc-state=draft
      lc-object=ArtiParameterTypeMapRef, lc-state=draft
      lc-object=ArtiObjectInstanceParameter, lc-state=draft
      lc-object=ArtiConstantRef, lc-state=draft
      lc-object=ArtiExpressionRef, lc-state=draft
      lc-object=ArtiHookRef, lc-state=draft
      lc-object=ArtiParameterTypeMap, lc-state=draft
      lc-object=ArtiParameterTypeMapPair, lc-state=draft
      lc-object=ArtiParameterTypeMapPairInput, lc-state=draft
      lc-object=ArtiParameterTypeMapPairOutput, lc-state=draft
      lc-object=ArtiGenericComponentClass, lc-state=draft
      lc-object=ArtiGenericComponentClassName, lc-state=draft
      lc-object=ArtiGenericComponentClassParameter, lc-state=draft
      lc-object=ArtiGenericComponentClassParameterName, lc-state=draft
      lc-object=ArtiParameterTypeMapRef, lc-state=draft
      lc-object=ArtiGenericComponentInstance, lc-state=draft
      lc-object=ArtiGenericComponentInstanceName, lc-state=draft
      lc-object=ArtiGenericComponentClassRef, lc-state=draft
      lc-object=ArtiGenericComponentInstanceParameter, lc-state=draft
      lc-object=ArtiConstantRef, lc-state=draft
      lc-object=ArtiExpressionRef, lc-state=draft
      lc-object=ArtiGenericComponentClassParameterRef, lc-state=draft
      lc-object=ArtiHookRef, lc-state=draft
      lc-object=ArtiHwCoreClass, lc-state=draft
      lc-object=ArtiCurrentApplicationClassRef, lc-state=draft
      lc-object=ArtiCurrentTaskClassRef, lc-state=draft
      lc-object=ArtiLastErrorClassRef, lc-state=draft
      lc-object=ArtiHwCoreInstance, lc-state=draft
      lc-object=ArtiCurrentApplicationInstanceRef, lc-state=draft
      lc-object=ArtiCurrentTaskInstanceRef, lc-state=draft
      lc-object=ArtiEcucCoreRef, lc-state=draft
      lc-object=ArtiLastErrorInstanceRef, lc-state=draft
      lc-object=ArtiOsClass, lc-state=draft
      lc-object=ArtiOsAppModeClassRef, lc-state=draft
      lc-object=ArtiOsInstance, lc-state=draft
      lc-object=ArtiOsAppModeEcucRef, lc-state=draft
      lc-object=ArtiOsAppModeInstanceRef, lc-state=draft
      lc-object=ArtiOsEcucRef, lc-state=draft
      lc-object=ArtiOsTaskHookRef, lc-state=draft
      lc-object=ArtiOsTaskClass, lc-state=draft
      lc-object=ArtiOsTaskInstance, lc-state=draft
      lc-object=ArtiGenericComponentInstanceRef, lc-state=draft
      lc-object=ArtiOsTaskEcucRef, lc-state=draft
      lc-object=CanControllerEcucPartitionRef, lc-state=draft
      lc-object=CanTTControllerEcucPartitionRef, lc-state=draft
      lc-object=CanEcucPartitionRef, lc-state=draft
      lc-object=CanTSynGlobalTimeSecureTmacLength, lc-state=draft
      lc-object=CanTSynTxTmacCalculated, lc-state=draft
      lc-object=CanTSynGlobalTimeMinMsgGap, lc-state=draft
      lc-object=CanTSynRxTmacValidated, lc-state=draft
      lc-object=CanTrcvChannelEcucPartitionRef, lc-state=draft
      lc-object=CanTrcvEcucPartitionRef, lc-state=draft
      lc-object=CorTstBackgroundEcucPartitionRef, lc-state=draft
      lc-object=CorTstForegroundEcucPartitionRef, lc-state=draft
      lc-object=CorTstEcucPartitionRef, lc-state=draft
      lc-object=CryptoDriverObjectEcucPartitionRef, lc-state=draft
      lc-object=CryptoEcucPartitionRef, lc-state=draft
      lc-object=DemFreezeFrameRecordTrigger, lc-state=draft
      lc-object=DioPortEcucPartitionRef, lc-state=draft
      lc-object=DioChannelEcucPartitionRef, lc-state=draft
      lc-object=DioChannelGroupEcucPartitionRef, lc-state=draft
      lc-object=DioEcucPartitionRef, lc-state=draft
      lc-object=EepEcucPartitionRef, lc-state=draft
      lc-object=EthCtrlEcucPartitionRef, lc-state=draft
      lc-object=EthEcucPartitionRef, lc-state=draft
      lc-object=EthSwtConfigEcucPartitionRef, lc-state=draft
      lc-object=EthSwtEcucPartitionRef, lc-state=draft
      lc-object=EthTSynGlobalTimeSecureTmacLength, lc-state=draft
      lc-object=EthTSynGlobalTimeMinMsgGap, lc-state=draft
      lc-object=EthTSynTxTmacCalculated, lc-state=draft
      lc-object=EthTSynRxTmacValidated, lc-state=draft
      lc-object=EthTrcvConfigEcucPartitionRef, lc-state=draft
      lc-object=EthTrcvEcucPartitionRef, lc-state=draft
      lc-object=FlsEcucPartitionRef, lc-state=draft
      lc-object=FlsTstEcucPartitionRef, lc-state=draft
      lc-object=FrEcucPartitionRef, lc-state=draft
      lc-object=FrCtrlEcucPartitionRef, lc-state=draft
      lc-object=FrTSynGlobalTimeSecureTmacLength, lc-state=draft
      lc-object=FrTSynUseExtendedMsgFormat, lc-state=draft
      lc-object=FrTSynTxTmacCalculated, lc-state=draft
      lc-object=FrTSynGlobalTimeMinMsgGap, lc-state=draft
      lc-object=FrTSynGlobalTimeTmacTimeout, lc-state=draft
      lc-object=FrTSynRxTmacValidated, lc-state=draft
      lc-object=FrTrcvChannelEcucPartitionRef, lc-state=draft
      lc-object=FrTrcvEcucPartitionRef, lc-state=draft
      lc-object=GptChannelEcucPartitionRef, lc-state=draft
      lc-object=GptEcucPartitionRef, lc-state=draft
      lc-object=GptKernelEcucPartitionRef, lc-state=draft
      lc-object=IcuChannelEcucPartitionRef, lc-state=draft
      lc-object=IcuEcucPartitionRef, lc-state=draft
      lc-object=IcuKernelEcucPartitionRef, lc-state=draft
      lc-object=IpduMContainedPduOffset, lc-state=draft
      lc-object=IpduMPduUpdateBitPosition, lc-state=draft
      lc-object=IpduMContainedPduOffset, lc-state=draft
      lc-object=IpduMPduUpdateBitPosition, lc-state=draft
      lc-object=IPDUM_HEADERTYPE_NONE, lc-state=draft
      lc-object=IPDUM_HEADERTYPE_NONE, lc-state=draft
      lc-object=IpduMUnusedAreasDefault, lc-state=draft
      lc-object=LinEcucPartitionRef, lc-state=draft
      lc-object=LinChannelEcucPartitionRef, lc-state=draft
      lc-object=LinTrcvChannelEcucPartitionRef, lc-state=draft
      lc-object=LinTrcvEcucPartitionRef, lc-state=draft
      lc-object=McuEcucPartitionRef, lc-state=draft
      lc-object=OcuChannelEcucPartitionRef, lc-state=draft
      lc-object=OcuEcucPartitionRef, lc-state=draft
      lc-object=OcuKernelEcucPartitionRef, lc-state=draft
      lc-object=PortPinEcucPartitionRef, lc-state=draft
      lc-object=PortEcucPartitionRef, lc-state=draft
      lc-object=PwmChannelEcucPartitionRef, lc-state=draft
      lc-object=PwmEcucPartitionRef, lc-state=draft
      lc-object=PwmKernelEcucPartitionRef, lc-state=draft
      lc-object=RamTstEcucPartitionRef, lc-state=draft
      lc-object=RamTstBlockParamsEcucPartitionRef, lc-state=draft
      lc-object=RteRipsFillRoutineRef, lc-state=draft
      lc-object=RteRipsFlushRoutineRef, lc-state=draft
      lc-object=RteBswExclusiveAreaResponsibleRipsPluginRef, lc-state=draft
      lc-object=RteModeMachineInstanceResponsibleRipsPluginRef, lc-state=draft
      lc-object=RteDSMQResponsibleRipsPluginRef, lc-state=draft
      lc-object=RteRips, lc-state=draft
      lc-object=RteRipsSupport, lc-state=draft
      lc-object=RteRipsPluginConfigurationRef, lc-state=draft
      lc-object=RteRipsFillRoutineRef, lc-state=draft
      lc-object=RteRipsFlushRoutineRef, lc-state=draft
      lc-object=RteRipsInvocationHandlerRef, lc-state=draft
      lc-object=RteExclusiveAreaResponsibleRipsPluginRef, lc-state=draft
      lc-object=RteModeMachineInstanceResponsibleRipsPluginRef, lc-state=draft
      lc-object=SoAdSocketTcpTlsConnectionRef, lc-state=draft
      lc-object=SpiDeviceEcucPartitionRef, lc-state=draft
      lc-object=SpiEcucPartitionRef, lc-state=draft
      lc-object=SpiKernelEcucPartitionRef, lc-state=draft
      lc-object=TcpIpTlsConfig, lc-state=draft
      lc-object=TcpIpTlsMaxConnections, lc-state=draft
      lc-object=TcpIpTlsCsmRandomGenerateJobRef, lc-state=draft
      lc-object=TcpIpTlsCiphersuites, lc-state=draft
      lc-object=TcpIpTlsCertificateIdentity, lc-state=draft
      lc-object=TcpIpTlsServerNameIdentification, lc-state=draft
      lc-object=TcpIpTlsCiphersuiteDefinition, lc-state=draft
      lc-object=TcpIpTlsCiphersuiteId, lc-state=draft
      lc-object=TcpIpTlsCiphersuiteName, lc-state=draft
      lc-object=TcpIpTlsCiphersuitePriority, lc-state=draft
      lc-object=TcpIpTlsUseAEADCipher, lc-state=draft
      lc-object=TcpIpTlsUsePresharedKeys, lc-state=draft
      lc-object=TcpIpTlsUseSecurityExtensionForceMacThenHash, lc-state=draft
      lc-object=TcpIpTlsVersion, lc-state=draft
      lc-object=TcpIpTlsCiphersuiteWorker, lc-state=draft
      lc-object=TcpIpTlsCipherAEADCipherKeyLength, lc-state=draft
      lc-object=TcpIpTlsCipherEncryptKeyLength, lc-state=draft
      lc-object=TcpIpTlsCipherMacKeyLength, lc-state=draft
      lc-object=TcpIpTlsCipherCsmDecryptJobRef, lc-state=draft
      lc-object=TcpIpTlsCipherCsmDecryptKeyRef, lc-state=draft
      lc-object=TcpIpTlsCipherCsmEncryptJobRef, lc-state=draft
      lc-object=TcpIpTlsCipherCsmEncryptKeyRef, lc-state=draft
      lc-object=TcpIpTlsCipherCsmMacGenerateJobRef, lc-state=draft
      lc-object=TcpIpTlsCipherCsmMacGenerateKeyRef, lc-state=draft
      lc-object=TcpIpTlsCipherCsmMacVerifyJobRef, lc-state=draft
      lc-object=TcpIpTlsCipherCsmMacVerifyKeyRef, lc-state=draft
      lc-object=TcpIpTlsCiphersuiteDefinitionRef, lc-state=draft
      lc-object=TcpIpTlsConnectionHandshakeRef, lc-state=draft
      lc-object=TcpIpTlsHandshake, lc-state=draft
      lc-object=TcpIpTlsCsmPRFSupportType, lc-state=draft
      lc-object=TcpIpTlsCsmHashVerifyJobRef, lc-state=draft
      lc-object=TcpIpTlsCsmKeyExchangeCalcPubValJobRef, lc-state=draft
      lc-object=TcpIpTlsCsmKeyExchangeCalcSecretJobRef, lc-state=draft
      lc-object=TcpIpTlsCsmKeyExchangeDecryptJobRef, lc-state=draft
      lc-object=TcpIpTlsCsmKeyExchangeDecryptKeyRef, lc-state=draft
      lc-object=TcpIpTlsCsmKeyExchangeEncryptJobRef, lc-state=draft
      lc-object=TcpIpTlsCsmKeyExchangeEncryptKeyRef, lc-state=draft
      lc-object=TcpIpTlsCsmKeyExchangeKeyRef, lc-state=draft
      lc-object=TcpIpTlsCsmKeyExchangeSignatureGenerateJobRef, lc-state=draft
      lc-object=TcpIpTlsCsmKeyExchangeSignatureGenerateKeyRef, lc-state=draft
      lc-object=TcpIpTlsCsmKeyExchangeSignatureVerifyJobRef, lc-state=draft
      lc-object=TcpIpTlsCsmKeyExchangeSignatureVerifyKeyRef, lc-state=draft
      lc-object=TcpIpTlsCsmMasterSecretKeyRef, lc-state=draft
      lc-object=TcpIpTlsCsmPrfMacJobRef, lc-state=draft
      lc-object=TcpIpTlsCsmPrfMacKeyRef, lc-state=draft
      lc-object=TcpIpTlsPskIdentity, lc-state=draft
      lc-object=TcpIpTlsPresharedKeyIdentity, lc-state=draft
      lc-object=TcpIpTlsPresharedKeyIdentityHint, lc-state=draft
      lc-object=TcpIpTlsPskGetClientKeyIdentityFunc, lc-state=draft
      lc-object=TcpIpTlsPskGetKeyIdentyHintFunc, lc-state=draft
      lc-object=TcpIpTlsPskGetServerKeyIdentityFunc, lc-state=draft
      lc-object=TcpIpTlsPresharedKeyCsmKeyRef, lc-state=draft
      lc-object=TcpIpTlsConnection, lc-state=draft
      lc-object=TcpIpTlsConnectionGetTimeFunc, lc-state=draft
      lc-object=TcpIpTlsConnectionId, lc-state=draft
      lc-object=TcpIpTlsConnectionType, lc-state=draft
      lc-object=TcpIpTlsMaxFragmentLength, lc-state=draft
      lc-object=TcpIpTlsPortAssignment, lc-state=draft
      lc-object=TcpIpTlsUseClientAuthenticationRequest, lc-state=draft
      lc-object=TcpIpTlsUseSecurityExtensionRecordSizeLimit, lc-state=draft
      lc-object=TcpIpTlsCertificateIdentityRef, lc-state=draft
      lc-object=TcpIpTlsConnectionCiphersuiteWorkerRef, lc-state=draft
      lc-object=TcpIpTlsConnectionGroupRef, lc-state=draft
      lc-object=TcpIpTlsConnectionPskIdentityRef, lc-state=draft
      lc-object=TcpIpTlsIpAddressAssignment, lc-state=draft
      lc-object=TcpIpTlsConnectionGroup, lc-state=draft
      lc-object=WEthCtrlEcucPartitionRef, lc-state=draft
      lc-object=WEthEcucPartitionRef, lc-state=draft
      lc-object=WEthTrcvConfigEcucPartitionRef, lc-state=draft
      lc-object=WEthTrcvEcucPartitionRef, lc-state=draft
      lc-object=WdgEcucPartitionRef, lc-state=draft
