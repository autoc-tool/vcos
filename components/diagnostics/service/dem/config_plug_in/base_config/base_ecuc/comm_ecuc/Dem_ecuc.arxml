AUTOSAR XML (schema 00046)
package /ActiveEcuC
  module config Dem: implementation-config-variant=VARIANT-PRE-COMPILE
    DemGeneral:
      DemAgingRequiresNotFailedCycle = false
      DemAgingRequiresTestedCycle = false
      DemDebounceCounterBasedSupport = false
      DemDebounceTimeBasedSupport = false
      DemDevErrorDetect = false
      DemGeneralInterfaceSupport = false
      DemPTOSupport = false
      DemResetConfirmedBitOnOverflow = true
      DemStatusBitStorageTestFailed = false
      DemTriggerFiMReports = false
      DemTriggerMonitorInitBeforeClearOk = false
      DemVersionInfoApi = false
      DemTaskTime = 0.01
      DemBswErrorBufferSize = 0
      DemMaxNumberEventEntryEventBuffer = 1
      DemMaxNumberPrestoredFF = 0
      DemAvailabilitySupport = DEM_NO_AVAILABILITY
      DemClearDTCBehavior = DEM_CLRRESP_NONVOLATILE_FINISH
      DemClearDTCLimitation = DEM_ALL_SUPPORTED_DTCS
      DemDataElementDefaultEndianness = BIG_ENDIAN
      DemEventCombinationSupport = DEM_EVCOMB_DISABLED
      DemOBDSupport = DEM_OBD_NO_OBD_SUPPORT
      DemStatusBitHandlingTestFailedSinceLastClear = DEM_STATUS_BIT_NORMAL
      DemSuppressionSupport = DEM_DTC_SUPPRESSION
      DemGeneralCallbackMonitorStatusChangedFnc = 
    DemConfigSet
