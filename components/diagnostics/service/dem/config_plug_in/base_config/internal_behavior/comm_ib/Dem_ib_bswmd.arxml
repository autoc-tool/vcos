AUTOSAR XML (schema 00048)
package /AUTOSAR/Dem_ib_bswmd/BswModuleDescriptions
  bsw module description Dem: provided-entrys=Dem_MainFunction
    bsw internal behavior DemBehavior
      5 x exclusive area:
        DEM_EXCLUSIVE_AREA_0  # (DiagMonitor) Ensures consistency and atomicity of event reports
        DEM_EXCLUSIVE_AREA_1  # (StateManager) Ensures consistent status updates when receiving ECU states managed outside the Dem
        DEM_EXCLUSIVE_AREA_2  # (DcmAPI) Ensures consistent status updates when receiving ECU states managed outside the Dem
        DEM_EXCLUSIVE_AREA_3  # (CrossCoreComm) Ensures consistent prestorage when called from multiple clients. Ensures data consistency between satellites and master if the platform does not provide a specific compareAndSwap instruction
        DEM_EXCLUSIVE_AREA_4  # (NonAtomic32bit) Ensures consistency if the platform does not provide an atomic 32bit access
      bsw schedulable entity Dem_MainFunction: implemented-entry=Dem_MainFunction
      bsw timing event Dem_MainFunctionTimingEvent0: starts-on-event=Dem_MainFunction, period=0.01
  bsw module entry Dem_MainFunction: call-type=SCHEDULED, execution-context=TASK
