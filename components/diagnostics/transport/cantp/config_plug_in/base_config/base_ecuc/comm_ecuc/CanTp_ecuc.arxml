AUTOSAR XML (schema 00046)
package /ActiveEcuC
  module config CanTp: implementation-config-variant=VARIANT-PRE-COMPILE
    CanTpConfig
    CanTpGeneral:
      CanTpChangeParameterApi = false
      CanTpDevErrorDetect = false
      CanTpDynIdSupport = false
      CanTpFlexibleDataRateSupport = false
      CanTpGenericConnectionSupport = false
      CanTpReadParameterApi = false
      CanTpVersionInfoApi = false
      CanTpPaddingByte = 85
      CanTpEnableSynchronousTransmit = true
