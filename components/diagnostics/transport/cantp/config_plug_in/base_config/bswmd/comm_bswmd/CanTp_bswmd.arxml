AUTOSAR XML (schema 00046)
package /AUTOSAR/EcucDefs
  module definition CanTp [0..1]: post-build-variant-support=true, variants post-build/pre-compile  # Configuration of the CanTp (CAN Transport Protocol) module. / 概述：CanTp 是 AUTOSAR Communication Stack 的一部分，负责实现基于 ISO 15765-2 的 CAN 传输层协议，它支持长消息的分割和重组，确保在CAN通信时I-PDU的数据长度不大于8个字节，在CAN FD通信时I-PDU的数据不大于64个字节。 注意：在配置 CanTp 模块时，需要确保正确设置网络层的参数，如N-PDU、定时参数和流控制策略；CanTp 配置应与 CanIf 和 PduR 的配置相匹配，以确保数据可正确传输。
    container CanTpConfig  # This container contains the configuration parameters and sub containers of the AUTOSAR CanTp module. / 概述：CanTpConfig是用于配置CAN传输层（CAN Transport Layer）的参数，该配置项下包含CanTpMainFunctionPeriod和CanTpChannel。 在配置CanTpConfig下面的CanTpChannel时，此配置项下可根据需求添加若干连接通道（CanTpChannel），在静态配置下，每个连接通道会对应一个或一对SDU，SDU可为接收方向与发送方向；因此，CanTpChannel下有两种子容器，分别为CanTpRxNSdu和CanTpTxNSdu。
      container CanTpMainFunction [1..255]: multiplicity set at pre-compile, post-build-variant-multiplicity=true  # Contains the configuration parameters of the AUTOSAR CanTp module's CanTpMainFunction. / 概述：CanSMMainFunction是一个配置项，用于定义CAN网络管理（CANSM）中的主函数，这些主函数用于taskmapping。 注意：在配置CanTpMainFunction时，需要确保其与taskmapping功能相匹配；此外，该配置项的属性应符合AUTOSAR CP 4.4标准中对CANTP的规定。
        float CanTpMainFunctionPeriod: 0..Inf, scope=ECU, set at pre-compile, default-value=0.005  # Allow to configure the time for the MainFunction (as float in seconds). The CanTpMainFunctionPeriod should be assigned a value which is optimal regarding all of the timers configured for CanTp in TX and RX data transfer i.e. the differences from the configured timing should be as small as possible. Please note: This period shall be the same as call cycle time of the periodic task were CanTp Main function is called. / 概述：CanTpMainFunctionPeriod配置项指定了CAN传输协议（CAN Transport Protocol）主函数的调用周期，用于控制网络层消息的发送和接收处理的时间间隔。 注意：此参数的值应该大于0，CanTpMainFunctionPeriod的值应根据 CanTp 在发送和接收数据传输中配置的所有计时器进行优化，即使得配置时间与实际时间的差异尽可能小，此周期应与调用 CanTp 主函数的周期性任务的调用周期时间相同,默认值5ms。
      container CanTpChannel [1..*]: multiplicity set at post-build in variant post-build / pre-compile in variant pre-compile, post-build-variant-multiplicity=true  # This container contains the configuration parameters of the CanTp channel. / 概述：CanTpChannel 配置项用于定义CAN传输层的通道属性，包含的子容器有CanTpRxNSdu和CanTpTxNSdu。 注意：在配置CanTpChannel时，需要确保通道标识符的唯一性。
        container CanTpRxNSdu [0..1]: multiplicity set at post-build in variant post-build / pre-compile in variant pre-compile, post-build-variant-multiplicity=true  # The following parameters needs to be configured for each CAN N-SDU that the CanTp module receives via the CanTpChannel. This N-SDU produces meta data items of type SOURCE_ADDRESS_16, TARGET_ADDRESS_16 and ADDRESS_EXTENSION_8. / 概述：CanTpRxNSdu配置中包含连接通道CAN N-SDU接收方向相关的所需的相关关键数据。 注意：在配置CanTpRxNSdu时，必须确保PDU标识符的唯一性以避免冲突；正确设置地址信息以匹配发送方的配置；合理配置超时时间以适应网络延迟和系统性能。
          enumeration CanTpRxAddressingFormat: {CANTP_EXTENDED, CANTP_STANDARD}, set at pre-compile, default-value=CANTP_STANDARD  # Declares which communication addressing mode is supported for this RxNSdu. Definition of Enumeration values: / 概述：CanTpRxAddressingFormat 配置项用于定义CAN传输层接收侧的寻址方式，包括标准寻址、扩展寻址和混合寻址。 注意：在配置CanTpRxAddressingFormat时，需要确保它与通信矩阵中定义的寻址方式相匹配；此外，该配置项应与发送侧的CanTpTxAddressingFormat保持一致，以确保通信的一致性。 | CanTpStandard to use normal addressing format. CanTpExtended to use extended addressing format. CanTpMixed to use mixed 11 bit addressing format. CanTpNormalFixed to use normal fixed addressing format. CanTpMixed29Bit to use mixed 29 bit addressing format.
          enumeration CanTpRxPaddingActivation: {CANTP_OFF, CANTP_ON}, post-build-variant-value=true, set at post-build in variant post-build / pre-compile in variant pre-compile, default-value=CANTP_ON  # Defines if the receive frame uses padding or not. This parameter is restricted to 8 byte N-PDUs. / 概述：CanTpRxPaddingActivation 配置项用于定义接收侧的传输协议是否应该对接收到的CAN帧进行填充，以确保数据帧的长度达到预定的标准长度。 注意：在AUTOSAR CP 4.4标准中，接收到的CAN帧可能需要填充到8字节，这取决于网络的配置；不正确的填充设置可能会导致通信不一致或数据解析错误；主要适用于适用于SF（单帧）、FC（流控制帧）和最后一个CF（连续帧）。 | Definition of enumeration values: CanTpOn: The N-PDU received uses padding for SF, FC and the last CF. (N-PDU length is always >= 8 bytes in case of CAN 2.0) CanTpOff: The N-PDU received does not use padding for SF, CF and the last CF. (N-PDU length is dynamic - any valid DLC value). Note: The mandatory mapping to the next higher valid DLC value for N-PDUs with a length > 8 bytes is not affected by this parameter.
          enumeration CanTpRxTaType: {CANTP_FUNCTIONAL, CANTP_PHYSICAL}, set at pre-compile  # Declares the communication type of this Rx N-SDU. / 概述：CanTpRxTaType 配置项声明该Rx N-SDU的通信类型；具体可分为功能寻址或物理寻址。 注意：在配置CanTpRxTaType时，需要确保它与系统中使用的CAN地址方案一致。
          float CanTpNar [0..1]: 0..Inf, multiplicity set at post-build in variant post-build / pre-compile in variant pre-compile, post-build-variant-multiplicity=true, post-build-variant-value=true, set at post-build in variant post-build / pre-compile in variant pre-compile, default-value=0.025  # Value in seconds of the N_Ar timeout. N_Ar is the time for transmission of a CAN frame (any N_PDU) on the receiver side. / 概述：N_Ar超时值（以秒为单位）；CanTpNar配置项以网络层请求链路层发送（Receiver.req）为时间起点，以网络层收到链路层返回发送成功回执（Receiver.con）为时间终点。 注意：CanTpNar参数定义了N_Ar超时时间，即CAN接收端传输CAN帧所允许的最大时间。超过这段时间如果没有完成传输，可能会导致通信超时错误。
          float CanTpNbr [0..1]: 0..Inf, post-build-variant-value=true, set at post-build in variant post-build / pre-compile in variant pre-compile, default-value=0.025  # Value in seconds of the performance requirement for (N_Br + N_Ar). N_Br is the elapsed time between the receiving indication of a FF or CF or the transmit confirmation of a FC, until the transmit request of the next FC. / 概述：N_Br是从接收到FF（首帧）或CF（连续帧）的接收指示或FC（流控帧）的发送确认后，到下一FC的发送请求之间的时间。 注意：在配置CanTpNbr时，重要的是要考虑到通信网络的实际条件和性能限制，以确保设置的时间既不会导致不必要的延迟，也不会由于过于紧迫的时间限制导致数据传输失败。
          float CanTpNcr [0..1]: 0..Inf, multiplicity set at post-build in variant post-build / pre-compile in variant pre-compile, post-build-variant-multiplicity=true, post-build-variant-value=true, set at post-build in variant post-build / pre-compile in variant pre-compile, default-value=0.15  # Value in seconds of the N_Cr timeout. N_Cr is the time until reception of the next Consecutive Frame N_PDU. / 概述：CanTpNcr 是 AUTOSAR CP (Classic Platform) 中的配置参数，N_Cr超时的值（以秒为单位）。N_Cr是接收方动作结束到接收下一个连续帧的时长。 注意：该参数的值必须根据网络的通信速率和性能要求来设定，以确保在规定时间内发送流控制帧。
          float CanTpSTmin [0..1]: 0..Inf, multiplicity set at post-build in variant post-build / pre-compile in variant pre-compile, post-build-variant-multiplicity=true, post-build-variant-value=true, set at post-build in variant post-build / pre-compile in variant pre-compile, default-value=0.025  # Sets the duration of the minimum time the CanTp sender shall wait between the transmissions of two CF N-PDUs. / 概述：CanTpSTmin 是一个配置参数，用于定义在CAN传输层（CAN Transport Layer）中连续帧（Consecutive Frame, CF）之间的必须等待的最小间隔时间。 注意：STmin的值必须在规定的范围内，通常是0到127毫秒或特定的微秒值；配置值过小可能导致接收端处理不及，过大可能影响通信效率；在配置STmin时，还需考虑网络的负载和性能要求。 | For further details on this parameter value see ISO 15765-2 specification.
          integer CanTpBs [0..1]: 0..255, multiplicity set at post-build in variant post-build / pre-compile in variant pre-compile, post-build-variant-multiplicity=true, post-build-variant-value=true, set at post-build in variant post-build / pre-compile in variant pre-compile, default-value=8  # Sets the number of N-PDUs the CanTp receiver allows the sender to send, before waiting for an authorization to continue transmission of the following N-PDUs.For further details on this parameter value see ISO 15765-2 specification. / 概述：CanTpBs 配置项用于定义ISO TP（ISO 15765-2，也称为传输协议）中的块大小，即在接收方需要发送下一个流控制帧之前，发送方可以发送的连续帧的最大数量。 注意：块大小的配置必须符合ECU的缓冲能力和网络的带宽限制；过大的块大小可能导致接收方缓冲区溢出，而过小可能影响通信效率。
          integer CanTpRxNSduId: 0..65535, set at pre-compile, symbolic-name-value=true, default-value=0  # Unique identifier user by the upper layer to call CanTp_CancelReceive, CanTp_ChangeParameter and CanTp_ReadParameter. / 概述：CanTpRxNSduId是用于唯一标识接收侧网络层服务数据单元（N-SDU）的配置项，它在CAN传输协议中用于区分不同的接收消息。 注意：CanTpRxNSduId是SDU的编号，在CanTp_CancelReceive函数和CanTp_ChangeParameter函数和CanTp_ReadParameter函数调用流程中会使用。
          integer CanTpRxWftMax [0..1]: 0..65535, multiplicity set at post-build in variant post-build / pre-compile in variant pre-compile, post-build-variant-multiplicity=true, post-build-variant-value=true, set at post-build in variant post-build / pre-compile in variant pre-compile, default-value=255  # This parameter indicates how many Flow Control wait N-PDUs can be consecutively transmitted by the receiver. It is local to the node and is not transmitted inside the FC protocol data unit. / 概述：CanTpRxWftMax 是一个配置参数，用于指定网络层（CAN传输层）在接收ISO 15765-2多帧消息时，可以发送的最大流控制WAIT帧（WFT）的数量。 注意：该参数的值必须根据网络的性能和通信需求来设定，以避免通信延迟和超时；过高的WFT值可能导致通信效率降低，而过低的值可能导致无法正确接收大数据包。 | CanTpRxWftMax is used to avoid sender nodes being potentially hooked-up in case of a temporarily reception inability on the part of the receiver nodes, whereby the sender could be waiting continuously.
          reference CanTpRxNSduRef: post-build-variant-value=true, set at post-build in variant post-build / pre-compile in variant pre-compile, destination=Pdu  # Reference to a Pdu in the COM-Stack. / 概述：CanTpRxNSduRef是一个配置项，用于引用接收侧网络层服务数据单元（NSDU），它指定了CAN传输层接收消息的标识和处理规则。 注意：确保每个CanTpRxNSduRef正确引用了期望的PduR层的RxNSdu，以保证消息正确路由；在配置时需注意与发送侧NSdu的匹配性，避免数据传输错误；该配置项在AUTOSAR CP 4.4中是必需的，缺失会导致接收过程无法正确执行。
          container CanTpNAe [0..1]  # This container is required for each RxNSdu and TxNSdu with AddressingFormat CANTP_MIXED or CANTP_MIXED29BIT.
            integer CanTpNAe: 0..255, set at pre-compile  # This parameter contains the transport protocol address extension value.
          container CanTpNSa [0..1]  # This container is required for each RxNSdu and TxNSdu with RxTaType CANTP_PHYSICAL and CanTpAddressingFormat CANTP_EXTENDED. When DynIdSupport is enabled, this container is also required for each TxNSdu with AddressingFormat CANTP_NORMALFIXED or CANTP_MIXED29BIT. When DynIdSupport is enabled and GenericConnectionSupport is not enabled, this container is also required for each RxNSdu with AddressingFormat CANTP_NORMALFIXED or CANTP_MIXED29BIT.
            integer CanTpNSa: 0..255, set at pre-compile  # This parameter contains the transport protocol source address value.
          container CanTpNTa [0..1]  # This container is required for each RxNSdu and TxNSdu with AddressingFormat CANTP_EXTENDED. When DynIdSupport is enabled, this container is also required for each RxNSdu with AddressingFormat CANTP_NORMALFIXED or CANTP_MIXED29BIT. When DynIdSupport is enabled and GenericConnectionSupport is not enabled, this container is also required for each TxNSdu with AddressingFormat CANTP_NORMALFIXED or CANTP_MIXED29BIT.
            integer CanTpNTa: 0..255, set at pre-compile  # This parameter contains the transport protocol target address value.
          container CanTpRxNPdu  # Used for grouping of the ID of a PDU and the Reference to a PDU. This N-PDU consumes a meta data item of type CAN_ID_32. / 概述：CanTpRxNPdu配置项用于定义接收侧网络层协议数据单元（N-PDU），它指定了接收CAN传输协议数据的参数和属性，如N-PDU的ID和接收消息的处理方式。 注意：在配置CanTpRxNPdu时，必须确保N-PDU的ID在整个CAN网络中是唯一的，以避免消息冲突；此配置项应与CAN驱动和CAN接口模块的配置保持一致，以确保正确的消息接收和处理；AUTOSAR CP 4.4标准要求对接收的N-PDU进行严格的时间和资源管理，以满足实时性要求。
            integer CanTpRxNPduId: 0..65535, set at pre-compile, symbolic-name-value=true, default-value=0  # The N-PDU identifier attached to the RxNsdu is identified by CanTpRxNSduId. / 概述：CanTpRxNPduId是用于标识接收到的网络层协议数据单元（N-PDU）的唯一标识符，它使得CAN传输层（CanTp）能够区分和处理接收到的不同N-PDU消息。 注意：在配置CanTpRxNPduId时，必须确保其值在整个CAN网络中是唯一的，以避免消息处理的冲突；此外，该标识符的配置应与CAN驱动和网络管理配置相匹配，以确保正确的消息路由和处理；在AUTOSAR CP 4.4标准中，对CanTpRxNPduId的具体数值范围没有特殊限制，但应遵循项目或网络的具体要求。 | Each RxNsdu identifier is linked to only one SF/FF/CF N-PDU identifier. Nevertheless, in the case of extended or mixed addressing format, the same N-PDU identifier can be used for several N-SDU identifiers. The distinction is made by the N_TA or N_AE value (first data byte of SF or FF frames).
            reference CanTpRxNPduRef: post-build-variant-value=true, set at post-build in variant post-build / pre-compile in variant pre-compile, destination=Pdu  # Reference to a Pdu in the COM-Stack. / 概述：CanTpRxNPduRef是一个配置项，用于指定接收到的网络层协议数据单元（N-PDU）的引用，这是CAN传输协议（CanTp）模块处理接收消息所必需的。 注意：确保每个CanTpRxNPduRef正确映射到相应的N-PDU，以保证消息的正确接收和处理；在配置时需注意与CAN驱动和PDU路由的一致性；该配置项的属性应与AUTOSAR CP 4.4标准保持一致，任何偏差都需要特别注意。
          container CanTpTxFcNPdu [0..1]  # Used for grouping of the ID of a PDU and the Reference to a PDU. This N-PDU produces a meta data item of type CAN_ID_32. / 概述：CanTpTxFcNPdu 配置项用于定义CAN传输层（CAN Transport Layer）发送流控制帧的网络协议数据单元（N-PDU），它指定了发送流控制帧的CAN帧ID和DLC。 注意：在配置CanTpTxFcNPdu时，必须确保所指定的CAN帧ID不与系统中其他N-PDU ID冲突；DLC值应符合CAN网络的数据长度要求；此配置应与接收方的期望流控制帧配置相匹配，以确保通信的正确性。
            integer CanTpTxFcNPduConfirmationPduId: 0..65535, set at pre-compile, symbolic-name-value=true, default-value=0  # Handle Id to be used by the CanIf to confirm the transmission of the CanTpTxFcNPdu to the CanIf module. / 概述：CanTpTxFcNPduConfirmationPduId 是用于配置CAN传输层的参数，它指定了发送流控制帧N-PDU的确认消息的PDU ID。 注意：在配置CanTpTxFcNPduConfirmationPduId时，必须确保所指定的PDU ID与系统中其他PDU ID不冲突；此ID应与发送流控制帧的N-PDU相对应；在配置时应参照ECU的CAN通信矩阵确保正确性。
            reference CanTpTxFcNPduRef: post-build-variant-value=true, set at post-build in variant post-build / pre-compile in variant pre-compile, destination=Pdu  # Reference to a Pdu in the COM-Stack. / 概述：CanTpTxFcNPduRef配置项用于定义传输层（CAN Transport Layer）在发送流控制帧（Flow Control Frame）时所使用的网络PDU（协议数据单元）的引用。 注意：该配置项确保了流控制帧的正确发送，特别是在基于CAN网络的通信中；在配置时需确保引用的PDU与实际的CAN网络配置相匹配。
        container CanTpTxNSdu [0..1]: multiplicity set at post-build in variant post-build / pre-compile in variant pre-compile, post-build-variant-multiplicity=true  # The following parameters needs to be configured for each CAN N-SDU that the CanTp module transmits via the CanTpChannel. This N-SDU consumes meta data items of type SOURCE_ADDRESS_16, TARGET_ADDRESS_16 and ADDRESS_EXTENSION_8. / 概述：CanTpTxNSdu配置中包含连接通道CAN N-SDU发送方向相关的所需的相关关键数据。 注意：在配置CanTpTxNSdu时，必须确保NSDU的标识符在整个系统中是唯一的；根据AUTOSAR CP 4.4标准，需要正确设置地址信息和传输属性，以保证数据的正确发送和接收；配置时应注意与接收端的配置相匹配，避免通信错误。
          boolean CanTpTc: set at pre-compile  # Switch for enabling Transmit Cancellation. / 概述：CanTpTc是一个配置项，用于指定CAN传输层（CAN Transport Layer）是否支持传输控制，即是否允许对CAN消息的发送进行管理和控制。 注意：在AUTOSAR CP 4.4标准中，确保在启用CanTpTc时，网络层已经配置为支持相应的传输控制功能；此配置项对于实现高级数据传输管理功能至关重要；不当的配置可能会影响网络通信的效率和可靠性。
          enumeration CanTpTxAddressingFormat: {CANTP_EXTENDED, CANTP_STANDARD}, set at pre-compile, default-value=CANTP_STANDARD  # Declares which communication addressing format is supported for this TxNSdu. Definition of Enumeration values: / 概述：CanTpTxAddressingFormat配置项用于定义CAN传输层（CanTp）在发送帧的寻址方式。 注意：在配置CanTpTxAddressingFormat时，需要确保它与网络上其他节点的寻址格式兼容；AUTOSAR CP 4.4标准支持标准寻址、扩展寻址和混合寻址模式；选择错误的寻址格式可能导致通信失败或数据解析错误。 | CanTpStandard to use normal addressing format. CanTpExtended to use extended addressing format. CanTpMixed to use mixed 11 bit addressing format. CanTpNormalFixed to use normal fixed addressing format. CanTpMixed29Bit to use mixed 29 bit addressing format.
          enumeration CanTpTxPaddingActivation: {CANTP_OFF, CANTP_ON}, post-build-variant-value=true, set at post-build in variant post-build / pre-compile in variant pre-compile, default-value=CANTP_ON  # Defines if the transmit frame use padding or not. This parameter is restricted to 8 byte N-PDUs. / 概述：CanTpTxPaddingActivation 是一个配置项，用于定义在使用CAN传输层进行发送操作时，是否激活填充功能，控制该通道报文是否填充。 注意：在AUTOSAR CP 4.4标准中，确保此配置与PDU的长度和CAN控制器的填充功能设置相匹配。 | Definition of Enumeration values: CanTpOn The transmit N-PDU uses padding for SF, FC and the last CF. (N-PDU length is always 8 bytes in case of CAN 2.0) CanTpOff The transmit N-PDU does not use padding for SF, CF and the last CF. (N-PDU length is dynamic - any valid DLC value). Note: The mandatory mapping to the next higher valid DLC value for N-PDUs with a length > 8 bytes is not affected by this parameter.
          enumeration CanTpTxTaType: {CANTP_FUNCTIONAL, CANTP_PHYSICAL}, set at pre-compile  # Declares the communication type of this TxNsdu. / 概述：CanTpTxTaType配置项用于定义CAN传输层（CanTp）中发送端的地址类型，它决定了如何处理发送帧的地址信息。 注意：在配置CanTpTxTaType时，需要确保它与网络上其他节点的地址类型兼容；此外，选择错误的地址类型可能导致通信失败或数据错误；AUTOSAR CP 4.4标准支持多种地址类型，包括物理地址和功能地址，需要根据实际应用场景选择合适的类型。 | Enumeration values: CanTpPhysical. Used for 1:1 communication. CanTpFunctional. Used for 1:n communication.
          float CanTpNas: 0..Inf, post-build-variant-value=true, set at post-build in variant post-build / pre-compile in variant pre-compile, default-value=0.025  # Value in second of the N_As timeout. N_As is the time for transmission of a CAN frame (any N_PDU) on the part of the sender. / 概述：CanTpNas 是用于定义 CAN 传输层的网络层服务数据单元（N-PDU）的发送确认超时时间，发送方发送任意类型数据帧（首帧、连续帧）的时长。 注意：该值必须根据网络的实际条件和性能要求进行配置；超时时间设置过短可能导致在网络拥堵时无法正确确认消息，设置过长可能影响系统响应时间；在配置时需遵循相关的网络通信标准和协议要求。
          float CanTpNbs [0..1]: 0..Inf, multiplicity set at post-build in variant post-build / pre-compile in variant pre-compile, post-build-variant-multiplicity=true, post-build-variant-value=true, set at post-build in variant post-build / pre-compile in variant pre-compile, default-value=0.075  # Value in seconds of the N_Bs timeout. N_Bs is the time of transmission until reception of the next Flow Control N_PDU. / 概述：CanTpNbs配置项定义了发送方任意动作结束到收到流控帧的时长。 注意：N_Ar以网络层请求链路层发送（Receiver.req）为时间起点，以网络层收到链路层返回发送成功回执（Receiver.con）为时间终点；N_Bs可以以链路层返回首帧或连续帧发送成功（Sender.con）为时间起点，以链路层返回收到新的流控帧提示（Sender.ind）为时间终点；N_Bs可以以链路层返回连续帧发送成功（Sender.con）为时间起点，以链路层返回收到新的流控帧提示（Sender.ind）为时间终点；N_Bs可以以收到流控帧的提示（Sender.con）为时间起点，以链路层返回收到新的流控帧提示（Sender.ind）为时间终点。
          float CanTpNcs [0..1]: 0..Inf, multiplicity set at post-build in variant post-build / pre-compile in variant pre-compile, post-build-variant-multiplicity=true, post-build-variant-value=true, set at post-build in variant post-build / pre-compile in variant pre-compile, default-value=0.05  # Value in seconds of the performance requirement of (N_Cs + N_As). N_Cs is the time in which CanTp is allowed to request the Tx data of a Consecutive Frame N_PDU. / 概述：CanTpNcs配置项定义了发送方动作结束到发送下一个连续帧的时长。 注意：N_Cs可以以链路层提示收到流控帧（Sender.ind）为时间起点，以网络层请求链路层发送连续帧（Sender.req）为时间终点；N_Cs可以以返回连续帧发送成功（Sender.con）为时间起点，以网络层请求链路层发送新的连续帧（Sender.req）为时间终点。
          integer CanTpTxNSduId: 0..65535, set at pre-compile, symbolic-name-value=true, default-value=0  # Unique identifier to a structure that contains all useful information to process the transmission of a TxNsdu. / 概述：CanTpTxNSduId是用于标识CAN传输层（CanTp）中特定发送NSDU（网络服务数据单元）的唯一标识符。 注意：该SDU的编号，在CanTp_Transmit函数和CanTp_CancelTransmit函数调用流程中会使用。
          reference CanTpTxNSduRef: post-build-variant-value=true, set at post-build in variant post-build / pre-compile in variant pre-compile, destination=Pdu  # Reference to a Pdu in the COM-Stack. / 概述：CanTpTxNSduRef是一个配置项，用于引用发送端网络层服务数据单元（NSDU），它指定了CAN传输层（CanTp）用于发送数据的特定NSDU。 注意：确保CanTpTxNSduRef正确引用了期望的NSDU配置，以保证数据能够正确发送；在配置时需注意与接收端NSDU的匹配性，避免数据发送到错误的目标；此配置项缺失会导致发送功能不可用。
          container CanTpNAe [0..1]  # This container is required for each RxNSdu and TxNSdu with AddressingFormat CANTP_MIXED or CANTP_MIXED29BIT.
            integer CanTpNAe: 0..255, set at pre-compile  # This parameter contains the transport protocol address extension value. / 概述：CanTpNAe是用于定义网络地址扩展（Network Address Extension）的配置参数，它允许在CAN传输层（CAN Transport Layer）中支持多个网络地址，从而实现对不同节点的通信。 注意：在使用CanTpNAe时，需要确保网络中的每个节点都支持网络地址扩展功能；此配置项在配置CAN通信时非常重要，以确保消息正确路由；AUTOSAR CP 4.4标准中并未直接提及CanTpNAe，因此具体实现可能会依赖于供应商的实现细节。 该配置项未使用
          container CanTpNSa [0..1]  # This container is required for each RxNSdu and TxNSdu with RxTaType CANTP_PHYSICAL and CanTpAddressingFormat CANTP_EXTENDED. When DynIdSupport is enabled, this container is also required for each TxNSdu with AddressingFormat CANTP_NORMALFIXED or CANTP_MIXED29BIT. When DynIdSupport is enabled and GenericConnectionSupport is not enabled, this container is also required for each RxNSdu with AddressingFormat CANTP_NORMALFIXED or CANTP_MIXED29BIT.
            integer CanTpNSa: 0..255, set at pre-compile  # This parameter contains the transport protocol source address value. / 概述：CanTpNSa 配置项指定了用于CAN传输层的网络源地址，这是ISO-TP（ISO 15765-2）协议中的一部分，用于标识发送节点的地址信息。 注意：在配置CanTpNSa时，需要确保地址值与网络中其他节点的源地址不冲突；此外，该值通常与车辆网络的地址分配方案一致；在AUTOSAR CP 4.4标准中，确保此配置项符合CAN传输层模块的要求。 该配置项未使用
          container CanTpNTa [0..1]  # This container is required for each RxNSdu and TxNSdu with AddressingFormat CANTP_EXTENDED. When DynIdSupport is enabled, this container is also required for each RxNSdu with AddressingFormat CANTP_NORMALFIXED or CANTP_MIXED29BIT. When DynIdSupport is enabled and GenericConnectionSupport is not enabled, this container is also required for each TxNSdu with AddressingFormat CANTP_NORMALFIXED or CANTP_MIXED29BIT.
            integer CanTpNTa: 0..255, set at pre-compile  # This parameter contains the transport protocol target address value. / 概述：CanTpNTa 配置项定义了CAN传输层中的网络目标地址，用于区分不同的网络节点，确保CAN消息能够被正确地发送到预定的目标节点。 注意：在配置CanTpNTa时，需要确保地址与网络中其他节点的地址不冲突；根据CAN网络的实际架构和通信需求来设置此地址；在AUTOSAR CP 4.4标准中，此配置应与PDU层的地址信息保持一致，以确保消息的正确路由。 该配置项未使用
          container CanTpRxFcNPdu [0..1]  # Used for grouping of the ID of a PDU and the Reference to a PDU. This N-PDU consumes a meta data item of type CAN_ID_32. / 概述：CanTpRxFcNPdu 配置项为该路连接通道配置流控帧所需PDU引用，其中包括PduId和引用信息。 注意：在配置CanTpRxFcNPdu时，PduId在普通寻址方式时与NSduId挂接，但是在扩展寻址等其他方式中，可能会存在多路复用的情况，需要同时考虑N_TA。
            integer CanTpRxFcNPduId: 0..65535, set at pre-compile, symbolic-name-value=true, default-value=0  # N-PDU identifier attached to the FC N-PDU of this TxNsdu identified by CanTpTxNSduId. / 概述：CanTpRxFcNPduId是用于定义接收流控制帧的网络层协议数据单元（N-PDU）的标识符，它是CAN传输层配置中的一个元素，用于确保正确接收流控制信息。 注意：该标识符必须是唯一的，以避免在网络上的冲突；在配置时需确保与发送流控制帧的N-PDU ID相匹配；在AUTOSAR CP 4.4标准中，确保该配置项符合网络管理和诊断消息的要求。 | Each TxNsdu identifier is linked to one Rx FC N-PDU identifier only. However, in the case of extended addressing format, the same FC N-PDU identifier can be used for several N-SDU identifiers. The distinction is made by means of the N_TA value (first data byte of FC frames).
            reference CanTpRxFcNPduRef: post-build-variant-value=true, set at post-build in variant post-build / pre-compile in variant pre-compile, destination=Pdu  # Reference to a Pdu in the COM-Stack. / 概述：CanTpRxFcNPduRef配置项用于定义接收流控制帧的网络层协议数据单元（N-PDU）的引用，确保在CAN传输层正确处理接收到的流控制帧。 注意：该配置项必须确保引用的N-PDU与实际接收流控制帧的N-PDU匹配；在配置时需注意与其他N-PDU的唯一性和区分性，避免冲突；AUTOSAR CP 4.4标准中，确保该配置项的正确性对于实现基于CAN的网络通信的流控制至关重要。
          container CanTpTxNPdu  # Used for grouping of the ID of a PDU and the Reference to a PDU. This N-PDU produces a meta data item of type CAN_ID_32. / 概述：CanTpTxNPdu 配置项用于定义CAN传输层（CAN Transport Layer）中用于发送网络层协议数据单元（NPDU）的参数，这些参数包括PDU的ID、类型以及与之关联的CAN控制器等信息。 注意：在配置CanTpTxNPdu时，必须确保PDU的ID在整个CAN网络中是唯一的，以避免冲突；需要与CAN驱动和网络管理配置相匹配，以确保正确的数据传输和网络行为；在配置过程中，应参照AUTOSAR CP 4.4标准中的相关规范来设置参数，确保配置的兼容性和标准性。
            integer CanTpTxNPduConfirmationPduId: 0..65535, set at pre-compile, symbolic-name-value=true, default-value=0  # Handle Id to be used by the CanIf to confirm the transmission of the CanTpTxNPdu to the CanIf module. / 概述：CanTpTxNPduConfirmationPduId 是用于配置CAN传输层的参数，它指定了用于确认传输NPDU（网络协议数据单元）的PDU ID。 注意：在配置CanTpTxNPduConfirmationPduId时，必须确保它与实际的CAN驱动层中定义的PDU ID相匹配；此ID应唯一地标识一个特定的确认PDU；在配置过程中，应避免与其他PDU ID发生冲突。
            reference CanTpTxNPduRef: post-build-variant-value=true, set at post-build in variant post-build / pre-compile in variant pre-compile, destination=Pdu  # Reference to a Pdu in the COM-Stack. / 概述：CanTpTxNPduRef是一个配置项，用于指定CAN传输层（CanTp）中用于网络层协议数据单元（NPDU）传输的引用，主要用于发送操作。 注意：确保CanTpTxNPduRef正确指向有效的NPDU配置，以保证数据能够正确发送；在配置时需注意与接收NPDU的匹配和兼容性；此配置项在AUTOSAR CP 4.4中应与CAN驱动和网络管理模块的配置保持一致，以避免通信问题。
    container CanTpGeneral  # This container contains the general configuration parameters of the CanTp module. / 概述：CanTpGeneral 是一个配置容器，为CanTp模块的通用配置项。 注意：在配置CanTpGeneral时，需要确保参数设置符合网络的通信需求和性能指标。
      boolean CanTpChangeParameterApi: set at pre-compile  # This parameter, if set to true, enables the CanTp_ChangeParameterRequest Api for this Module. / 概述：CanTpChangeParameterApi 是一个配置项，此配置项允许在运行时更改参数，通过API调用。 注意：类型为Boolean，控制是否使能CanTp_ChangeParameterRequest函数。
      boolean CanTpDevErrorDetect: set at pre-compile, default-value=false  # Switches the development error detection and notification on or off. / 概述：CanTpDevErrorDetect 是一个配置参数，类型为Boolean，控制是否使能本模块开发错误追踪问题。 注意：true: 启用检测及通知；false: 禁用检测及通知；此功能用于支持开发阶段的问题定位，在正式版本中建议关闭。 | * true: detection and notification is enabled. * false: detection and notification is disabled.
      boolean CanTpDynIdSupport [0..1]: multiplicity set at pre-compile, set at pre-compile, default-value=false  # Enable support for dynamic ID handling via N-PDU MetaData. / 概述：CanTpDynIdSupport 配置项用于指定CAN传输层（CanTp）是否支持动态定义CAN标识符，这允许在运行时改变用于诊断或数据传输的CAN ID。 注意：在AUTOSAR CP 4.4标准中，动态CAN ID支持是可选的，需要根据项目需求决定是否启���；如果启用此功能，需要确保上层服务和应用能够适应动态ID的变化；在配置时，应检查ECU硬件和CAN驱动是否支持动态ID的配置和更改。 该配置项未使用
      boolean CanTpFlexibleDataRateSupport [0..1]: set at pre-compile, default-value=true  # Enable support for CAN FD frames. / 概述：CanTpFlexibleDataRateSupport配置项用于指定CAN传输层（CanTp模块）启用对CAN FD帧的支持。 注意：类型为Boolean，控制是否支持CAN FD（Flexible Data-Rate）。
      boolean CanTpGenericConnectionSupport [0..1]: multiplicity set at pre-compile, set at pre-compile, default-value=false  # Enable support for the handling of generic connections using N-SDUs with MetaData. Requires CanTpDynIdSupport. / 概述：CanTpGenericConnectionSupport 是一个配置项，用于指定CAN传输层（CanTp模块）是否支持泛型连接管理，这可以提高模块的灵活性，允许它处理不同类型的通信连接。 注意：在AUTOSAR CP 4.4标准中，确保在使用泛型连接支持时，相关的PDU路由配置正确；此功能可能会增加模块的复杂性和资源消耗；如果应用场景不需要泛型连接，可以关闭此功能以节省资源。 该配置项未使用
      boolean CanTpEnableSynchronousTransmit: set at pre-compile, default-value=true  # If this option is enabled, the CanTp will try to get a buffer and to transmit the FF or SF directly from the context of CanTp_Transmit. Otherwise, buffer request and transmission will be done during the next CanTp_MainFunction call. / 概述：CanTpEnableSynchronousTransmit 配置项用于确定CAN传输层（CanTp）是否支持同步发送功能。 注意：该配置项为非标配置项，类型为Boolean，控制是否支持同步发送。
      boolean CanTpReadParameterApi: set at pre-compile  # This parameter, if set to true, enables the CanTp_ReadParameterApi for this module. / 概述：CanTpReadParameterApi 配置项用于启用或禁用传输层读取参数的API。 注意：类型为Boolean，控制是否使能CanTp_ReadParameter函数。
      boolean CanTpVersionInfoApi: set at pre-compile, default-value=false  # The function CanTp_GetVersionInfo is configurable (On/Off) by this configuration parameter. / 概述：CanTpVersionInfoApi 配置项用于启用或禁用 CAN 传输层的版本信息API，该API允许用户获取CAN传输层模块的版本信息。 注意：在AUTOSAR CP 4.4标准中，版本信息API的使用是可选的；如果启用，必须确保模块实现了相应的API函数；在发布产品时，出于节省资源的考虑，通常建议禁用此API。 该配置项未使用
      integer CanTpPaddingByte: 0..255, set at pre-compile, default-value=85  # Used for the initialization of unused bytes with a certain value / 概述：CanTpPaddingByte 是用于定义在传输层（CAN Transport Layer）发送CAN帧时，填充剩余字节的值。 注意：类型为Int，用于填充的数据，ISO-15765-2默认配置为0xCC。
package /AUTOSAR/EcucDestinationUriDefSets
  ecuc destination uri def set RteRipsUriDefSet
    ecuc destination uri def RteRipsInvocationHandler
      destination-uri-policy destination-uri-nesting-contract=TARGET-CONTAINER:
        container RteRipsInvocationHandlerFnc [0..*]  # This container describes an invocation handler function implemented by an RTE Implementation Plug-In to handle the invocation of server runnables and triggered runnables via a transformer. Tags: atp.Status=draft / 概述：RteRipsInvocationHandlerFnc是一个配置项，用于指定Remote Invocation Proxy Stub (RIPS)的调用处理函数，这是AUTOSAR中实现跨ECU通信的一种机制。 注意：在配置RteRipsInvocationHandlerFnc时，需要确保指定的函数符合AUTOSAR CP 4.4标准中对于远程调用处理函数的要求和格式；此配置项对于实现跨ECU的方法调用至关重要，因此需要仔细设计以确保通信的可靠性和效率；AUTOSAR CP 4.4标准中并未详细描述此配置项的具体属性，因此在实际应用中可能需要参考软件供应商的具体实现。 该配置项未使用
          function name RteRipsInvocationHandlerFncSymbol  # C-Symbol of the Rte_Rips_FillFlushRoutine function. Tags: atp.Status=draft / 概述：RteRipsInvocationHandlerFncSymbol是用于定义RTE生成代码中，某个RTE内部调用处理函数的符号名称，这个符号用于在代码中标识具体的函数，以便于实现函数的调用。 注意：该配置项的命名需要遵循项目或组织内部的编码规范，以确保一致性和可读性；在AUTOSAR CP 4.4标准中，对于函数符号的具体命名规则没有严格要求，但建议使用有意义的命名以便于维护；更改此配置项时，需要确保引用的函数符号在代码中存在且可访问。 该配置项未使用
    ecuc destination uri def RteRipsPlugin
      destination-uri-policy destination-uri-nesting-contract=TARGET-CONTAINER:
        container RteRipsPluginProps  # This container defines the identity of the Rte Implementation Plug-in and provides the RTE relevant parameters of the Rte Implementation Plug-in. Tags: atp.Status=draft / 概述：RteRipsPluginProps是用于定义RTE生成代码时，与RTE插件相关的属性配置，这些属性影响代码生成的特定行为或优化。 注意：该配置项的属性必须与所使用的RTE版本和插件兼容；在进行大型项目或多版本项目时，应仔细管理不同插件的属性设置，以避免兼容性问题；在AUTOSAR CP 4.4标准中，对于RteRipsPluginProps的具体属性和使用可能没有详细的规定，需要参考具体的RTE工具文档。 该配置项未使用 | The shortName of the container defines the name of the Rte Implementation Plug-in used for the API infixes.
          boolean RtePluginSupportsIReadIWrite: default-value=false  # Denotes if or if not the plug-in supports the Rte_Rips_IRead/IWrite macros for primitive data. Tags: atp.Status=draft / 概述：RtePluginSupportsIReadIWrite配置项用于指定RTE（Runtime Environment）是否支持IRead和IWrite接口，这些接口用于实现组件间的数据读写操作。 注意：在AUTOSAR CP 4.4标准中，确保组件间通信的一致性和数据交换的实时性是至关重要的；如果项目不使用AUTOSAR标准的IRead和IWrite接口，需要特别注意数据交换机制的设计和实现；此配置项的设置应与项目需求和系统设计紧密相关，以确保系统的高效和可靠运行。 该配置项未使用
          enumeration RteRipsGlobalCopyInstantiationPolicy: {RTE_RIPS_INSTANTIATION_BY_PLUGIN, RTE_RIPS_INSTANTIATION_BY_RTE}, default-value=RTE_RIPS_INSTANTIATION_BY_RTE  # Globally enables or disables the support for Rte Implementation Plug-Ins (RIPS) Tags: atp.Status=draft / 概述：RteRipsGlobalCopyInstantiationPolicy配置项用于定义RTE在处理跨分区通信时，全局变量复制的实例化策略，确保数据一致性和隔离性。 注意：该配置项对于确保系统安全性和数据一致性至关重要；必须根据系统的安全需求和分区策略仔细选择合适的实例化策略；在AUTOSAR CP 4.4标准中，需要确保与系统分区和通信机制兼容。 该配置项未使用
    ecuc destination uri def RteRipsPluginFillFlushRoutine
      destination-uri-policy destination-uri-nesting-contract=TARGET-CONTAINER:
        container RteRipsPluginFillFlushRoutineFnc [0..*]  # This container describes a Fill-Flush Routine function implemented by a RTE Implementation Plug-In to handle the buffering for implicit communication. Tags: atp.Status=draft / 概述：RteRipsPluginFillFlushRoutineFnc配置项用于定义RTE生成的代码中，与接收或发送IPdu相关的插件的填充和刷新例程函数。 注意：该配置项需要确保与所使用的通信堆栈兼容；在配置时需注意函数的命名规则以避免命名冲突；此配置项在AUTOSAR CP 4.4标准中未明确定义，需要根据实际使用的AUTOSAR RTE生成工具的文档进行配置。 该配置项未使用
          enumeration RteRipsModeDisablingHandling: {RTE_RIPS_CONSIDER_MODE_DISABLINGS, RTE_RIPS_IGNORE_MODE_DISABLINGS}  # This parameter configures whether mode disabling dependencies are considered for the invocation of Rte_Rips_FillFlushRoutines. Tags: atp.Status=draft / 概述：RteRipsModeDisablingHandling配置项用于定义AUTOSAR RTE（Run-Time Environment）中，当某个模式（Mode）被禁用时，相关联的模式切换接口（Mode Switch Interface）的处理行为。 注意：在AUTOSAR CP 4.4标准中，对于模式禁用的处理并没有特定的配置项名为RteRipsModeDisablingHandling，因此在使用时需要确认标准文档中对应的正确配置项和属性。正确处理模式禁用行为对于确保系统稳定性和预期行为至关重要。配置时应考虑系统的容错需求和模式管理策略。 该配置项未使用
          enumeration RteRipsOsSchedulePoint [0..1]: {NONE, UNCONDITIONAL}  # Introduce a schedule point by explicitly calling Os Schedule service after the execution of the Rte_Rips_FillFlushRoutine. Tags: atp.Status=draft / 概述：RteRipsOsSchedulePoint 配置项用于定义AUTOSAR RTE（Run-Time Environment）中的调度点，这些调度点是RTE与操作系统(OS)交互的同步点，用于控制任务的执行和调度。 注意：在配置RteRipsOsSchedulePoint时，需要确保调度点与操作系统的任务配置相匹配，避免因调度点设置不当导致任务调度异常；此外，调度点的设置应考虑系统的实时性要求，以及可能的优先级反转问题；在多核系统中，还需注意调度点在不同核心间的同步和一致性。 该配置项未使用
          function name RteRipsPluginFillFlushRoutineFncSymbol  # C-Symbol of the Rte_Rips_FillFlushRoutine function. Tags: atp.Status=draft / 概述：RteRipsPluginFillFlushRoutineFncSymbol配置项用于定义RTE生成的代码中，与RIPS插件交互的填充和刷新例程的函数符号名称，这些例程用于数据交换和同步。 注意：该配置项的命名需要遵循项目中的命名规范，以确保一致性和可读性；在配置时需确保所指定的函数符号在项目中存在且可访问；此配置项在AUTOSAR CP 4.4标准中未明确定义，因此在使用时应参考具体的RTE生成工具或RIPS插件的文档。 该配置项未使用
package /AUTOSAR/LifeCycleInfoSets
  life cycle info set AUTOSARParameterDefinition
    life-cycle-infos:
      lc-object=AdcGroupEcucPartitionRef, lc-state=draft
      lc-object=AdcEcucPartitionRef, lc-state=draft
      lc-object=AdcKernelEcucPartitionRef, lc-state=draft
      lc-object=ArtiConstant, lc-state=draft
      lc-object=ArtiConstantString, lc-state=draft
      lc-object=ArtiExpression, lc-state=draft
      lc-object=ArtiExpressionString, lc-state=draft
      lc-object=ArtiHook, lc-state=draft
      lc-object=ArtiHookClass, lc-state=draft
      lc-object=ArtiHookEventName, lc-state=draft
      lc-object=ArtiHookInstance, lc-state=draft
      lc-object=ArtiHookEventParameterTypeRef, lc-state=draft
      lc-object=ArtiHookInstanceParameterTypeRef, lc-state=draft
      lc-object=ArtiObjectClassParameter, lc-state=draft
      lc-object=ArtiParameterTypeMapRef, lc-state=draft
      lc-object=ArtiObjectInstanceParameter, lc-state=draft
      lc-object=ArtiConstantRef, lc-state=draft
      lc-object=ArtiExpressionRef, lc-state=draft
      lc-object=ArtiHookRef, lc-state=draft
      lc-object=ArtiParameterTypeMap, lc-state=draft
      lc-object=ArtiParameterTypeMapPair, lc-state=draft
      lc-object=ArtiParameterTypeMapPairInput, lc-state=draft
      lc-object=ArtiParameterTypeMapPairOutput, lc-state=draft
      lc-object=ArtiGenericComponentClass, lc-state=draft
      lc-object=ArtiGenericComponentClassName, lc-state=draft
      lc-object=ArtiGenericComponentClassParameter, lc-state=draft
      lc-object=ArtiGenericComponentClassParameterName, lc-state=draft
      lc-object=ArtiParameterTypeMapRef, lc-state=draft
      lc-object=ArtiGenericComponentInstance, lc-state=draft
      lc-object=ArtiGenericComponentInstanceName, lc-state=draft
      lc-object=ArtiGenericComponentClassRef, lc-state=draft
      lc-object=ArtiGenericComponentInstanceParameter, lc-state=draft
      lc-object=ArtiConstantRef, lc-state=draft
      lc-object=ArtiExpressionRef, lc-state=draft
      lc-object=ArtiGenericComponentClassParameterRef, lc-state=draft
      lc-object=ArtiHookRef, lc-state=draft
      lc-object=ArtiHwCoreClass, lc-state=draft
      lc-object=ArtiCurrentApplicationClassRef, lc-state=draft
      lc-object=ArtiCurrentTaskClassRef, lc-state=draft
      lc-object=ArtiLastErrorClassRef, lc-state=draft
      lc-object=ArtiHwCoreInstance, lc-state=draft
      lc-object=ArtiCurrentApplicationInstanceRef, lc-state=draft
      lc-object=ArtiCurrentTaskInstanceRef, lc-state=draft
      lc-object=ArtiEcucCoreRef, lc-state=draft
      lc-object=ArtiLastErrorInstanceRef, lc-state=draft
      lc-object=ArtiOsClass, lc-state=draft
      lc-object=ArtiOsAppModeClassRef, lc-state=draft
      lc-object=ArtiOsInstance, lc-state=draft
      lc-object=ArtiOsAppModeEcucRef, lc-state=draft
      lc-object=ArtiOsAppModeInstanceRef, lc-state=draft
      lc-object=ArtiOsEcucRef, lc-state=draft
      lc-object=ArtiOsTaskHookRef, lc-state=draft
      lc-object=ArtiOsTaskClass, lc-state=draft
      lc-object=ArtiOsTaskInstance, lc-state=draft
      lc-object=ArtiGenericComponentInstanceRef, lc-state=draft
      lc-object=ArtiOsTaskEcucRef, lc-state=draft
      lc-object=CanControllerEcucPartitionRef, lc-state=draft
      lc-object=CanTTControllerEcucPartitionRef, lc-state=draft
      lc-object=CanEcucPartitionRef, lc-state=draft
      lc-object=CanTSynGlobalTimeSecureTmacLength, lc-state=draft
      lc-object=CanTSynTxTmacCalculated, lc-state=draft
      lc-object=CanTSynGlobalTimeMinMsgGap, lc-state=draft
      lc-object=CanTSynRxTmacValidated, lc-state=draft
      lc-object=CanTrcvChannelEcucPartitionRef, lc-state=draft
      lc-object=CanTrcvEcucPartitionRef, lc-state=draft
      lc-object=CorTstBackgroundEcucPartitionRef, lc-state=draft
      lc-object=CorTstForegroundEcucPartitionRef, lc-state=draft
      lc-object=CorTstEcucPartitionRef, lc-state=draft
      lc-object=CryptoDriverObjectEcucPartitionRef, lc-state=draft
      lc-object=CryptoEcucPartitionRef, lc-state=draft
      lc-object=DemFreezeFrameRecordTrigger, lc-state=draft
      lc-object=DioPortEcucPartitionRef, lc-state=draft
      lc-object=DioChannelEcucPartitionRef, lc-state=draft
      lc-object=DioChannelGroupEcucPartitionRef, lc-state=draft
      lc-object=DioEcucPartitionRef, lc-state=draft
      lc-object=EepEcucPartitionRef, lc-state=draft
      lc-object=EthCtrlEcucPartitionRef, lc-state=draft
      lc-object=EthEcucPartitionRef, lc-state=draft
      lc-object=EthSwtConfigEcucPartitionRef, lc-state=draft
      lc-object=EthSwtEcucPartitionRef, lc-state=draft
      lc-object=EthTSynGlobalTimeSecureTmacLength, lc-state=draft
      lc-object=EthTSynGlobalTimeMinMsgGap, lc-state=draft
      lc-object=EthTSynTxTmacCalculated, lc-state=draft
      lc-object=EthTSynRxTmacValidated, lc-state=draft
      lc-object=EthTrcvConfigEcucPartitionRef, lc-state=draft
      lc-object=EthTrcvEcucPartitionRef, lc-state=draft
      lc-object=FlsEcucPartitionRef, lc-state=draft
      lc-object=FlsTstEcucPartitionRef, lc-state=draft
      lc-object=FrEcucPartitionRef, lc-state=draft
      lc-object=FrCtrlEcucPartitionRef, lc-state=draft
      lc-object=FrTSynGlobalTimeSecureTmacLength, lc-state=draft
      lc-object=FrTSynUseExtendedMsgFormat, lc-state=draft
      lc-object=FrTSynTxTmacCalculated, lc-state=draft
      lc-object=FrTSynGlobalTimeMinMsgGap, lc-state=draft
      lc-object=FrTSynGlobalTimeTmacTimeout, lc-state=draft
      lc-object=FrTSynRxTmacValidated, lc-state=draft
      lc-object=FrTrcvChannelEcucPartitionRef, lc-state=draft
      lc-object=FrTrcvEcucPartitionRef, lc-state=draft
      lc-object=GptChannelEcucPartitionRef, lc-state=draft
      lc-object=GptEcucPartitionRef, lc-state=draft
      lc-object=GptKernelEcucPartitionRef, lc-state=draft
      lc-object=IcuChannelEcucPartitionRef, lc-state=draft
      lc-object=IcuEcucPartitionRef, lc-state=draft
      lc-object=IcuKernelEcucPartitionRef, lc-state=draft
      lc-object=IpduMContainedPduOffset, lc-state=draft
      lc-object=IpduMPduUpdateBitPosition, lc-state=draft
      lc-object=IpduMContainedPduOffset, lc-state=draft
      lc-object=IpduMPduUpdateBitPosition, lc-state=draft
      lc-object=IPDUM_HEADERTYPE_NONE, lc-state=draft
      lc-object=IPDUM_HEADERTYPE_NONE, lc-state=draft
      lc-object=IpduMUnusedAreasDefault, lc-state=draft
      lc-object=LinEcucPartitionRef, lc-state=draft
      lc-object=LinChannelEcucPartitionRef, lc-state=draft
      lc-object=LinTrcvChannelEcucPartitionRef, lc-state=draft
      lc-object=LinTrcvEcucPartitionRef, lc-state=draft
      lc-object=McuEcucPartitionRef, lc-state=draft
      lc-object=OcuChannelEcucPartitionRef, lc-state=draft
      lc-object=OcuEcucPartitionRef, lc-state=draft
      lc-object=OcuKernelEcucPartitionRef, lc-state=draft
      lc-object=PortPinEcucPartitionRef, lc-state=draft
      lc-object=PortEcucPartitionRef, lc-state=draft
      lc-object=PwmChannelEcucPartitionRef, lc-state=draft
      lc-object=PwmEcucPartitionRef, lc-state=draft
      lc-object=PwmKernelEcucPartitionRef, lc-state=draft
      lc-object=RamTstEcucPartitionRef, lc-state=draft
      lc-object=RamTstBlockParamsEcucPartitionRef, lc-state=draft
      lc-object=RteRipsFillRoutineRef, lc-state=draft
      lc-object=RteRipsFlushRoutineRef, lc-state=draft
      lc-object=RteBswExclusiveAreaResponsibleRipsPluginRef, lc-state=draft
      lc-object=RteModeMachineInstanceResponsibleRipsPluginRef, lc-state=draft
      lc-object=RteDSMQResponsibleRipsPluginRef, lc-state=draft
      lc-object=RteRips, lc-state=draft
      lc-object=RteRipsSupport, lc-state=draft
      lc-object=RteRipsPluginConfigurationRef, lc-state=draft
      lc-object=RteRipsFillRoutineRef, lc-state=draft
      lc-object=RteRipsFlushRoutineRef, lc-state=draft
      lc-object=RteRipsInvocationHandlerRef, lc-state=draft
      lc-object=RteExclusiveAreaResponsibleRipsPluginRef, lc-state=draft
      lc-object=RteModeMachineInstanceResponsibleRipsPluginRef, lc-state=draft
      lc-object=SoAdSocketTcpTlsConnectionRef, lc-state=draft
      lc-object=SpiDeviceEcucPartitionRef, lc-state=draft
      lc-object=SpiEcucPartitionRef, lc-state=draft
      lc-object=SpiKernelEcucPartitionRef, lc-state=draft
      lc-object=TcpIpTlsConfig, lc-state=draft
      lc-object=TcpIpTlsMaxConnections, lc-state=draft
      lc-object=TcpIpTlsCsmRandomGenerateJobRef, lc-state=draft
      lc-object=TcpIpTlsCiphersuites, lc-state=draft
      lc-object=TcpIpTlsCertificateIdentity, lc-state=draft
      lc-object=TcpIpTlsServerNameIdentification, lc-state=draft
      lc-object=TcpIpTlsCiphersuiteDefinition, lc-state=draft
      lc-object=TcpIpTlsCiphersuiteId, lc-state=draft
      lc-object=TcpIpTlsCiphersuiteName, lc-state=draft
      lc-object=TcpIpTlsCiphersuitePriority, lc-state=draft
      lc-object=TcpIpTlsUseAEADCipher, lc-state=draft
      lc-object=TcpIpTlsUsePresharedKeys, lc-state=draft
      lc-object=TcpIpTlsUseSecurityExtensionForceMacThenHash, lc-state=draft
      lc-object=TcpIpTlsVersion, lc-state=draft
      lc-object=TcpIpTlsCiphersuiteWorker, lc-state=draft
      lc-object=TcpIpTlsCipherAEADCipherKeyLength, lc-state=draft
      lc-object=TcpIpTlsCipherEncryptKeyLength, lc-state=draft
      lc-object=TcpIpTlsCipherMacKeyLength, lc-state=draft
      lc-object=TcpIpTlsCipherCsmDecryptJobRef, lc-state=draft
      lc-object=TcpIpTlsCipherCsmDecryptKeyRef, lc-state=draft
      lc-object=TcpIpTlsCipherCsmEncryptJobRef, lc-state=draft
      lc-object=TcpIpTlsCipherCsmEncryptKeyRef, lc-state=draft
      lc-object=TcpIpTlsCipherCsmMacGenerateJobRef, lc-state=draft
      lc-object=TcpIpTlsCipherCsmMacGenerateKeyRef, lc-state=draft
      lc-object=TcpIpTlsCipherCsmMacVerifyJobRef, lc-state=draft
      lc-object=TcpIpTlsCipherCsmMacVerifyKeyRef, lc-state=draft
      lc-object=TcpIpTlsCiphersuiteDefinitionRef, lc-state=draft
      lc-object=TcpIpTlsConnectionHandshakeRef, lc-state=draft
      lc-object=TcpIpTlsHandshake, lc-state=draft
      lc-object=TcpIpTlsCsmPRFSupportType, lc-state=draft
      lc-object=TcpIpTlsCsmHashVerifyJobRef, lc-state=draft
      lc-object=TcpIpTlsCsmKeyExchangeCalcPubValJobRef, lc-state=draft
      lc-object=TcpIpTlsCsmKeyExchangeCalcSecretJobRef, lc-state=draft
      lc-object=TcpIpTlsCsmKeyExchangeDecryptJobRef, lc-state=draft
      lc-object=TcpIpTlsCsmKeyExchangeDecryptKeyRef, lc-state=draft
      lc-object=TcpIpTlsCsmKeyExchangeEncryptJobRef, lc-state=draft
      lc-object=TcpIpTlsCsmKeyExchangeEncryptKeyRef, lc-state=draft
      lc-object=TcpIpTlsCsmKeyExchangeKeyRef, lc-state=draft
      lc-object=TcpIpTlsCsmKeyExchangeSignatureGenerateJobRef, lc-state=draft
      lc-object=TcpIpTlsCsmKeyExchangeSignatureGenerateKeyRef, lc-state=draft
      lc-object=TcpIpTlsCsmKeyExchangeSignatureVerifyJobRef, lc-state=draft
      lc-object=TcpIpTlsCsmKeyExchangeSignatureVerifyKeyRef, lc-state=draft
      lc-object=TcpIpTlsCsmMasterSecretKeyRef, lc-state=draft
      lc-object=TcpIpTlsCsmPrfMacJobRef, lc-state=draft
      lc-object=TcpIpTlsCsmPrfMacKeyRef, lc-state=draft
      lc-object=TcpIpTlsPskIdentity, lc-state=draft
      lc-object=TcpIpTlsPresharedKeyIdentity, lc-state=draft
      lc-object=TcpIpTlsPresharedKeyIdentityHint, lc-state=draft
      lc-object=TcpIpTlsPskGetClientKeyIdentityFunc, lc-state=draft
      lc-object=TcpIpTlsPskGetKeyIdentyHintFunc, lc-state=draft
      lc-object=TcpIpTlsPskGetServerKeyIdentityFunc, lc-state=draft
      lc-object=TcpIpTlsPresharedKeyCsmKeyRef, lc-state=draft
      lc-object=TcpIpTlsConnection, lc-state=draft
      lc-object=TcpIpTlsConnectionGetTimeFunc, lc-state=draft
      lc-object=TcpIpTlsConnectionId, lc-state=draft
      lc-object=TcpIpTlsConnectionType, lc-state=draft
      lc-object=TcpIpTlsMaxFragmentLength, lc-state=draft
      lc-object=TcpIpTlsPortAssignment, lc-state=draft
      lc-object=TcpIpTlsUseClientAuthenticationRequest, lc-state=draft
      lc-object=TcpIpTlsUseSecurityExtensionRecordSizeLimit, lc-state=draft
      lc-object=TcpIpTlsCertificateIdentityRef, lc-state=draft
      lc-object=TcpIpTlsConnectionCiphersuiteWorkerRef, lc-state=draft
      lc-object=TcpIpTlsConnectionGroupRef, lc-state=draft
      lc-object=TcpIpTlsConnectionPskIdentityRef, lc-state=draft
      lc-object=TcpIpTlsIpAddressAssignment, lc-state=draft
      lc-object=TcpIpTlsConnectionGroup, lc-state=draft
      lc-object=WEthCtrlEcucPartitionRef, lc-state=draft
      lc-object=WEthEcucPartitionRef, lc-state=draft
      lc-object=WEthTrcvConfigEcucPartitionRef, lc-state=draft
      lc-object=WEthTrcvEcucPartitionRef, lc-state=draft
      lc-object=WdgEcucPartitionRef, lc-state=draft
