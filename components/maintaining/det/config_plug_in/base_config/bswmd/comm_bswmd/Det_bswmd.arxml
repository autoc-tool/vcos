AUTOSAR XML (schema 00046)
package /AUTOSAR/EcucDefs
  module definition Det [0..1]: variants pre-compile  # Det configuration includes the functions to be called at notification. On one / 概述：Det（Development Error Tracer）模块用于在AUTOSAR系统中提供开发时错误跟踪功能，它记录软件模块在运行时发生的开发错误，并提供错误报告机制。 注意：在AUTOSAR CP 4.4标准中，Det模块的配置应确保与系统的错误处理策略一致；Det模块通常在开发和测试阶段使用，而在生产环境中可能被禁用或配置为最小化资源占用；配置Det时，应注意不同错误级别的区分和相应的错误处理动作。 | side the application functions are specified and in general it can be decided whether Dlt shall be called at each call of Det.
    container DetConfigSet [0..1]  # Configuration set container for Det. / 概述：DetConfigSet是用于定义诊断事件管理器（Diagnostic Event Manager, DEM）的配置集，包括错误存储、事件记录和错误处理策略等。 注意：DetConfigSet必须与系统中实际的错误处理需求相匹配，确保所有预期的诊断事件都能被正确管理和记录；在多配置系统中，每个配置集应当独立定义，避免配置间的冲突；AUTOSAR CP 4.4标准要求明确每个诊断事件的处理策略，以保证系统的稳定性和可靠性。
      container DetModule [0..*]  # This container describes a non BSW module that is using the Det via Service Interface. / 概述：DetModule配置项用于定义诊断事件管理器模块（Diagnostic Event Manager Module）的属性，这包括错误记录、错误报告以及与其他模块的交互方式等。 注意：DetModule配置需要与系统中的诊断需求和策略紧密对应，确保错误处理和报告机制的一致性；在配置DetModule时，需注意其与其他模块（如Dem）的接口匹配和数据交换协议；AUTOSAR CP 4.4标准中对Det的具体实现细节和配置选项可能有所更新，需参考最新的标准文档进行配置。
        integer DetModuleId: 4096..65535, set at pre-compile, symbolic-name-value=true  # Unique identifier of the error reporting component. When reporting errors to the DET, a symbolic name derived from the moduleID has to be used to identify the reporter. / 概述：DetModuleId 用于标识开发错误跟踪（Development Error Tracer, DET）模块的唯一标识符，用于错误记录和诊断。 注意：确保每个DetModuleId在整个项目中是唯一的，以避免错误诊断信息的混淆；在配置时应参照AUTOSAR标准中定义的模块ID范围；不正确的模块ID配置可能导致错误追踪功能失效。
        container DetModuleInstance [1..255]: multiplicity set at pre-compile, post-build-variant-multiplicity=true  # Describes the Instance used for the according Service Port. / 概述：DetModuleInstance配置项用于定义诊断事件管理器（Diagnostic Event Manager, DEM）中的模块实例，它关联了特定的错误识别码和模块，以便于错误的监控和报告。 注意：在AUTOSAR CP 4.4标准中，确保每个DetModuleInstance配置的模块名称和错误识别码的组合是唯一的，以避免诊断信息的冲突；模块实例的配置应与系统中实际的软件模块和其错误处理策略相对应；在配置过程中，应注意与DEM的交互和集成要求，确保错误信息能够正确地被DEM管理和报告。 | It shall be used to differentiate software component instances when multiple instantiation is used.
          integer DetInstanceId: 0..255, set at pre-compile, default-value=0  # Describes the InstanceId used for the according Service Port. / 概述：DetInstanceId用于标识开发错误跟踪（Development Error Tracer, DET）模块中的实例ID，允许系统区分和管理不同DET实例的错误记录。 注意：在配置DetInstanceId时，确保每个DET模块实例的ID是唯一的，以避免错误记录的混淆；AUTOSAR CP 4.4标准中可能对DET实例的最大数量有限制，需要根据具体的标准文档进行确认；在多模块系统中，合理分配实例ID以便于错误追踪和系统调试。 | It shall be used to differentiate software component instances when multiple instantiation is used. Else it shall be set to 0.
    container DetGeneral  # Generic configuration parameters of the Det module. / 概述：DetGeneral是AUTOSAR开发中的一个配置参数，用于定义开发错误检测（Development Error Tracer, DET）模块的一般属性，如版本信息和错误记录机制。 注意：确保DetGeneral中的版本信息与实际AUTOSAR版本一致；错误记录机制的配置应考虑系统资源和性能要求；在配置错误记录级别时，需平衡开发调试的需求和系统的运行效率。
      boolean DetForwardToDlt [0..1]: multiplicity set at pre-compile, set at pre-compile  # Only if the parameter is present and set to true, the Det requires the Dlt interface and forwards it's call to the function Dlt_DetForwardErrorTrace. In this case the optional interface to Dlt_Det is required. / 概述：DetForwardToDlt配置项用于决定是否将开发错误追踪（Development Error Tracer, DET）报告的错误信息转发到诊断日志和追踪（Diagnostic Log and Trace, DLT）模块。 注意：在AUTOSAR CP 4.4中，确保DLT模块已配置且激活以支持错误信息的接收和处理；转发功能的启用可能会影响系统性能，特别是在错误频繁发生时；配置时需考虑系统的诊断策略和性能要求。
      boolean DetVersionInfoApi: set at pre-compile, default-value=false  # Pre-processor switch to enable / disable the API to read out the modules version information. / 概述：DetVersionInfoApi 是一个配置参数，用于启用或禁用开发错误跟踪器（Development Error Tracer, DET）模块中的版本信息API，该API允许获取模块的版本信息，如供应商ID、模块版本等。 注意：在AUTOSAR CP 4.4标准中，如果启用了该配置项，则必须实现相应的版本信息接口函数；如果不需要模块版本信息，可以禁用以节省资源；确保与其他模块的版本信息获取方式保持一致性。 | true: Version info API enabled. false: Version info API disabled.
      boolean FlowControlEnable: scope=ECU, set at pre-compile, default-value=false  # Monitor whether it is enabled. / 概述：该监控项目是否使能
      integer DetTokenNum: 1..65536, set at pre-compile, default-value=20  # The upper limit of the number of Det that a single module can print per unit time / 概述：det默认的令牌桶数量 注意：需要配合令牌桶进行使用
      enumeration DetTokenPeriod: {256, 512, 1024, 2048, 4096, 8192}, multiplicity set at pre-compile, set at pre-compile, default-value=1024  # The upper limit of the number of Det that a single module can print per unit time / 概述：配置Det令牌桶的周期 注意：需要配合ModuleTokenNum配置项使用，ModuleTokenNum用于Det令牌桶的个数
      container DetFlowControl [0..255]  # The DetFlowControl configuration item is used to determine whether to enable Det data flow control. After the configuration is enabled, the NumberOfDets configurations will take effect. / 概述：DetFlowControl配置项用于决定是否Det数据流量控制，配置开启后，NumberOfDets和PerMillisecond两个配置将生效。 注意：当出现大规模Det上报时，超出配置项的Det数据将被忽略，且该流控功能会在该场景下比非开启时，多消耗CPU负载资源。
        foreign reference ModuleRef [0..1]: set at pre-compile, destination-type=ECUC-MODULE-CONFIGURATION-VALUES  # Foreign reference to the configuration of a module instance which shall be initialized by Det / 概述：ModuleRef 配置项用于指定需要det限流的ECU管理模块 注意：确保所有引用的模块在系统中已定义且可用。
        integer ModuleTokenNum: 1..255, set at pre-compile, default-value=10  # The upper limit of the number of Det that a single module can print per unit time / 概述：单位时间内，单一模块可以打印Det的数量上限 注意：需要配合PerMillisecond配置项使用，PerMillisecond用于配置单位时间的值
        boolean ModuleDetFlowControl [0..1]: multiplicity set at link in variant link-time+post-build / pre-compile in variant pre-compile, set at link in variant link-time+post-build / pre-compile in variant pre-compile, default-value=false  # Selects STANDBY (true) or SLEEP (false) transceiver mode when entering LINSM_NO_COM. / 概述：配置模块flow的开关。 注意：各模块flow控制的开关。
    container DetNotification [0..1]  # Configuration of the notification functions. / 概述：DetNotification用于定义诊断事件管理器（Diagnostic Event Manager, DEM）在检测到特定错误时，通知开发错误跟踪（Development Error Tracer, DET）的机制。 注意：在AUTOSAR CP 4.4中，确保DetNotification配置与DEM和DET模块的交互逻辑一致；配置时需注意错误级别和通知策略，以避免过多的性能开销；此配置项对于错误诊断和系统稳定性至关重要，需谨慎处理。
      string DetErrorHook [0..65535]: multiplicity set at pre-compile, set at pre-compile  # Optional list of functions to be called by the Default Error Tracer in context of each call of Det_ReportError. / 概述：DetErrorHook是一个配置项，用于定义是否启用开发错误跟踪（Development Error Tracer, DET）的错误钩子函数，该函数在检测到开发时错误时被调用。 注意：在AUTOSAR CP 4.4中，启用DetErrorHook可能会影响系统性能，因为每次错误检测都会调用该钩子函数；确保错误处理逻辑不会引入新的错误或异常；在资源受限的系统中谨慎使用，以避免过多消耗CPU时间和内存。 | The type of these functions shall be identical the type of Det_ReportError itself: Std_ReturnType (*f)(uint16, uint8, uint8, uint8).
      string DetReportRuntimeErrorCallout [0..65535]: set at pre-compile  # This parameter defines the existence and the names of callout functions for the corresponding runtime error handler. / 概述：DetReportRuntimeErrorCallout 是一个配置项，用于定义在检测到运行时错误时调用的回调函数。 注意：确保回调函数符合AUTOSAR CP 4.4标准中对错误处理函数的要求；回调函数需要能够处理所有传入的错误参数；避免在回调函数中执行复杂或耗时的操作，以免影响系统性能。 | The type of these functions shall be identical the type of Det_ReportRuntimeError itself: Std_ReturnType (*f)(uint16, uint8, uint8, uint8)
      string DetReportTransientFaultCallout [0..65535]: set at pre-compile  # This parameter defines the existence and the names of callout functions for the corresponding transient fault handler. / 概述：DetReportTransientFaultCallout 是一个配置项，用于定义在检测到瞬态故障时调用的回调函数。 注意：确保回调函数符合AUTOSAR CP 4.4标准中对错误处理和回调机制的要求；回调函数应具备高效处理故障的能力，避免影响系统性能；在多核或多任务环境中，确保回调函数的线程安全性。 | The type of these functions shall be identical the type of Det_ReportTransientFault itself: Std_ReturnType (*f)(uint16, uint8, uint8, uint8)
package /AUTOSAR/EcucDestinationUriDefSets
  ecuc destination uri def set RteRipsUriDefSet
    ecuc destination uri def RteRipsInvocationHandler
      destination-uri-policy destination-uri-nesting-contract=TARGET-CONTAINER:
        container RteRipsInvocationHandlerFnc [0..*]  # This container describes an invocation handler function implemented by an RTE Implementation Plug-In to handle the invocation of server runnables and triggered runnables via a transformer. Tags: atp.Status=draft / 概述：RteRipsInvocationHandlerFnc是一个配置项，用于指定RTE（Runtime Environment）中的RIPS（RTE Invocation Processing Scheme）调用处理函数，该函数负责管理组件间的方法调用和事件机制。 注意：在配置RteRipsInvocationHandlerFnc时，需要确保所指定的处理函数与系统中实际的调用处理逻辑相匹配；此外，处理函数应当遵循AUTOSAR CP标准中对于方法调用和事件处理的规定；在多核或多分区系统中，还需考虑跨核或跨分区调用的一致性和同步问题。
          function name RteRipsInvocationHandlerFncSymbol  # C-Symbol of the Rte_Rips_FillFlushRoutine function. Tags: atp.Status=draft / 概述：RteRipsInvocationHandlerFncSymbol是用于定义RTE生成代码中，某个RIPS（Receiver Interface Proxy Sw-Component）调用处理函数的符号名称，这使得RTE层可以通过这个符号来调用底层软件组件的具体实现。 注意：该配置项的命名需要遵循项目或组织的命名规范，以确保一致性和可读性；符号名称应唯一，避免在项目中出现重名导致的调用错误；在AUTOSAR CP 4.4标准中，对于RIPS的具体实现和调用机制有详细规定，需要确保配置项与标准保持一致。
    ecuc destination uri def RteRipsPlugin
      destination-uri-policy destination-uri-nesting-contract=TARGET-CONTAINER:
        container RteRipsPluginProps  # This container defines the identity of the Rte Implementation Plug-in and provides the RTE relevant parameters of the Rte Implementation Plug-in. Tags: atp.Status=draft / 概述：RteRipsPluginProps 是一个配置项，用于定义RTE生成代码时所需的插件属性，这些属性可能会影响代码生成的行为或者输出。 注意：在配置RteRipsPluginProps时，需要确保所选插件与AUTOSAR CP 4.4标准兼容；插件的配置参数应当根据项目需求和规范仔细选择，以避免生成不符合预期的代码；在多供应商环境中，还需确保插件的配置不会引起供应商间的兼容性问题。 | The shortName of the container defines the name of the Rte Implementation Plug-in used for the API infixes.
          boolean RtePluginSupportsIReadIWrite: default-value=false  # Denotes if or if not the plug-in supports the Rte_Rips_IRead/IWrite macros for primitive data. Tags: atp.Status=draft / 概述：RtePluginSupportsIReadIWrite配置项用于指定RTE生成代码时是否支持IRead和IWrite接口，这些接口用于简化组件间的数据读写操作。 注意：在AUTOSAR CP 4.4标准中，对于IRead和IWrite接口的支持是可选的，因此开发者需要根据项目需求决定是否启用此配置；启用IRead和IWrite可能会影响生成代码的大小和性能；确保在项目早期阶段确定此配置，以避免后期重大架构更改。
          enumeration RteRipsGlobalCopyInstantiationPolicy: {RTE_RIPS_INSTANTIATION_BY_PLUGIN, RTE_RIPS_INSTANTIATION_BY_RTE}, default-value=RTE_RIPS_INSTANTIATION_BY_RTE  # Globally enables or disables the support for Rte Implementation Plug-Ins (RIPS) Tags: atp.Status=draft / 概述：RteRipsGlobalCopyInstantiationPolicy配置项用于定义AUTOSAR RTE（Run-Time Environment）中，针对RteRips（Receiver Interface Prototype Sender）全局数据拷贝的实例化策略，决定如何在组件间传递数据。 注意：在AUTOSAR CP 4.4标准中，对于RteRipsGlobalCopyInstantiationPolicy的具体定义和使用可能有所不同或未直接提及，因此在应用此配置项时需参考最新的AUTOSAR文档和工具链支持情况；正确配置此项对于优化数据传输效率和系统性能至关重要；需注意与其他数据传输策略（如直接接口调用）的兼容性和选择。
    ecuc destination uri def RteRipsPluginFillFlushRoutine
      destination-uri-policy destination-uri-nesting-contract=TARGET-CONTAINER:
        container RteRipsPluginFillFlushRoutineFnc [0..*]  # This container describes a Fill-Flush Routine function implemented by a RTE Implementation Plug-In to handle the buffering for implicit communication. Tags: atp.Status=draft / 概述：RteRipsPluginFillFlushRoutineFnc是一个配置项，用于指定RTE与底层硬件交互时，填充和刷新数据的插件函数。 注意：在配置该项时，需要确保所指定的函数符合AUTOSAR CP 4.4标准中对于数据填充和刷新例程的要求；此外，函数的实现必须保证线程安全和可重入性；最后，该函数应当与硬件抽象层(HAL)或复杂驱动的实现紧密协作，以确保数据的正确传输。
          enumeration RteRipsModeDisablingHandling: {RTE_RIPS_CONSIDER_MODE_DISABLINGS, RTE_RIPS_IGNORE_MODE_DISABLINGS}  # This parameter configures whether mode disabling dependencies are considered for the invocation of Rte_Rips_FillFlushRoutines. Tags: atp.Status=draft / 概述：RteRipsModeDisablingHandling 配置项用于定义如何处理因模式禁用导致的Runnable的启动或停止。 注意：在配置此项时，需要确保与系统的模式管理策略一致；此配置项在AUTOSAR CP 4.4中应详细考虑模式依赖的Runnable的行为；不正确的配置可能导致系统行为不符合预期，特别是在模式切换时。
          enumeration RteRipsOsSchedulePoint [0..1]: {NONE, UNCONDITIONAL}  # Introduce a schedule point by explicitly calling Os Schedule service after the execution of the Rte_Rips_FillFlushRoutine. Tags: atp.Status=draft / 概述：RteRipsOsSchedulePoint 配置项用于定义AUTOSAR RTE（Runtime Environment）中的调度点，这些调度点是RTE与操作系统(OS)交互的同步点，用于管理Runnable实体的执行和OS任务的调度。 注意：在配置RteRipsOsSchedulePoint时，需要确保调度点与操作系统任务和中断正确对齐，以便于实现预期的调度行为；调度点的配置应遵循AUTOSAR OS模块的时间分区和任务配置要求；在多核系统中，还需考虑调度点在不同核心间的同步和一致性问题。
          function name RteRipsPluginFillFlushRoutineFncSymbol  # C-Symbol of the Rte_Rips_FillFlushRoutine function. Tags: atp.Status=draft / 概述：RteRipsPluginFillFlushRoutineFncSymbol 是用于指定RTE生成代码中，RIPS插件的填充和刷新例程的函数符号名称。 注意：确保函数符号名称的唯一性和正确性，以避免在链接时发生符号冲突；该符号名称应与实际实现的函数名称一致，以确保正确调用；在多插件环境中，每个插件应有不同的符号名称，以保持清晰的模块界限。
package /AUTOSAR/LifeCycleInfoSets
  life cycle info set AUTOSARParameterDefinition
    life-cycle-infos:
      lc-object=AdcGroupEcucPartitionRef, lc-state=draft
      lc-object=AdcEcucPartitionRef, lc-state=draft
      lc-object=AdcKernelEcucPartitionRef, lc-state=draft
      lc-object=ArtiConstant, lc-state=draft
      lc-object=ArtiConstantString, lc-state=draft
      lc-object=ArtiExpression, lc-state=draft
      lc-object=ArtiExpressionString, lc-state=draft
      lc-object=ArtiHook, lc-state=draft
      lc-object=ArtiHookClass, lc-state=draft
      lc-object=ArtiHookEventName, lc-state=draft
      lc-object=ArtiHookInstance, lc-state=draft
      lc-object=ArtiHookEventParameterTypeRef, lc-state=draft
      lc-object=ArtiHookInstanceParameterTypeRef, lc-state=draft
      lc-object=ArtiObjectClassParameter, lc-state=draft
      lc-object=ArtiParameterTypeMapRef, lc-state=draft
      lc-object=ArtiObjectInstanceParameter, lc-state=draft
      lc-object=ArtiConstantRef, lc-state=draft
      lc-object=ArtiExpressionRef, lc-state=draft
      lc-object=ArtiHookRef, lc-state=draft
      lc-object=ArtiParameterTypeMap, lc-state=draft
      lc-object=ArtiParameterTypeMapPair, lc-state=draft
      lc-object=ArtiParameterTypeMapPairInput, lc-state=draft
      lc-object=ArtiParameterTypeMapPairOutput, lc-state=draft
      lc-object=ArtiGenericComponentClass, lc-state=draft
      lc-object=ArtiGenericComponentClassName, lc-state=draft
      lc-object=ArtiGenericComponentClassParameter, lc-state=draft
      lc-object=ArtiGenericComponentClassParameterName, lc-state=draft
      lc-object=ArtiParameterTypeMapRef, lc-state=draft
      lc-object=ArtiGenericComponentInstance, lc-state=draft
      lc-object=ArtiGenericComponentInstanceName, lc-state=draft
      lc-object=ArtiGenericComponentClassRef, lc-state=draft
      lc-object=ArtiGenericComponentInstanceParameter, lc-state=draft
      lc-object=ArtiConstantRef, lc-state=draft
      lc-object=ArtiExpressionRef, lc-state=draft
      lc-object=ArtiGenericComponentClassParameterRef, lc-state=draft
      lc-object=ArtiHookRef, lc-state=draft
      lc-object=ArtiHwCoreClass, lc-state=draft
      lc-object=ArtiCurrentApplicationClassRef, lc-state=draft
      lc-object=ArtiCurrentTaskClassRef, lc-state=draft
      lc-object=ArtiLastErrorClassRef, lc-state=draft
      lc-object=ArtiHwCoreInstance, lc-state=draft
      lc-object=ArtiCurrentApplicationInstanceRef, lc-state=draft
      lc-object=ArtiCurrentTaskInstanceRef, lc-state=draft
      lc-object=ArtiEcucCoreRef, lc-state=draft
      lc-object=ArtiLastErrorInstanceRef, lc-state=draft
      lc-object=ArtiOsClass, lc-state=draft
      lc-object=ArtiOsAppModeClassRef, lc-state=draft
      lc-object=ArtiOsInstance, lc-state=draft
      lc-object=ArtiOsAppModeEcucRef, lc-state=draft
      lc-object=ArtiOsAppModeInstanceRef, lc-state=draft
      lc-object=ArtiOsEcucRef, lc-state=draft
      lc-object=ArtiOsTaskHookRef, lc-state=draft
      lc-object=ArtiOsTaskClass, lc-state=draft
      lc-object=ArtiOsTaskInstance, lc-state=draft
      lc-object=ArtiGenericComponentInstanceRef, lc-state=draft
      lc-object=ArtiOsTaskEcucRef, lc-state=draft
      lc-object=CanControllerEcucPartitionRef, lc-state=draft
      lc-object=CanTTControllerEcucPartitionRef, lc-state=draft
      lc-object=CanEcucPartitionRef, lc-state=draft
      lc-object=CanTSynGlobalTimeSecureTmacLength, lc-state=draft
      lc-object=CanTSynTxTmacCalculated, lc-state=draft
      lc-object=CanTSynGlobalTimeMinMsgGap, lc-state=draft
      lc-object=CanTSynRxTmacValidated, lc-state=draft
      lc-object=CanTrcvChannelEcucPartitionRef, lc-state=draft
      lc-object=CanTrcvEcucPartitionRef, lc-state=draft
      lc-object=CorTstBackgroundEcucPartitionRef, lc-state=draft
      lc-object=CorTstForegroundEcucPartitionRef, lc-state=draft
      lc-object=CorTstEcucPartitionRef, lc-state=draft
      lc-object=CryptoDriverObjectEcucPartitionRef, lc-state=draft
      lc-object=CryptoEcucPartitionRef, lc-state=draft
      lc-object=DemFreezeFrameRecordTrigger, lc-state=draft
      lc-object=DioPortEcucPartitionRef, lc-state=draft
      lc-object=DioChannelEcucPartitionRef, lc-state=draft
      lc-object=DioChannelGroupEcucPartitionRef, lc-state=draft
      lc-object=DioEcucPartitionRef, lc-state=draft
      lc-object=EepEcucPartitionRef, lc-state=draft
      lc-object=EthCtrlEcucPartitionRef, lc-state=draft
      lc-object=EthEcucPartitionRef, lc-state=draft
      lc-object=EthSwtConfigEcucPartitionRef, lc-state=draft
      lc-object=EthSwtEcucPartitionRef, lc-state=draft
      lc-object=EthTSynGlobalTimeSecureTmacLength, lc-state=draft
      lc-object=EthTSynGlobalTimeMinMsgGap, lc-state=draft
      lc-object=EthTSynTxTmacCalculated, lc-state=draft
      lc-object=EthTSynRxTmacValidated, lc-state=draft
      lc-object=EthTrcvConfigEcucPartitionRef, lc-state=draft
      lc-object=EthTrcvEcucPartitionRef, lc-state=draft
      lc-object=FlsEcucPartitionRef, lc-state=draft
      lc-object=FlsTstEcucPartitionRef, lc-state=draft
      lc-object=FrEcucPartitionRef, lc-state=draft
      lc-object=FrCtrlEcucPartitionRef, lc-state=draft
      lc-object=FrTSynGlobalTimeSecureTmacLength, lc-state=draft
      lc-object=FrTSynUseExtendedMsgFormat, lc-state=draft
      lc-object=FrTSynTxTmacCalculated, lc-state=draft
      lc-object=FrTSynGlobalTimeMinMsgGap, lc-state=draft
      lc-object=FrTSynGlobalTimeTmacTimeout, lc-state=draft
      lc-object=FrTSynRxTmacValidated, lc-state=draft
      lc-object=FrTrcvChannelEcucPartitionRef, lc-state=draft
      lc-object=FrTrcvEcucPartitionRef, lc-state=draft
      lc-object=GptChannelEcucPartitionRef, lc-state=draft
      lc-object=GptEcucPartitionRef, lc-state=draft
      lc-object=GptKernelEcucPartitionRef, lc-state=draft
      lc-object=IcuChannelEcucPartitionRef, lc-state=draft
      lc-object=IcuEcucPartitionRef, lc-state=draft
      lc-object=IcuKernelEcucPartitionRef, lc-state=draft
      lc-object=IpduMContainedPduOffset, lc-state=draft
      lc-object=IpduMPduUpdateBitPosition, lc-state=draft
      lc-object=IpduMContainedPduOffset, lc-state=draft
      lc-object=IpduMPduUpdateBitPosition, lc-state=draft
      lc-object=IPDUM_HEADERTYPE_NONE, lc-state=draft
      lc-object=IPDUM_HEADERTYPE_NONE, lc-state=draft
      lc-object=IpduMUnusedAreasDefault, lc-state=draft
      lc-object=LinEcucPartitionRef, lc-state=draft
      lc-object=LinChannelEcucPartitionRef, lc-state=draft
      lc-object=LinTrcvChannelEcucPartitionRef, lc-state=draft
      lc-object=LinTrcvEcucPartitionRef, lc-state=draft
      lc-object=McuEcucPartitionRef, lc-state=draft
      lc-object=OcuChannelEcucPartitionRef, lc-state=draft
      lc-object=OcuEcucPartitionRef, lc-state=draft
      lc-object=OcuKernelEcucPartitionRef, lc-state=draft
      lc-object=PortPinEcucPartitionRef, lc-state=draft
      lc-object=PortEcucPartitionRef, lc-state=draft
      lc-object=PwmChannelEcucPartitionRef, lc-state=draft
      lc-object=PwmEcucPartitionRef, lc-state=draft
      lc-object=PwmKernelEcucPartitionRef, lc-state=draft
      lc-object=RamTstEcucPartitionRef, lc-state=draft
      lc-object=RamTstBlockParamsEcucPartitionRef, lc-state=draft
      lc-object=RteRipsFillRoutineRef, lc-state=draft
      lc-object=RteRipsFlushRoutineRef, lc-state=draft
      lc-object=RteBswExclusiveAreaResponsibleRipsPluginRef, lc-state=draft
      lc-object=RteModeMachineInstanceResponsibleRipsPluginRef, lc-state=draft
      lc-object=RteDSMQResponsibleRipsPluginRef, lc-state=draft
      lc-object=RteRips, lc-state=draft
      lc-object=RteRipsSupport, lc-state=draft
      lc-object=RteRipsPluginConfigurationRef, lc-state=draft
      lc-object=RteRipsFillRoutineRef, lc-state=draft
      lc-object=RteRipsFlushRoutineRef, lc-state=draft
      lc-object=RteRipsInvocationHandlerRef, lc-state=draft
      lc-object=RteExclusiveAreaResponsibleRipsPluginRef, lc-state=draft
      lc-object=RteModeMachineInstanceResponsibleRipsPluginRef, lc-state=draft
      lc-object=SoAdSocketTcpTlsConnectionRef, lc-state=draft
      lc-object=SpiDeviceEcucPartitionRef, lc-state=draft
      lc-object=SpiEcucPartitionRef, lc-state=draft
      lc-object=SpiKernelEcucPartitionRef, lc-state=draft
      lc-object=TcpIpTlsConfig, lc-state=draft
      lc-object=TcpIpTlsMaxConnections, lc-state=draft
      lc-object=TcpIpTlsCsmRandomGenerateJobRef, lc-state=draft
      lc-object=TcpIpTlsCiphersuites, lc-state=draft
      lc-object=TcpIpTlsCertificateIdentity, lc-state=draft
      lc-object=TcpIpTlsServerNameIdentification, lc-state=draft
      lc-object=TcpIpTlsCiphersuiteDefinition, lc-state=draft
      lc-object=TcpIpTlsCiphersuiteId, lc-state=draft
      lc-object=TcpIpTlsCiphersuiteName, lc-state=draft
      lc-object=TcpIpTlsCiphersuitePriority, lc-state=draft
      lc-object=TcpIpTlsUseAEADCipher, lc-state=draft
      lc-object=TcpIpTlsUsePresharedKeys, lc-state=draft
      lc-object=TcpIpTlsUseSecurityExtensionForceMacThenHash, lc-state=draft
      lc-object=TcpIpTlsVersion, lc-state=draft
      lc-object=TcpIpTlsCiphersuiteWorker, lc-state=draft
      lc-object=TcpIpTlsCipherAEADCipherKeyLength, lc-state=draft
      lc-object=TcpIpTlsCipherEncryptKeyLength, lc-state=draft
      lc-object=TcpIpTlsCipherMacKeyLength, lc-state=draft
      lc-object=TcpIpTlsCipherCsmDecryptJobRef, lc-state=draft
      lc-object=TcpIpTlsCipherCsmDecryptKeyRef, lc-state=draft
      lc-object=TcpIpTlsCipherCsmEncryptJobRef, lc-state=draft
      lc-object=TcpIpTlsCipherCsmEncryptKeyRef, lc-state=draft
      lc-object=TcpIpTlsCipherCsmMacGenerateJobRef, lc-state=draft
      lc-object=TcpIpTlsCipherCsmMacGenerateKeyRef, lc-state=draft
      lc-object=TcpIpTlsCipherCsmMacVerifyJobRef, lc-state=draft
      lc-object=TcpIpTlsCipherCsmMacVerifyKeyRef, lc-state=draft
      lc-object=TcpIpTlsCiphersuiteDefinitionRef, lc-state=draft
      lc-object=TcpIpTlsConnectionHandshakeRef, lc-state=draft
      lc-object=TcpIpTlsHandshake, lc-state=draft
      lc-object=TcpIpTlsCsmPRFSupportType, lc-state=draft
      lc-object=TcpIpTlsCsmHashVerifyJobRef, lc-state=draft
      lc-object=TcpIpTlsCsmKeyExchangeCalcPubValJobRef, lc-state=draft
      lc-object=TcpIpTlsCsmKeyExchangeCalcSecretJobRef, lc-state=draft
      lc-object=TcpIpTlsCsmKeyExchangeDecryptJobRef, lc-state=draft
      lc-object=TcpIpTlsCsmKeyExchangeDecryptKeyRef, lc-state=draft
      lc-object=TcpIpTlsCsmKeyExchangeEncryptJobRef, lc-state=draft
      lc-object=TcpIpTlsCsmKeyExchangeEncryptKeyRef, lc-state=draft
      lc-object=TcpIpTlsCsmKeyExchangeKeyRef, lc-state=draft
      lc-object=TcpIpTlsCsmKeyExchangeSignatureGenerateJobRef, lc-state=draft
      lc-object=TcpIpTlsCsmKeyExchangeSignatureGenerateKeyRef, lc-state=draft
      lc-object=TcpIpTlsCsmKeyExchangeSignatureVerifyJobRef, lc-state=draft
      lc-object=TcpIpTlsCsmKeyExchangeSignatureVerifyKeyRef, lc-state=draft
      lc-object=TcpIpTlsCsmMasterSecretKeyRef, lc-state=draft
      lc-object=TcpIpTlsCsmPrfMacJobRef, lc-state=draft
      lc-object=TcpIpTlsCsmPrfMacKeyRef, lc-state=draft
      lc-object=TcpIpTlsPskIdentity, lc-state=draft
      lc-object=TcpIpTlsPresharedKeyIdentity, lc-state=draft
      lc-object=TcpIpTlsPresharedKeyIdentityHint, lc-state=draft
      lc-object=TcpIpTlsPskGetClientKeyIdentityFunc, lc-state=draft
      lc-object=TcpIpTlsPskGetKeyIdentyHintFunc, lc-state=draft
      lc-object=TcpIpTlsPskGetServerKeyIdentityFunc, lc-state=draft
      lc-object=TcpIpTlsPresharedKeyCsmKeyRef, lc-state=draft
      lc-object=TcpIpTlsConnection, lc-state=draft
      lc-object=TcpIpTlsConnectionGetTimeFunc, lc-state=draft
      lc-object=TcpIpTlsConnectionId, lc-state=draft
      lc-object=TcpIpTlsConnectionType, lc-state=draft
      lc-object=TcpIpTlsMaxFragmentLength, lc-state=draft
      lc-object=TcpIpTlsPortAssignment, lc-state=draft
      lc-object=TcpIpTlsUseClientAuthenticationRequest, lc-state=draft
      lc-object=TcpIpTlsUseSecurityExtensionRecordSizeLimit, lc-state=draft
      lc-object=TcpIpTlsCertificateIdentityRef, lc-state=draft
      lc-object=TcpIpTlsConnectionCiphersuiteWorkerRef, lc-state=draft
      lc-object=TcpIpTlsConnectionGroupRef, lc-state=draft
      lc-object=TcpIpTlsConnectionPskIdentityRef, lc-state=draft
      lc-object=TcpIpTlsIpAddressAssignment, lc-state=draft
      lc-object=TcpIpTlsConnectionGroup, lc-state=draft
      lc-object=WEthCtrlEcucPartitionRef, lc-state=draft
      lc-object=WEthEcucPartitionRef, lc-state=draft
      lc-object=WEthTrcvConfigEcucPartitionRef, lc-state=draft
      lc-object=WEthTrcvEcucPartitionRef, lc-state=draft
      lc-object=WdgEcucPartitionRef, lc-state=draft
