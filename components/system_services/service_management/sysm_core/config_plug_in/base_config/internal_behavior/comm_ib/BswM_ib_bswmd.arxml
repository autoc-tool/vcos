AUTOSAR XML (schema 00048)
package /AUTOSAR/BswM_ib_bswmd/BswModuleDescriptions
  bsw module description BswM: provided-entrys=bswm_mainfunction
    bsw internal behavior BswMBehavior
      exclusive area BSWM_EXCLUSIVE_AREA_0
      bsw schedulable entity bswm_mainfunction: implemented-entry=bswm_mainfunction
      bsw timing event BswM_MainFunctionTimingEvent0: starts-on-event=bswm_mainfunction, period=0.01
  bsw module entry bswm_mainfunction: call-type=SCHEDULED, execution-context=TASK
