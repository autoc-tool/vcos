AUTOSAR XML (schema 00046)
package /ActiveEcuC
  module config EcuM: implementation-config-variant=VARIANT-PRE-COMPILE, module-description=EcuM_Impl
    EcuMGeneral: EcuMDevErrorDetect=false, EcuMIncludeDet=false, EcuMVersionInfoApi=false, EcuMMainFunctionPeriod=0.01
    EcuMFlexGeneral:
      EcuMAlarmClockPresent = false
      EcuMModeHandling = false
      EcuMResetLoopDetection = false
      EcuMSetProgrammableInterrupts = false
      EcuMAlarmWakeupSource = <empty>
    EcuMConfiguration
      EcuMCommonConfiguration: EcuMConfigConsistencyHash=1431677610, EcuMDefaultAppMode=/ActiveEcuC/Os/OSDEFAULTAPPMODE, EcuMOSResource=(unset)
        EcuMDefaultShutdownTarget: EcuMDefaultShutdownTarget=EcuMShutdownTargetOff, EcuMDefaultResetModeRef=, EcuMDefaultSleepModeRef=
        EcuMDriverInitListZero
        EcuMDriverInitListOne
        EcuMDriverRestartList
        5 x EcuMWakeupSource, all with EcuMWakeupSourcePolling=false, EcuMCheckWakeupTimeout=0, EcuMValidationTimeout=0, EcuMComMChannelRef=(unset), EcuMComMPNCRef=(unset), EcuMResetReasonRef=(unset):
          ECUM_WKSOURCE_POWER: EcuMWakeupSourceId=0
          ECUM_WKSOURCE_RESET: EcuMWakeupSourceId=1
          ECUM_WKSOURCE_INTERNAL_RESET: EcuMWakeupSourceId=2
          ECUM_WKSOURCE_INTERNAL_WDG: EcuMWakeupSourceId=3
          ECUM_WKSOURCE_EXTERNAL_WDG: EcuMWakeupSourceId=4
      EcuMFlexConfiguration: EcuMNormalMcuModeRef=, EcuMPartitionRef=
        ECUM_RESET_MCU (EcuMResetMode): EcuMResetModeId=0
