AUTOSAR XML (schema 00048)
package /AUTOSAR/EcuM_ib_bswmd/BswModuleDescriptions
  bsw module description EcuM: provided-entrys=ecum_mainfunction
    bsw internal behavior EcuMBehavior
      4 x exclusive area:
        ECUM_EXCLUSIVE_AREA_0  # This exclusive area shall disable all wake up interrupts to prevent overwriting of some global variables.
        ECUM_EXCLUSIVE_AREA_1  # This exclusive area is only used in case of multi core and if the the EcuM is configured to handle also the slave cores. It must be configured as a spinlock to allow access to some variables simultaneously from multiple cores.
        ECUM_EXCLUSIVE_AREA_2  # This exclusive area is used for accessing the clock variable. It shall disable GPT interrupts and task changes. Only necessary if 32 Bit access is not atomic and Alarm Clock is present.
        ECUM_EXCLUSIVE_AREA_3  # This This exclusive area must be configured as a spin lock to protect access on global shutdown target variables.
      bsw schedulable entity ecum_mainfunction: implemented-entry=ecum_mainfunction
      bsw timing event EcuM_MainFunctionTimingEvent{0..2}: starts-on-event=ecum_mainfunction, period=0.01
  bsw module entry ecum_mainfunction: call-type=SCHEDULED, execution-context=TASK
