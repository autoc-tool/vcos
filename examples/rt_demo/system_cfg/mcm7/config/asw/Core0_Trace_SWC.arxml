AUTOSAR XML (schema 00046)
package /ComponentTypes
  application sw component type Core0_Trace_SWC
    behavior Core0_Trace_SWC_InternalBehavior
      timing event TMT_handshake_main_func: start-on-event=handshake_main_func, period=0.001
      timing event TMT_trace_dumpudp_main_func: start-on-event=trace_dumpudp_main_func, period=0.001
      runnable handshake_main_func
      runnable trace_dumpudp_main_func
  swc implementation Core0_Trace_SWC_Implementation: behavior=Core0_Trace_SWC_InternalBehavior
    code-descriptors:
      code Default: artifact-descriptors=autosar-engineering-object={short-label=Default, category=SWSRC}
