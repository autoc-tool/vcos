AUTOSAR XML (schema 00046)
package /ComponentTypes
  application sw component type Core1TaskTestSWC
    behavior Core1TaskTestSWC_InternalBehavior
      12 x timing event:
        TMT_core1_actuatorin_runnable_10ms: start-on-event=core1_actuatorin_runnable_10ms, period=0.01
        TMT_core1_actuatorin_runnable_1ms: start-on-event=core1_actuatorin_runnable_1ms, period=0.001
        TMT_core1_actuatorout_runnable_10ms: start-on-event=core1_actuatorout_runnable_10ms, period=0.01
        TMT_core1_actuatorout_runnable_1ms: start-on-event=core1_actuatorout_runnable_1ms, period=0.001
        TMT_core1_asilb_runnable_10ms: start-on-event=core1_asilb_runnable_10ms, period=0.01
        TMT_core1_asilb_runnable_1ms: start-on-event=core1_asilb_runnable_1ms, period=0.001
        TMT_core1_asild_runnable_10ms: start-on-event=core1_asild_runnable_10ms, period=0.01
        TMT_core1_bsw_runnable_10ms: start-on-event=core1_bsw_runnable_10ms, period=0.01
        TMT_core1_bswapp_runnable_10ms: start-on-event=core1_bswapp_runnable_10ms, period=0.01
        TMT_core1_bswapp_runnable_1ms: start-on-event=core1_bswapp_runnable_1ms, period=0.001
        TMT_core1_bswapp_runnable_5ms: start-on-event=core1_bswapp_runnable_5ms, period=0.005
        TMT_core1_nmm_runnable_10ms: start-on-event=core1_nmm_runnable_10ms, period=0.01
      12 x runnable:
        core1_actuatorin_runnable_10ms
        core1_actuatorin_runnable_1ms
        core1_actuatorout_runnable_10ms
        core1_actuatorout_runnable_1ms
        core1_asilb_runnable_10ms
        core1_asilb_runnable_1ms
        core1_asild_runnable_10ms
        core1_bsw_runnable_10ms
        core1_bswapp_runnable_10ms
        core1_bswapp_runnable_1ms
        core1_bswapp_runnable_5ms
        core1_nmm_runnable_10ms
  swc implementation Core1TaskTestSWC_Implementation: behavior=Core1TaskTestSWC_InternalBehavior
    code-descriptors:
      code Default: artifact-descriptors=autosar-engineering-object={short-label=Default, category=SWSRC}
