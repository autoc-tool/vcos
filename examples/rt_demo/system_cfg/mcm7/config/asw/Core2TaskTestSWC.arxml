AUTOSAR XML (schema 00046)
package /ComponentTypes
  application sw component type Core2TaskTestSWC
    behavior Core2TaskTestSWC_InternalBehavior
      timing event TMT_core2_bsw_runnable_10ms: start-on-event=core2_bsw_runnable_10ms, period=0.01
      timing event TMT_core2_bsw_runnable_1ms: start-on-event=core2_bsw_runnable_1ms, period=0.001
      timing event TMT_core2_bsw_runnable_5ms: start-on-event=core2_bsw_runnable_5ms, period=0.005
      runnable core2_bsw_runnable_10ms
      runnable core2_bsw_runnable_1ms
      runnable core2_bsw_runnable_5ms
  swc implementation Core2TaskTestSWC_Implementation: behavior=Core2TaskTestSWC_InternalBehavior
    code-descriptors:
      code Default: artifact-descriptors=autosar-engineering-object={short-label=Default, category=SWSRC}
