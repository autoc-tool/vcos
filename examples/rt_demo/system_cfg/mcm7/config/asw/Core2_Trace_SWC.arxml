AUTOSAR XML (schema 00046)
package /ComponentTypes
  application sw component type Core2_Trace_SWC
    behavior Core2_Trace_SWC_InternalBehavior
      timing event TMT_handshake_main_func: start-on-event=handshake_main_func, period=0.001
      runnable handshake_main_func
  swc implementation Core2_Trace_SWC_Implementation: behavior=Core2_Trace_SWC_InternalBehavior
    code-descriptors:
      code Default: artifact-descriptors=autosar-engineering-object={short-label=Default, category=SWSRC}
