AUTOSAR XML (schema 00046)
package /ActiveEcuC
  module config Memmap
    fw (MemmapLayer): OsInternalLayer=true, InternalLayer=true
    bsw (MemmapLayer): OsInternalLayer=false, InternalLayer=false
    7 x MemmapModule, all with MemmapUseCalibration=false, MemmapUseLayer=/ActiveEcuC/Memmap/bsw:
      tcpip: MemmapApplicationRef=/ActiveEcuC/Os/SystemApplication_Core0
      ethif: MemmapApplicationRef=/ActiveEcuC/Os/SystemApplication_Core0
      nvm: MemmapApplicationRef=/ActiveEcuC/Os/SystemApplication_Core0
      crc: MemmapApplicationRef=(unset)
      memif: MemmapApplicationRef=(unset)
      eth: MemmapApplicationRef=/ActiveEcuC/Os/SystemApplication_Core0
      rte: MemmapApplicationRef=/ActiveEcuC/Os/SystemApplication_Core0, MemmapApplicationRef=/ActiveEcuC/Os/SystemApplication_Core1, MemmapApplicationRef=/ActiveEcuC/Os/SystemApplication_Core2, MemmapApplicationRef=/ActiveEcuC/Os/SystemApplication_Core3
