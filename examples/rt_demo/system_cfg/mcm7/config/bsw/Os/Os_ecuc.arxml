AUTOSAR XML (schema 00046)
package /ActiveEcuC
  module config Os: implementation-config-variant=VARIANT-PRE-COMPILE, module-description=Os_Impl
    OSDEFAULTAPPMODE (OsAppMode)
    OSAUTOSTARTMODE (OsAppMode)
    Armv8rE3650 (OsPublishedInformation): OsKernelVersion=1.0.0, OsPlatformName=E3650
      OsDerivativeInformation: OsStackAlignment=4
        4 x OsPhysicalCore:
          OsPhysicalCore{0..3}: OsPhysicalCoreId={0..3}
        4 x OsHardWareTimer, all with OsHardWareTimerClockFrequency=24:
          GTM{0..3}: OsHardWareTimerChannel=GTM{0..3}
        OsMemoryRegionSpecifics
          USER_NON_SUPERVISOR_R (OsMemoryRegionAccess): OsMemoryRegionAccessRights=USER_NON_SUPERVISOR_R
          MEMATTR_TYPE_00_WRITE_BACK_WRTIE_ALLOCATE_CACHEABLE (OsMemoryRegionFlags): OsMemoryRegionMemoryAttributes=MEMATTR_TYPE_00_WRITE_BACK_WRTIE_ALLOCATE_CACHEABLE
          5 x OsMemoryRegionAccess:
            USER_NON_SUPERVISOR_RW: OsMemoryRegionAccessRights=USER_NON_SUPERVISOR_RW
            USER_NON_SUPERVISOR_RX: OsMemoryRegionAccessRights=USER_NON_SUPERVISOR_RX
            USER_R_SUPERVISOR_R: OsMemoryRegionAccessRights=USER_R_SUPERVISOR_R
            USER_RW_SUPERVISOR_RW: OsMemoryRegionAccessRights=USER_RW_SUPERVISOR_RW
            USER_RX_SUPERVISOR_RX: OsMemoryRegionAccessRights=USER_RX_SUPERVISOR_RX
          4 x OsMemoryRegionFlags:
            MEMATTR_TYPE_01_WRITE_THROUGH_CACHEABLE: OsMemoryRegionMemoryAttributes=MEMATTR_TYPE_01_WRITE_THROUGH_CACHEABLE
            MEMATTR_TYPE_02_NO_CACHEABLE: OsMemoryRegionMemoryAttributes=MEMATTR_TYPE_02_NO_CACHEABLE
            MEMATTR_TYPE_03_DEVICE_NGNRNE: OsMemoryRegionMemoryAttributes=MEMATTR_TYPE_03_DEVICE_NGNRNE
            MEMATTR_TYPE_04_DEVICE_NGNRE: OsMemoryRegionMemoryAttributes=MEMATTR_TYPE_04_DEVICE_NGNRE
    4 x OsCore:
      OsCore{0..3}: OsCoreBswApplicationRef=/ActiveEcuC/Os/SystemApplication_Core{0..3}, OsCoreEcucIdRef=/ActiveEcuC/EcuC/EcucHardware/EcucCoreDefinition{0..3}
    4 x OsScheduleTable, all with OsScheduleTableRepeating=true, OsSchTblAccessingApplication=/ActiveEcuC/Os/SystemApplication_Core0, OsSchTblAccessingApplication=/ActiveEcuC/Os/SystemApplication_Core1, OsSchTblAccessingApplication=/ActiveEcuC/Os/SystemApplication_Core2, OsSchTblAccessingApplication=/ActiveEcuC/Os/SystemApplication_Core3:
      OsScheduleTable_Core0: OsScheduleTableDuration=100, OsScheduleTableCounterRef=/ActiveEcuC/Os/systemtimer0
        100 x OsScheduleTableExpiryPoint:
          ExpiryPoint_0: OsScheduleTblExpPointOffset=0
            16 x OsScheduleTableEventSetting:
              OsScheduleTableEventSetting_000: OsScheduleTableSetEventRef=/ActiveEcuC/Os/Rte_Ev_Cyclic_Core0_Demo_Task_1ms_0_1ms, OsScheduleTableSetEventTaskRef=/ActiveEcuC/Os/Core0_Demo_Task_1ms
              OsScheduleTableEventSetting_001: OsScheduleTableSetEventRef=/ActiveEcuC/Os/Rte_Ev_Cyclic_Core0_BSWApp_Task_1ms_0_1ms, OsScheduleTableSetEventTaskRef=/ActiveEcuC/Os/Core0_BSWApp_Task_1ms
              OsScheduleTableEventSetting_002: OsScheduleTableSetEventRef=/ActiveEcuC/Os/Rte_Ev_Cyclic_Core0_BSW_Task_5ms_0_5ms, OsScheduleTableSetEventTaskRef=/ActiveEcuC/Os/Core0_BSW_Task_5ms
              OsScheduleTableEventSetting_003: OsScheduleTableSetEventRef=/ActiveEcuC/Os/Rte_Ev_Cyclic2_Core0_BSW_Task_5ms_0_50ms, OsScheduleTableSetEventTaskRef=/ActiveEcuC/Os/Core0_BSW_Task_5ms
              OsScheduleTableEventSetting_004: OsScheduleTableSetEventRef=/ActiveEcuC/Os/Rte_Ev_Cyclic2_Core0_BSW_Task_5ms_0_5ms, OsScheduleTableSetEventTaskRef=/ActiveEcuC/Os/Core0_BSW_Task_5ms
              OsScheduleTableEventSetting_005: OsScheduleTableSetEventRef=/ActiveEcuC/Os/Rte_Ev_Cyclic2_Core0_BSW_Task_5ms_0_100ms, OsScheduleTableSetEventTaskRef=/ActiveEcuC/Os/Core0_BSW_Task_5ms
              OsScheduleTableEventSetting_006: OsScheduleTableSetEventRef=/ActiveEcuC/Os/Rte_Ev_Cyclic_Core0_Demo_Task_5ms_0_5ms, OsScheduleTableSetEventTaskRef=/ActiveEcuC/Os/Core0_Demo_Task_5ms
              OsScheduleTableEventSetting_007: OsScheduleTableSetEventRef=/ActiveEcuC/Os/Rte_Ev_Cyclic_Core0_BSWApp_Task_5ms_0_5ms, OsScheduleTableSetEventTaskRef=/ActiveEcuC/Os/Core0_BSWApp_Task_5ms
              OsScheduleTableEventSetting_008: OsScheduleTableSetEventRef=/ActiveEcuC/Os/Rte_Ev_Cyclic_Core0_ASIL_BSW_Task_5ms_0_5ms, OsScheduleTableSetEventTaskRef=/ActiveEcuC/Os/Core0_ASIL_BSW_Task_5ms
              OsScheduleTableEventSetting_009: OsScheduleTableSetEventRef=/ActiveEcuC/Os/Rte_Ev_Cyclic_Core0_BSW_Task_10ms_0_10ms, OsScheduleTableSetEventTaskRef=/ActiveEcuC/Os/Core0_BSW_Task_10ms
              OsScheduleTableEventSetting_010: OsScheduleTableSetEventRef=/ActiveEcuC/Os/Rte_Ev_Cyclic_Core0_Demo_Task_10ms_0_10ms, OsScheduleTableSetEventTaskRef=/ActiveEcuC/Os/Core0_Demo_Task_10ms
              OsScheduleTableEventSetting_011: OsScheduleTableSetEventRef=/ActiveEcuC/Os/Rte_Ev_Cyclic_Core0_BSWApp_Task_10ms_0_10ms, OsScheduleTableSetEventTaskRef=/ActiveEcuC/Os/Core0_BSWApp_Task_10ms
              OsScheduleTableEventSetting_012: OsScheduleTableSetEventRef=/ActiveEcuC/Os/Rte_Ev_Cyclic_Core0_ASIL_BSW_Task_10ms_0_10ms, OsScheduleTableSetEventTaskRef=/ActiveEcuC/Os/Core0_ASIL_BSW_Task_10ms
              OsScheduleTableEventSetting_013: OsScheduleTableSetEventRef=/ActiveEcuC/Os/Rte_Ev_Cyclic_Core0_ActuatorIN_Task_10ms_0_10ms, OsScheduleTableSetEventTaskRef=/ActiveEcuC/Os/Core0_ActuatorIN_Task_10ms
              OsScheduleTableEventSetting_014: OsScheduleTableSetEventRef=/ActiveEcuC/Os/Rte_Ev_Cyclic_Core0_ActuatorOUT_Task_10ms_0_10ms, OsScheduleTableSetEventTaskRef=/ActiveEcuC/Os/Core0_ActuatorOUT_Task_10ms
              OsScheduleTableEventSetting_015: OsScheduleTableSetEventRef=/ActiveEcuC/Os/Rte_Ev_Cyclic_Core0_BSW_Task_10ms_LowPriority_0_10ms, OsScheduleTableSetEventTaskRef=/ActiveEcuC/Os/Core0_BSW_Task_10ms_LowPriority
          ExpiryPoint_1: OsScheduleTblExpPointOffset=1
            OsScheduleTableEventSetting_000 (OsScheduleTableEventSetting):
              OsScheduleTableSetEventRef = /ActiveEcuC/Os/Rte_Ev_Cyclic_Core0_Demo_Task_1ms_0_1ms
              OsScheduleTableSetEventTaskRef = /ActiveEcuC/Os/Core0_Demo_Task_1ms
            OsScheduleTableEventSetting_001 (OsScheduleTableEventSetting):
              OsScheduleTableSetEventRef = /ActiveEcuC/Os/Rte_Ev_Cyclic_Core0_BSWApp_Task_1ms_0_1ms
              OsScheduleTableSetEventTaskRef = /ActiveEcuC/Os/Core0_BSWApp_Task_1ms
          ExpiryPoint_2: OsScheduleTblExpPointOffset=2
            OsScheduleTableEventSetting_000 (OsScheduleTableEventSetting):
              OsScheduleTableSetEventRef = /ActiveEcuC/Os/Rte_Ev_Cyclic_Core0_Demo_Task_1ms_0_1ms
              OsScheduleTableSetEventTaskRef = /ActiveEcuC/Os/Core0_Demo_Task_1ms
            OsScheduleTableEventSetting_001 (OsScheduleTableEventSetting):
              OsScheduleTableSetEventRef = /ActiveEcuC/Os/Rte_Ev_Cyclic_Core0_BSWApp_Task_1ms_0_1ms
              OsScheduleTableSetEventTaskRef = /ActiveEcuC/Os/Core0_BSWApp_Task_1ms
          ExpiryPoint_3: OsScheduleTblExpPointOffset=3
            OsScheduleTableEventSetting_000 (OsScheduleTableEventSetting):
              OsScheduleTableSetEventRef = /ActiveEcuC/Os/Rte_Ev_Cyclic_Core0_Demo_Task_1ms_0_1ms
              OsScheduleTableSetEventTaskRef = /ActiveEcuC/Os/Core0_Demo_Task_1ms
            OsScheduleTableEventSetting_001 (OsScheduleTableEventSetting):
              OsScheduleTableSetEventRef = /ActiveEcuC/Os/Rte_Ev_Cyclic_Core0_BSWApp_Task_1ms_0_1ms
              OsScheduleTableSetEventTaskRef = /ActiveEcuC/Os/Core0_BSWApp_Task_1ms
          ExpiryPoint_4: OsScheduleTblExpPointOffset=4
            OsScheduleTableEventSetting_000 (OsScheduleTableEventSetting):
              OsScheduleTableSetEventRef = /ActiveEcuC/Os/Rte_Ev_Cyclic_Core0_Demo_Task_1ms_0_1ms
              OsScheduleTableSetEventTaskRef = /ActiveEcuC/Os/Core0_Demo_Task_1ms
            OsScheduleTableEventSetting_001 (OsScheduleTableEventSetting):
              OsScheduleTableSetEventRef = /ActiveEcuC/Os/Rte_Ev_Cyclic_Core0_BSWApp_Task_1ms_0_1ms
              OsScheduleTableSetEventTaskRef = /ActiveEcuC/Os/Core0_BSWApp_Task_1ms
          ExpiryPoint_5: OsScheduleTblExpPointOffset=5
            7 x OsScheduleTableEventSetting:
              OsScheduleTableEventSetting_000: OsScheduleTableSetEventRef=/ActiveEcuC/Os/Rte_Ev_Cyclic_Core0_Demo_Task_1ms_0_1ms, OsScheduleTableSetEventTaskRef=/ActiveEcuC/Os/Core0_Demo_Task_1ms
              OsScheduleTableEventSetting_001: OsScheduleTableSetEventRef=/ActiveEcuC/Os/Rte_Ev_Cyclic_Core0_BSWApp_Task_1ms_0_1ms, OsScheduleTableSetEventTaskRef=/ActiveEcuC/Os/Core0_BSWApp_Task_1ms
              OsScheduleTableEventSetting_002: OsScheduleTableSetEventRef=/ActiveEcuC/Os/Rte_Ev_Cyclic_Core0_BSW_Task_5ms_0_5ms, OsScheduleTableSetEventTaskRef=/ActiveEcuC/Os/Core0_BSW_Task_5ms
              OsScheduleTableEventSetting_003: OsScheduleTableSetEventRef=/ActiveEcuC/Os/Rte_Ev_Cyclic2_Core0_BSW_Task_5ms_0_5ms, OsScheduleTableSetEventTaskRef=/ActiveEcuC/Os/Core0_BSW_Task_5ms
              OsScheduleTableEventSetting_004: OsScheduleTableSetEventRef=/ActiveEcuC/Os/Rte_Ev_Cyclic_Core0_Demo_Task_5ms_0_5ms, OsScheduleTableSetEventTaskRef=/ActiveEcuC/Os/Core0_Demo_Task_5ms
              OsScheduleTableEventSetting_005: OsScheduleTableSetEventRef=/ActiveEcuC/Os/Rte_Ev_Cyclic_Core0_BSWApp_Task_5ms_0_5ms, OsScheduleTableSetEventTaskRef=/ActiveEcuC/Os/Core0_BSWApp_Task_5ms
              OsScheduleTableEventSetting_006: OsScheduleTableSetEventRef=/ActiveEcuC/Os/Rte_Ev_Cyclic_Core0_ASIL_BSW_Task_5ms_0_5ms, OsScheduleTableSetEventTaskRef=/ActiveEcuC/Os/Core0_ASIL_BSW_Task_5ms
          ExpiryPoint_6: OsScheduleTblExpPointOffset=6
            OsScheduleTableEventSetting_000 (OsScheduleTableEventSetting):
              OsScheduleTableSetEventRef = /ActiveEcuC/Os/Rte_Ev_Cyclic_Core0_Demo_Task_1ms_0_1ms
              OsScheduleTableSetEventTaskRef = /ActiveEcuC/Os/Core0_Demo_Task_1ms
            OsScheduleTableEventSetting_001 (OsScheduleTableEventSetting):
              OsScheduleTableSetEventRef = /ActiveEcuC/Os/Rte_Ev_Cyclic_Core0_BSWApp_Task_1ms_0_1ms
              OsScheduleTableSetEventTaskRef = /ActiveEcuC/Os/Core0_BSWApp_Task_1ms
          ExpiryPoint_7: OsScheduleTblExpPointOffset=7
            OsScheduleTableEventSetting_000 (OsScheduleTableEventSetting):
              OsScheduleTableSetEventRef = /ActiveEcuC/Os/Rte_Ev_Cyclic_Core0_Demo_Task_1ms_0_1ms
              OsScheduleTableSetEventTaskRef = /ActiveEcuC/Os/Core0_Demo_Task_1ms
            OsScheduleTableEventSetting_001 (OsScheduleTableEventSetting):
              OsScheduleTableSetEventRef = /ActiveEcuC/Os/Rte_Ev_Cyclic_Core0_BSWApp_Task_1ms_0_1ms
              OsScheduleTableSetEventTaskRef = /ActiveEcuC/Os/Core0_BSWApp_Task_1ms
          ExpiryPoint_8: OsScheduleTblExpPointOffset=8
            OsScheduleTableEventSetting_000 (OsScheduleTableEventSetting):
              OsScheduleTableSetEventRef = /ActiveEcuC/Os/Rte_Ev_Cyclic_Core0_Demo_Task_1ms_0_1ms
              OsScheduleTableSetEventTaskRef = /ActiveEcuC/Os/Core0_Demo_Task_1ms
            OsScheduleTableEventSetting_001 (OsScheduleTableEventSetting):
              OsScheduleTableSetEventRef = /ActiveEcuC/Os/Rte_Ev_Cyclic_Core0_BSWApp_Task_1ms_0_1ms
              OsScheduleTableSetEventTaskRef = /ActiveEcuC/Os/Core0_BSWApp_Task_1ms
          ExpiryPoint_9: OsScheduleTblExpPointOffset=9
            OsScheduleTableEventSetting_000 (OsScheduleTableEventSetting):
              OsScheduleTableSetEventRef = /ActiveEcuC/Os/Rte_Ev_Cyclic_Core0_Demo_Task_1ms_0_1ms
              OsScheduleTableSetEventTaskRef = /ActiveEcuC/Os/Core0_Demo_Task_1ms
            OsScheduleTableEventSetting_001 (OsScheduleTableEventSetting):
              OsScheduleTableSetEventRef = /ActiveEcuC/Os/Rte_Ev_Cyclic_Core0_BSWApp_Task_1ms_0_1ms
              OsScheduleTableSetEventTaskRef = /ActiveEcuC/Os/Core0_BSWApp_Task_1ms
          ExpiryPoint_10: OsScheduleTblExpPointOffset=10
            14 x OsScheduleTableEventSetting:
              OsScheduleTableEventSetting_000: OsScheduleTableSetEventRef=/ActiveEcuC/Os/Rte_Ev_Cyclic_Core0_Demo_Task_1ms_0_1ms, OsScheduleTableSetEventTaskRef=/ActiveEcuC/Os/Core0_Demo_Task_1ms
              OsScheduleTableEventSetting_001: OsScheduleTableSetEventRef=/ActiveEcuC/Os/Rte_Ev_Cyclic_Core0_BSWApp_Task_1ms_0_1ms, OsScheduleTableSetEventTaskRef=/ActiveEcuC/Os/Core0_BSWApp_Task_1ms
              OsScheduleTableEventSetting_002: OsScheduleTableSetEventRef=/ActiveEcuC/Os/Rte_Ev_Cyclic_Core0_BSW_Task_5ms_0_5ms, OsScheduleTableSetEventTaskRef=/ActiveEcuC/Os/Core0_BSW_Task_5ms
              OsScheduleTableEventSetting_003: OsScheduleTableSetEventRef=/ActiveEcuC/Os/Rte_Ev_Cyclic2_Core0_BSW_Task_5ms_0_5ms, OsScheduleTableSetEventTaskRef=/ActiveEcuC/Os/Core0_BSW_Task_5ms
              OsScheduleTableEventSetting_004: OsScheduleTableSetEventRef=/ActiveEcuC/Os/Rte_Ev_Cyclic_Core0_Demo_Task_5ms_0_5ms, OsScheduleTableSetEventTaskRef=/ActiveEcuC/Os/Core0_Demo_Task_5ms
              OsScheduleTableEventSetting_005: OsScheduleTableSetEventRef=/ActiveEcuC/Os/Rte_Ev_Cyclic_Core0_BSWApp_Task_5ms_0_5ms, OsScheduleTableSetEventTaskRef=/ActiveEcuC/Os/Core0_BSWApp_Task_5ms
              OsScheduleTableEventSetting_006: OsScheduleTableSetEventRef=/ActiveEcuC/Os/Rte_Ev_Cyclic_Core0_ASIL_BSW_Task_5ms_0_5ms, OsScheduleTableSetEventTaskRef=/ActiveEcuC/Os/Core0_ASIL_BSW_Task_5ms
              OsScheduleTableEventSetting_007: OsScheduleTableSetEventRef=/ActiveEcuC/Os/Rte_Ev_Cyclic_Core0_BSW_Task_10ms_0_10ms, OsScheduleTableSetEventTaskRef=/ActiveEcuC/Os/Core0_BSW_Task_10ms
              OsScheduleTableEventSetting_008: OsScheduleTableSetEventRef=/ActiveEcuC/Os/Rte_Ev_Cyclic_Core0_Demo_Task_10ms_0_10ms, OsScheduleTableSetEventTaskRef=/ActiveEcuC/Os/Core0_Demo_Task_10ms
              OsScheduleTableEventSetting_009: OsScheduleTableSetEventRef=/ActiveEcuC/Os/Rte_Ev_Cyclic_Core0_BSWApp_Task_10ms_0_10ms, OsScheduleTableSetEventTaskRef=/ActiveEcuC/Os/Core0_BSWApp_Task_10ms
              OsScheduleTableEventSetting_010: OsScheduleTableSetEventRef=/ActiveEcuC/Os/Rte_Ev_Cyclic_Core0_ASIL_BSW_Task_10ms_0_10ms, OsScheduleTableSetEventTaskRef=/ActiveEcuC/Os/Core0_ASIL_BSW_Task_10ms
              OsScheduleTableEventSetting_011: OsScheduleTableSetEventRef=/ActiveEcuC/Os/Rte_Ev_Cyclic_Core0_ActuatorIN_Task_10ms_0_10ms, OsScheduleTableSetEventTaskRef=/ActiveEcuC/Os/Core0_ActuatorIN_Task_10ms
              OsScheduleTableEventSetting_012: OsScheduleTableSetEventRef=/ActiveEcuC/Os/Rte_Ev_Cyclic_Core0_ActuatorOUT_Task_10ms_0_10ms, OsScheduleTableSetEventTaskRef=/ActiveEcuC/Os/Core0_ActuatorOUT_Task_10ms
              OsScheduleTableEventSetting_013: OsScheduleTableSetEventRef=/ActiveEcuC/Os/Rte_Ev_Cyclic_Core0_BSW_Task_10ms_LowPriority_0_10ms, OsScheduleTableSetEventTaskRef=/ActiveEcuC/Os/Core0_BSW_Task_10ms_LowPriority
          ExpiryPoint_11: OsScheduleTblExpPointOffset=11
            OsScheduleTableEventSetting_000 (OsScheduleTableEventSetting):
              OsScheduleTableSetEventRef = /ActiveEcuC/Os/Rte_Ev_Cyclic_Core0_Demo_Task_1ms_0_1ms
              OsScheduleTableSetEventTaskRef = /ActiveEcuC/Os/Core0_Demo_Task_1ms
            OsScheduleTableEventSetting_001 (OsScheduleTableEventSetting):
              OsScheduleTableSetEventRef = /ActiveEcuC/Os/Rte_Ev_Cyclic_Core0_BSWApp_Task_1ms_0_1ms
              OsScheduleTableSetEventTaskRef = /ActiveEcuC/Os/Core0_BSWApp_Task_1ms
          ExpiryPoint_12: OsScheduleTblExpPointOffset=12
            OsScheduleTableEventSetting_000 (OsScheduleTableEventSetting):
              OsScheduleTableSetEventRef = /ActiveEcuC/Os/Rte_Ev_Cyclic_Core0_Demo_Task_1ms_0_1ms
              OsScheduleTableSetEventTaskRef = /ActiveEcuC/Os/Core0_Demo_Task_1ms
            OsScheduleTableEventSetting_001 (OsScheduleTableEventSetting):
              OsScheduleTableSetEventRef = /ActiveEcuC/Os/Rte_Ev_Cyclic_Core0_BSWApp_Task_1ms_0_1ms
              OsScheduleTableSetEventTaskRef = /ActiveEcuC/Os/Core0_BSWApp_Task_1ms
          ExpiryPoint_13: OsScheduleTblExpPointOffset=13
            OsScheduleTableEventSetting_000 (OsScheduleTableEventSetting):
              OsScheduleTableSetEventRef = /ActiveEcuC/Os/Rte_Ev_Cyclic_Core0_Demo_Task_1ms_0_1ms
              OsScheduleTableSetEventTaskRef = /ActiveEcuC/Os/Core0_Demo_Task_1ms
            OsScheduleTableEventSetting_001 (OsScheduleTableEventSetting):
              OsScheduleTableSetEventRef = /ActiveEcuC/Os/Rte_Ev_Cyclic_Core0_BSWApp_Task_1ms_0_1ms
              OsScheduleTableSetEventTaskRef = /ActiveEcuC/Os/Core0_BSWApp_Task_1ms
          ExpiryPoint_14: OsScheduleTblExpPointOffset=14
            OsScheduleTableEventSetting_000 (OsScheduleTableEventSetting):
              OsScheduleTableSetEventRef = /ActiveEcuC/Os/Rte_Ev_Cyclic_Core0_Demo_Task_1ms_0_1ms
              OsScheduleTableSetEventTaskRef = /ActiveEcuC/Os/Core0_Demo_Task_1ms
            OsScheduleTableEventSetting_001 (OsScheduleTableEventSetting):
              OsScheduleTableSetEventRef = /ActiveEcuC/Os/Rte_Ev_Cyclic_Core0_BSWApp_Task_1ms_0_1ms
              OsScheduleTableSetEventTaskRef = /ActiveEcuC/Os/Core0_BSWApp_Task_1ms
          ExpiryPoint_15: OsScheduleTblExpPointOffset=15
            7 x OsScheduleTableEventSetting:
              OsScheduleTableEventSetting_000: OsScheduleTableSetEventRef=/ActiveEcuC/Os/Rte_Ev_Cyclic_Core0_Demo_Task_1ms_0_1ms, OsScheduleTableSetEventTaskRef=/ActiveEcuC/Os/Core0_Demo_Task_1ms
              OsScheduleTableEventSetting_001: OsScheduleTableSetEventRef=/ActiveEcuC/Os/Rte_Ev_Cyclic_Core0_BSWApp_Task_1ms_0_1ms, OsScheduleTableSetEventTaskRef=/ActiveEcuC/Os/Core0_BSWApp_Task_1ms
              OsScheduleTableEventSetting_002: OsScheduleTableSetEventRef=/ActiveEcuC/Os/Rte_Ev_Cyclic_Core0_BSW_Task_5ms_0_5ms, OsScheduleTableSetEventTaskRef=/ActiveEcuC/Os/Core0_BSW_Task_5ms
              OsScheduleTableEventSetting_003: OsScheduleTableSetEventRef=/ActiveEcuC/Os/Rte_Ev_Cyclic2_Core0_BSW_Task_5ms_0_5ms, OsScheduleTableSetEventTaskRef=/ActiveEcuC/Os/Core0_BSW_Task_5ms
              OsScheduleTableEventSetting_004: OsScheduleTableSetEventRef=/ActiveEcuC/Os/Rte_Ev_Cyclic_Core0_Demo_Task_5ms_0_5ms, OsScheduleTableSetEventTaskRef=/ActiveEcuC/Os/Core0_Demo_Task_5ms
              OsScheduleTableEventSetting_005: OsScheduleTableSetEventRef=/ActiveEcuC/Os/Rte_Ev_Cyclic_Core0_BSWApp_Task_5ms_0_5ms, OsScheduleTableSetEventTaskRef=/ActiveEcuC/Os/Core0_BSWApp_Task_5ms
              OsScheduleTableEventSetting_006: OsScheduleTableSetEventRef=/ActiveEcuC/Os/Rte_Ev_Cyclic_Core0_ASIL_BSW_Task_5ms_0_5ms, OsScheduleTableSetEventTaskRef=/ActiveEcuC/Os/Core0_ASIL_BSW_Task_5ms
          ExpiryPoint_16: OsScheduleTblExpPointOffset=16
            OsScheduleTableEventSetting_000 (OsScheduleTableEventSetting):
              OsScheduleTableSetEventRef = /ActiveEcuC/Os/Rte_Ev_Cyclic_Core0_Demo_Task_1ms_0_1ms
              OsScheduleTableSetEventTaskRef = /ActiveEcuC/Os/Core0_Demo_Task_1ms
            OsScheduleTableEventSetting_001 (OsScheduleTableEventSetting):
              OsScheduleTableSetEventRef = /ActiveEcuC/Os/Rte_Ev_Cyclic_Core0_BSWApp_Task_1ms_0_1ms
              OsScheduleTableSetEventTaskRef = /ActiveEcuC/Os/Core0_BSWApp_Task_1ms
          ExpiryPoint_17: OsScheduleTblExpPointOffset=17
            OsScheduleTableEventSetting_000 (OsScheduleTableEventSetting):
              OsScheduleTableSetEventRef = /ActiveEcuC/Os/Rte_Ev_Cyclic_Core0_Demo_Task_1ms_0_1ms
              OsScheduleTableSetEventTaskRef = /ActiveEcuC/Os/Core0_Demo_Task_1ms
            OsScheduleTableEventSetting_001 (OsScheduleTableEventSetting):
              OsScheduleTableSetEventRef = /ActiveEcuC/Os/Rte_Ev_Cyclic_Core0_BSWApp_Task_1ms_0_1ms
              OsScheduleTableSetEventTaskRef = /ActiveEcuC/Os/Core0_BSWApp_Task_1ms
          ExpiryPoint_18: OsScheduleTblExpPointOffset=18
            OsScheduleTableEventSetting_000 (OsScheduleTableEventSetting):
              OsScheduleTableSetEventRef = /ActiveEcuC/Os/Rte_Ev_Cyclic_Core0_Demo_Task_1ms_0_1ms
              OsScheduleTableSetEventTaskRef = /ActiveEcuC/Os/Core0_Demo_Task_1ms
            OsScheduleTableEventSetting_001 (OsScheduleTableEventSetting):
              OsScheduleTableSetEventRef = /ActiveEcuC/Os/Rte_Ev_Cyclic_Core0_BSWApp_Task_1ms_0_1ms
              OsScheduleTableSetEventTaskRef = /ActiveEcuC/Os/Core0_BSWApp_Task_1ms
          ExpiryPoint_19: OsScheduleTblExpPointOffset=19
            OsScheduleTableEventSetting_000 (OsScheduleTableEventSetting):
              OsScheduleTableSetEventRef = /ActiveEcuC/Os/Rte_Ev_Cyclic_Core0_Demo_Task_1ms_0_1ms
              OsScheduleTableSetEventTaskRef = /ActiveEcuC/Os/Core0_Demo_Task_1ms
            OsScheduleTableEventSetting_001 (OsScheduleTableEventSetting):
              OsScheduleTableSetEventRef = /ActiveEcuC/Os/Rte_Ev_Cyclic_Core0_BSWApp_Task_1ms_0_1ms
              OsScheduleTableSetEventTaskRef = /ActiveEcuC/Os/Core0_BSWApp_Task_1ms
          ExpiryPoint_20: OsScheduleTblExpPointOffset=20
            14 x OsScheduleTableEventSetting:
              OsScheduleTableEventSetting_000: OsScheduleTableSetEventRef=/ActiveEcuC/Os/Rte_Ev_Cyclic_Core0_Demo_Task_1ms_0_1ms, OsScheduleTableSetEventTaskRef=/ActiveEcuC/Os/Core0_Demo_Task_1ms
              OsScheduleTableEventSetting_001: OsScheduleTableSetEventRef=/ActiveEcuC/Os/Rte_Ev_Cyclic_Core0_BSWApp_Task_1ms_0_1ms, OsScheduleTableSetEventTaskRef=/ActiveEcuC/Os/Core0_BSWApp_Task_1ms
              OsScheduleTableEventSetting_002: OsScheduleTableSetEventRef=/ActiveEcuC/Os/Rte_Ev_Cyclic_Core0_BSW_Task_5ms_0_5ms, OsScheduleTableSetEventTaskRef=/ActiveEcuC/Os/Core0_BSW_Task_5ms
              OsScheduleTableEventSetting_003: OsScheduleTableSetEventRef=/ActiveEcuC/Os/Rte_Ev_Cyclic2_Core0_BSW_Task_5ms_0_5ms, OsScheduleTableSetEventTaskRef=/ActiveEcuC/Os/Core0_BSW_Task_5ms
              OsScheduleTableEventSetting_004: OsScheduleTableSetEventRef=/ActiveEcuC/Os/Rte_Ev_Cyclic_Core0_Demo_Task_5ms_0_5ms, OsScheduleTableSetEventTaskRef=/ActiveEcuC/Os/Core0_Demo_Task_5ms
              OsScheduleTableEventSetting_005: OsScheduleTableSetEventRef=/ActiveEcuC/Os/Rte_Ev_Cyclic_Core0_BSWApp_Task_5ms_0_5ms, OsScheduleTableSetEventTaskRef=/ActiveEcuC/Os/Core0_BSWApp_Task_5ms
              OsScheduleTableEventSetting_006: OsScheduleTableSetEventRef=/ActiveEcuC/Os/Rte_Ev_Cyclic_Core0_ASIL_BSW_Task_5ms_0_5ms, OsScheduleTableSetEventTaskRef=/ActiveEcuC/Os/Core0_ASIL_BSW_Task_5ms
              OsScheduleTableEventSetting_007: OsScheduleTableSetEventRef=/ActiveEcuC/Os/Rte_Ev_Cyclic_Core0_BSW_Task_10ms_0_10ms, OsScheduleTableSetEventTaskRef=/ActiveEcuC/Os/Core0_BSW_Task_10ms
              OsScheduleTableEventSetting_008: OsScheduleTableSetEventRef=/ActiveEcuC/Os/Rte_Ev_Cyclic_Core0_Demo_Task_10ms_0_10ms, OsScheduleTableSetEventTaskRef=/ActiveEcuC/Os/Core0_Demo_Task_10ms
              OsScheduleTableEventSetting_009: OsScheduleTableSetEventRef=/ActiveEcuC/Os/Rte_Ev_Cyclic_Core0_BSWApp_Task_10ms_0_10ms, OsScheduleTableSetEventTaskRef=/ActiveEcuC/Os/Core0_BSWApp_Task_10ms
              OsScheduleTableEventSetting_010: OsScheduleTableSetEventRef=/ActiveEcuC/Os/Rte_Ev_Cyclic_Core0_ASIL_BSW_Task_10ms_0_10ms, OsScheduleTableSetEventTaskRef=/ActiveEcuC/Os/Core0_ASIL_BSW_Task_10ms
              OsScheduleTableEventSetting_011: OsScheduleTableSetEventRef=/ActiveEcuC/Os/Rte_Ev_Cyclic_Core0_ActuatorIN_Task_10ms_0_10ms, OsScheduleTableSetEventTaskRef=/ActiveEcuC/Os/Core0_ActuatorIN_Task_10ms
              OsScheduleTableEventSetting_012: OsScheduleTableSetEventRef=/ActiveEcuC/Os/Rte_Ev_Cyclic_Core0_ActuatorOUT_Task_10ms_0_10ms, OsScheduleTableSetEventTaskRef=/ActiveEcuC/Os/Core0_ActuatorOUT_Task_10ms
              OsScheduleTableEventSetting_013: OsScheduleTableSetEventRef=/ActiveEcuC/Os/Rte_Ev_Cyclic_Core0_BSW_Task_10ms_LowPriority_0_10ms, OsScheduleTableSetEventTaskRef=/ActiveEcuC/Os/Core0_BSW_Task_10ms_LowPriority
          ExpiryPoint_21: OsScheduleTblExpPointOffset=21
            OsScheduleTableEventSetting_000 (OsScheduleTableEventSetting):
              OsScheduleTableSetEventRef = /ActiveEcuC/Os/Rte_Ev_Cyclic_Core0_Demo_Task_1ms_0_1ms
              OsScheduleTableSetEventTaskRef = /ActiveEcuC/Os/Core0_Demo_Task_1ms
            OsScheduleTableEventSetting_001 (OsScheduleTableEventSetting):
              OsScheduleTableSetEventRef = /ActiveEcuC/Os/Rte_Ev_Cyclic_Core0_BSWApp_Task_1ms_0_1ms
              OsScheduleTableSetEventTaskRef = /ActiveEcuC/Os/Core0_BSWApp_Task_1ms
          ExpiryPoint_22: OsScheduleTblExpPointOffset=22
            OsScheduleTableEventSetting_000 (OsScheduleTableEventSetting):
              OsScheduleTableSetEventRef = /ActiveEcuC/Os/Rte_Ev_Cyclic_Core0_Demo_Task_1ms_0_1ms
              OsScheduleTableSetEventTaskRef = /ActiveEcuC/Os/Core0_Demo_Task_1ms
            OsScheduleTableEventSetting_001 (OsScheduleTableEventSetting):
              OsScheduleTableSetEventRef = /ActiveEcuC/Os/Rte_Ev_Cyclic_Core0_BSWApp_Task_1ms_0_1ms
              OsScheduleTableSetEventTaskRef = /ActiveEcuC/Os/Core0_BSWApp_Task_1ms
          ExpiryPoint_23: OsScheduleTblExpPointOffset=23
            OsScheduleTableEventSetting_000 (OsScheduleTableEventSetting):
              OsScheduleTableSetEventRef = /ActiveEcuC/Os/Rte_Ev_Cyclic_Core0_Demo_Task_1ms_0_1ms
              OsScheduleTableSetEventTaskRef = /ActiveEcuC/Os/Core0_Demo_Task_1ms
            OsScheduleTableEventSetting_001 (OsScheduleTableEventSetting):
              OsScheduleTableSetEventRef = /ActiveEcuC/Os/Rte_Ev_Cyclic_Core0_BSWApp_Task_1ms_0_1ms
              OsScheduleTableSetEventTaskRef = /ActiveEcuC/Os/Core0_BSWApp_Task_1ms
          ExpiryPoint_24: OsScheduleTblExpPointOffset=24
            OsScheduleTableEventSetting_000 (OsScheduleTableEventSetting):
              OsScheduleTableSetEventRef = /ActiveEcuC/Os/Rte_Ev_Cyclic_Core0_Demo_Task_1ms_0_1ms
              OsScheduleTableSetEventTaskRef = /ActiveEcuC/Os/Core0_Demo_Task_1ms
            OsScheduleTableEventSetting_001 (OsScheduleTableEventSetting):
              OsScheduleTableSetEventRef = /ActiveEcuC/Os/Rte_Ev_Cyclic_Core0_BSWApp_Task_1ms_0_1ms
              OsScheduleTableSetEventTaskRef = /ActiveEcuC/Os/Core0_BSWApp_Task_1ms
          ExpiryPoint_25: OsScheduleTblExpPointOffset=25
            7 x OsScheduleTableEventSetting:
              OsScheduleTableEventSetting_000: OsScheduleTableSetEventRef=/ActiveEcuC/Os/Rte_Ev_Cyclic_Core0_Demo_Task_1ms_0_1ms, OsScheduleTableSetEventTaskRef=/ActiveEcuC/Os/Core0_Demo_Task_1ms
              OsScheduleTableEventSetting_001: OsScheduleTableSetEventRef=/ActiveEcuC/Os/Rte_Ev_Cyclic_Core0_BSWApp_Task_1ms_0_1ms, OsScheduleTableSetEventTaskRef=/ActiveEcuC/Os/Core0_BSWApp_Task_1ms
              OsScheduleTableEventSetting_002: OsScheduleTableSetEventRef=/ActiveEcuC/Os/Rte_Ev_Cyclic_Core0_BSW_Task_5ms_0_5ms, OsScheduleTableSetEventTaskRef=/ActiveEcuC/Os/Core0_BSW_Task_5ms
              OsScheduleTableEventSetting_003: OsScheduleTableSetEventRef=/ActiveEcuC/Os/Rte_Ev_Cyclic2_Core0_BSW_Task_5ms_0_5ms, OsScheduleTableSetEventTaskRef=/ActiveEcuC/Os/Core0_BSW_Task_5ms
              OsScheduleTableEventSetting_004: OsScheduleTableSetEventRef=/ActiveEcuC/Os/Rte_Ev_Cyclic_Core0_Demo_Task_5ms_0_5ms, OsScheduleTableSetEventTaskRef=/ActiveEcuC/Os/Core0_Demo_Task_5ms
              OsScheduleTableEventSetting_005: OsScheduleTableSetEventRef=/ActiveEcuC/Os/Rte_Ev_Cyclic_Core0_BSWApp_Task_5ms_0_5ms, OsScheduleTableSetEventTaskRef=/ActiveEcuC/Os/Core0_BSWApp_Task_5ms
              OsScheduleTableEventSetting_006: OsScheduleTableSetEventRef=/ActiveEcuC/Os/Rte_Ev_Cyclic_Core0_ASIL_BSW_Task_5ms_0_5ms, OsScheduleTableSetEventTaskRef=/ActiveEcuC/Os/Core0_ASIL_BSW_Task_5ms
          ExpiryPoint_26: OsScheduleTblExpPointOffset=26
            OsScheduleTableEventSetting_000 (OsScheduleTableEventSetting):
              OsScheduleTableSetEventRef = /ActiveEcuC/Os/Rte_Ev_Cyclic_Core0_Demo_Task_1ms_0_1ms
              OsScheduleTableSetEventTaskRef = /ActiveEcuC/Os/Core0_Demo_Task_1ms
            OsScheduleTableEventSetting_001 (OsScheduleTableEventSetting):
              OsScheduleTableSetEventRef = /ActiveEcuC/Os/Rte_Ev_Cyclic_Core0_BSWApp_Task_1ms_0_1ms
              OsScheduleTableSetEventTaskRef = /ActiveEcuC/Os/Core0_BSWApp_Task_1ms
          ExpiryPoint_27: OsScheduleTblExpPointOffset=27
            OsScheduleTableEventSetting_000 (OsScheduleTableEventSetting):
              OsScheduleTableSetEventRef = /ActiveEcuC/Os/Rte_Ev_Cyclic_Core0_Demo_Task_1ms_0_1ms
              OsScheduleTableSetEventTaskRef = /ActiveEcuC/Os/Core0_Demo_Task_1ms
            OsScheduleTableEventSetting_001 (OsScheduleTableEventSetting):
              OsScheduleTableSetEventRef = /ActiveEcuC/Os/Rte_Ev_Cyclic_Core0_BSWApp_Task_1ms_0_1ms
              OsScheduleTableSetEventTaskRef = /ActiveEcuC/Os/Core0_BSWApp_Task_1ms
          ExpiryPoint_28: OsScheduleTblExpPointOffset=28
            OsScheduleTableEventSetting_000 (OsScheduleTableEventSetting):
              OsScheduleTableSetEventRef = /ActiveEcuC/Os/Rte_Ev_Cyclic_Core0_Demo_Task_1ms_0_1ms
              OsScheduleTableSetEventTaskRef = /ActiveEcuC/Os/Core0_Demo_Task_1ms
            OsScheduleTableEventSetting_001 (OsScheduleTableEventSetting):
              OsScheduleTableSetEventRef = /ActiveEcuC/Os/Rte_Ev_Cyclic_Core0_BSWApp_Task_1ms_0_1ms
              OsScheduleTableSetEventTaskRef = /ActiveEcuC/Os/Core0_BSWApp_Task_1ms
          ExpiryPoint_29: OsScheduleTblExpPointOffset=29
            OsScheduleTableEventSetting_000 (OsScheduleTableEventSetting):
              OsScheduleTableSetEventRef = /ActiveEcuC/Os/Rte_Ev_Cyclic_Core0_Demo_Task_1ms_0_1ms
              OsScheduleTableSetEventTaskRef = /ActiveEcuC/Os/Core0_Demo_Task_1ms
            OsScheduleTableEventSetting_001 (OsScheduleTableEventSetting):
              OsScheduleTableSetEventRef = /ActiveEcuC/Os/Rte_Ev_Cyclic_Core0_BSWApp_Task_1ms_0_1ms
              OsScheduleTableSetEventTaskRef = /ActiveEcuC/Os/Core0_BSWApp_Task_1ms
          ExpiryPoint_30: OsScheduleTblExpPointOffset=30
            14 x OsScheduleTableEventSetting:
              OsScheduleTableEventSetting_000: OsScheduleTableSetEventRef=/ActiveEcuC/Os/Rte_Ev_Cyclic_Core0_Demo_Task_1ms_0_1ms, OsScheduleTableSetEventTaskRef=/ActiveEcuC/Os/Core0_Demo_Task_1ms
              OsScheduleTableEventSetting_001: OsScheduleTableSetEventRef=/ActiveEcuC/Os/Rte_Ev_Cyclic_Core0_BSWApp_Task_1ms_0_1ms, OsScheduleTableSetEventTaskRef=/ActiveEcuC/Os/Core0_BSWApp_Task_1ms
              OsScheduleTableEventSetting_002: OsScheduleTableSetEventRef=/ActiveEcuC/Os/Rte_Ev_Cyclic_Core0_BSW_Task_5ms_0_5ms, OsScheduleTableSetEventTaskRef=/ActiveEcuC/Os/Core0_BSW_Task_5ms
              OsScheduleTableEventSetting_003: OsScheduleTableSetEventRef=/ActiveEcuC/Os/Rte_Ev_Cyclic2_Core0_BSW_Task_5ms_0_5ms, OsScheduleTableSetEventTaskRef=/ActiveEcuC/Os/Core0_BSW_Task_5ms
              OsScheduleTableEventSetting_004: OsScheduleTableSetEventRef=/ActiveEcuC/Os/Rte_Ev_Cyclic_Core0_Demo_Task_5ms_0_5ms, OsScheduleTableSetEventTaskRef=/ActiveEcuC/Os/Core0_Demo_Task_5ms
              OsScheduleTableEventSetting_005: OsScheduleTableSetEventRef=/ActiveEcuC/Os/Rte_Ev_Cyclic_Core0_BSWApp_Task_5ms_0_5ms, OsScheduleTableSetEventTaskRef=/ActiveEcuC/Os/Core0_BSWApp_Task_5ms
              OsScheduleTableEventSetting_006: OsScheduleTableSetEventRef=/ActiveEcuC/Os/Rte_Ev_Cyclic_Core0_ASIL_BSW_Task_5ms_0_5ms, OsScheduleTableSetEventTaskRef=/ActiveEcuC/Os/Core0_ASIL_BSW_Task_5ms
              OsScheduleTableEventSetting_007: OsScheduleTableSetEventRef=/ActiveEcuC/Os/Rte_Ev_Cyclic_Core0_BSW_Task_10ms_0_10ms, OsScheduleTableSetEventTaskRef=/ActiveEcuC/Os/Core0_BSW_Task_10ms
              OsScheduleTableEventSetting_008: OsScheduleTableSetEventRef=/ActiveEcuC/Os/Rte_Ev_Cyclic_Core0_Demo_Task_10ms_0_10ms, OsScheduleTableSetEventTaskRef=/ActiveEcuC/Os/Core0_Demo_Task_10ms
              OsScheduleTableEventSetting_009: OsScheduleTableSetEventRef=/ActiveEcuC/Os/Rte_Ev_Cyclic_Core0_BSWApp_Task_10ms_0_10ms, OsScheduleTableSetEventTaskRef=/ActiveEcuC/Os/Core0_BSWApp_Task_10ms
              OsScheduleTableEventSetting_010: OsScheduleTableSetEventRef=/ActiveEcuC/Os/Rte_Ev_Cyclic_Core0_ASIL_BSW_Task_10ms_0_10ms, OsScheduleTableSetEventTaskRef=/ActiveEcuC/Os/Core0_ASIL_BSW_Task_10ms
              OsScheduleTableEventSetting_011: OsScheduleTableSetEventRef=/ActiveEcuC/Os/Rte_Ev_Cyclic_Core0_ActuatorIN_Task_10ms_0_10ms, OsScheduleTableSetEventTaskRef=/ActiveEcuC/Os/Core0_ActuatorIN_Task_10ms
              OsScheduleTableEventSetting_012: OsScheduleTableSetEventRef=/ActiveEcuC/Os/Rte_Ev_Cyclic_Core0_ActuatorOUT_Task_10ms_0_10ms, OsScheduleTableSetEventTaskRef=/ActiveEcuC/Os/Core0_ActuatorOUT_Task_10ms
              OsScheduleTableEventSetting_013: OsScheduleTableSetEventRef=/ActiveEcuC/Os/Rte_Ev_Cyclic_Core0_BSW_Task_10ms_LowPriority_0_10ms, OsScheduleTableSetEventTaskRef=/ActiveEcuC/Os/Core0_BSW_Task_10ms_LowPriority
          ExpiryPoint_31: OsScheduleTblExpPointOffset=31
            OsScheduleTableEventSetting_000 (OsScheduleTableEventSetting):
              OsScheduleTableSetEventRef = /ActiveEcuC/Os/Rte_Ev_Cyclic_Core0_Demo_Task_1ms_0_1ms
              OsScheduleTableSetEventTaskRef = /ActiveEcuC/Os/Core0_Demo_Task_1ms
            OsScheduleTableEventSetting_001 (OsScheduleTableEventSetting):
              OsScheduleTableSetEventRef = /ActiveEcuC/Os/Rte_Ev_Cyclic_Core0_BSWApp_Task_1ms_0_1ms
              OsScheduleTableSetEventTaskRef = /ActiveEcuC/Os/Core0_BSWApp_Task_1ms
          ExpiryPoint_32: OsScheduleTblExpPointOffset=32
            OsScheduleTableEventSetting_000 (OsScheduleTableEventSetting):
              OsScheduleTableSetEventRef = /ActiveEcuC/Os/Rte_Ev_Cyclic_Core0_Demo_Task_1ms_0_1ms
              OsScheduleTableSetEventTaskRef = /ActiveEcuC/Os/Core0_Demo_Task_1ms
            OsScheduleTableEventSetting_001 (OsScheduleTableEventSetting):
              OsScheduleTableSetEventRef = /ActiveEcuC/Os/Rte_Ev_Cyclic_Core0_BSWApp_Task_1ms_0_1ms
              OsScheduleTableSetEventTaskRef = /ActiveEcuC/Os/Core0_BSWApp_Task_1ms
          ExpiryPoint_33: OsScheduleTblExpPointOffset=33
            OsScheduleTableEventSetting_000 (OsScheduleTableEventSetting):
              OsScheduleTableSetEventRef = /ActiveEcuC/Os/Rte_Ev_Cyclic_Core0_Demo_Task_1ms_0_1ms
              OsScheduleTableSetEventTaskRef = /ActiveEcuC/Os/Core0_Demo_Task_1ms
            OsScheduleTableEventSetting_001 (OsScheduleTableEventSetting):
              OsScheduleTableSetEventRef = /ActiveEcuC/Os/Rte_Ev_Cyclic_Core0_BSWApp_Task_1ms_0_1ms
              OsScheduleTableSetEventTaskRef = /ActiveEcuC/Os/Core0_BSWApp_Task_1ms
          ExpiryPoint_34: OsScheduleTblExpPointOffset=34
            OsScheduleTableEventSetting_000 (OsScheduleTableEventSetting):
              OsScheduleTableSetEventRef = /ActiveEcuC/Os/Rte_Ev_Cyclic_Core0_Demo_Task_1ms_0_1ms
              OsScheduleTableSetEventTaskRef = /ActiveEcuC/Os/Core0_Demo_Task_1ms
            OsScheduleTableEventSetting_001 (OsScheduleTableEventSetting):
              OsScheduleTableSetEventRef = /ActiveEcuC/Os/Rte_Ev_Cyclic_Core0_BSWApp_Task_1ms_0_1ms
              OsScheduleTableSetEventTaskRef = /ActiveEcuC/Os/Core0_BSWApp_Task_1ms
          ExpiryPoint_35: OsScheduleTblExpPointOffset=35
            7 x OsScheduleTableEventSetting:
              OsScheduleTableEventSetting_000: OsScheduleTableSetEventRef=/ActiveEcuC/Os/Rte_Ev_Cyclic_Core0_Demo_Task_1ms_0_1ms, OsScheduleTableSetEventTaskRef=/ActiveEcuC/Os/Core0_Demo_Task_1ms
              OsScheduleTableEventSetting_001: OsScheduleTableSetEventRef=/ActiveEcuC/Os/Rte_Ev_Cyclic_Core0_BSWApp_Task_1ms_0_1ms, OsScheduleTableSetEventTaskRef=/ActiveEcuC/Os/Core0_BSWApp_Task_1ms
              OsScheduleTableEventSetting_002: OsScheduleTableSetEventRef=/ActiveEcuC/Os/Rte_Ev_Cyclic_Core0_BSW_Task_5ms_0_5ms, OsScheduleTableSetEventTaskRef=/ActiveEcuC/Os/Core0_BSW_Task_5ms
              OsScheduleTableEventSetting_003: OsScheduleTableSetEventRef=/ActiveEcuC/Os/Rte_Ev_Cyclic2_Core0_BSW_Task_5ms_0_5ms, OsScheduleTableSetEventTaskRef=/ActiveEcuC/Os/Core0_BSW_Task_5ms
              OsScheduleTableEventSetting_004: OsScheduleTableSetEventRef=/ActiveEcuC/Os/Rte_Ev_Cyclic_Core0_Demo_Task_5ms_0_5ms, OsScheduleTableSetEventTaskRef=/ActiveEcuC/Os/Core0_Demo_Task_5ms
              OsScheduleTableEventSetting_005: OsScheduleTableSetEventRef=/ActiveEcuC/Os/Rte_Ev_Cyclic_Core0_BSWApp_Task_5ms_0_5ms, OsScheduleTableSetEventTaskRef=/ActiveEcuC/Os/Core0_BSWApp_Task_5ms
              OsScheduleTableEventSetting_006: OsScheduleTableSetEventRef=/ActiveEcuC/Os/Rte_Ev_Cyclic_Core0_ASIL_BSW_Task_5ms_0_5ms, OsScheduleTableSetEventTaskRef=/ActiveEcuC/Os/Core0_ASIL_BSW_Task_5ms
          ExpiryPoint_36: OsScheduleTblExpPointOffset=36
            OsScheduleTableEventSetting_000 (OsScheduleTableEventSetting):
              OsScheduleTableSetEventRef = /ActiveEcuC/Os/Rte_Ev_Cyclic_Core0_Demo_Task_1ms_0_1ms
              OsScheduleTableSetEventTaskRef = /ActiveEcuC/Os/Core0_Demo_Task_1ms
            OsScheduleTableEventSetting_001 (OsScheduleTableEventSetting):
              OsScheduleTableSetEventRef = /ActiveEcuC/Os/Rte_Ev_Cyclic_Core0_BSWApp_Task_1ms_0_1ms
              OsScheduleTableSetEventTaskRef = /ActiveEcuC/Os/Core0_BSWApp_Task_1ms
          ExpiryPoint_37: OsScheduleTblExpPointOffset=37
            OsScheduleTableEventSetting_000 (OsScheduleTableEventSetting):
              OsScheduleTableSetEventRef = /ActiveEcuC/Os/Rte_Ev_Cyclic_Core0_Demo_Task_1ms_0_1ms
              OsScheduleTableSetEventTaskRef = /ActiveEcuC/Os/Core0_Demo_Task_1ms
            OsScheduleTableEventSetting_001 (OsScheduleTableEventSetting):
              OsScheduleTableSetEventRef = /ActiveEcuC/Os/Rte_Ev_Cyclic_Core0_BSWApp_Task_1ms_0_1ms
              OsScheduleTableSetEventTaskRef = /ActiveEcuC/Os/Core0_BSWApp_Task_1ms
          ExpiryPoint_38: OsScheduleTblExpPointOffset=38
            OsScheduleTableEventSetting_000 (OsScheduleTableEventSetting):
              OsScheduleTableSetEventRef = /ActiveEcuC/Os/Rte_Ev_Cyclic_Core0_Demo_Task_1ms_0_1ms
              OsScheduleTableSetEventTaskRef = /ActiveEcuC/Os/Core0_Demo_Task_1ms
            OsScheduleTableEventSetting_001 (OsScheduleTableEventSetting):
              OsScheduleTableSetEventRef = /ActiveEcuC/Os/Rte_Ev_Cyclic_Core0_BSWApp_Task_1ms_0_1ms
              OsScheduleTableSetEventTaskRef = /ActiveEcuC/Os/Core0_BSWApp_Task_1ms
          ExpiryPoint_39: OsScheduleTblExpPointOffset=39
            OsScheduleTableEventSetting_000 (OsScheduleTableEventSetting):
              OsScheduleTableSetEventRef = /ActiveEcuC/Os/Rte_Ev_Cyclic_Core0_Demo_Task_1ms_0_1ms
              OsScheduleTableSetEventTaskRef = /ActiveEcuC/Os/Core0_Demo_Task_1ms
            OsScheduleTableEventSetting_001 (OsScheduleTableEventSetting):
              OsScheduleTableSetEventRef = /ActiveEcuC/Os/Rte_Ev_Cyclic_Core0_BSWApp_Task_1ms_0_1ms
              OsScheduleTableSetEventTaskRef = /ActiveEcuC/Os/Core0_BSWApp_Task_1ms
          ExpiryPoint_40: OsScheduleTblExpPointOffset=40
            14 x OsScheduleTableEventSetting:
              OsScheduleTableEventSetting_000: OsScheduleTableSetEventRef=/ActiveEcuC/Os/Rte_Ev_Cyclic_Core0_Demo_Task_1ms_0_1ms, OsScheduleTableSetEventTaskRef=/ActiveEcuC/Os/Core0_Demo_Task_1ms
              OsScheduleTableEventSetting_001: OsScheduleTableSetEventRef=/ActiveEcuC/Os/Rte_Ev_Cyclic_Core0_BSWApp_Task_1ms_0_1ms, OsScheduleTableSetEventTaskRef=/ActiveEcuC/Os/Core0_BSWApp_Task_1ms
              OsScheduleTableEventSetting_002: OsScheduleTableSetEventRef=/ActiveEcuC/Os/Rte_Ev_Cyclic_Core0_BSW_Task_5ms_0_5ms, OsScheduleTableSetEventTaskRef=/ActiveEcuC/Os/Core0_BSW_Task_5ms
              OsScheduleTableEventSetting_003: OsScheduleTableSetEventRef=/ActiveEcuC/Os/Rte_Ev_Cyclic2_Core0_BSW_Task_5ms_0_5ms, OsScheduleTableSetEventTaskRef=/ActiveEcuC/Os/Core0_BSW_Task_5ms
              OsScheduleTableEventSetting_004: OsScheduleTableSetEventRef=/ActiveEcuC/Os/Rte_Ev_Cyclic_Core0_Demo_Task_5ms_0_5ms, OsScheduleTableSetEventTaskRef=/ActiveEcuC/Os/Core0_Demo_Task_5ms
              OsScheduleTableEventSetting_005: OsScheduleTableSetEventRef=/ActiveEcuC/Os/Rte_Ev_Cyclic_Core0_BSWApp_Task_5ms_0_5ms, OsScheduleTableSetEventTaskRef=/ActiveEcuC/Os/Core0_BSWApp_Task_5ms
              OsScheduleTableEventSetting_006: OsScheduleTableSetEventRef=/ActiveEcuC/Os/Rte_Ev_Cyclic_Core0_ASIL_BSW_Task_5ms_0_5ms, OsScheduleTableSetEventTaskRef=/ActiveEcuC/Os/Core0_ASIL_BSW_Task_5ms
              OsScheduleTableEventSetting_007: OsScheduleTableSetEventRef=/ActiveEcuC/Os/Rte_Ev_Cyclic_Core0_BSW_Task_10ms_0_10ms, OsScheduleTableSetEventTaskRef=/ActiveEcuC/Os/Core0_BSW_Task_10ms
              OsScheduleTableEventSetting_008: OsScheduleTableSetEventRef=/ActiveEcuC/Os/Rte_Ev_Cyclic_Core0_Demo_Task_10ms_0_10ms, OsScheduleTableSetEventTaskRef=/ActiveEcuC/Os/Core0_Demo_Task_10ms
              OsScheduleTableEventSetting_009: OsScheduleTableSetEventRef=/ActiveEcuC/Os/Rte_Ev_Cyclic_Core0_BSWApp_Task_10ms_0_10ms, OsScheduleTableSetEventTaskRef=/ActiveEcuC/Os/Core0_BSWApp_Task_10ms
              OsScheduleTableEventSetting_010: OsScheduleTableSetEventRef=/ActiveEcuC/Os/Rte_Ev_Cyclic_Core0_ASIL_BSW_Task_10ms_0_10ms, OsScheduleTableSetEventTaskRef=/ActiveEcuC/Os/Core0_ASIL_BSW_Task_10ms
              OsScheduleTableEventSetting_011: OsScheduleTableSetEventRef=/ActiveEcuC/Os/Rte_Ev_Cyclic_Core0_ActuatorIN_Task_10ms_0_10ms, OsScheduleTableSetEventTaskRef=/ActiveEcuC/Os/Core0_ActuatorIN_Task_10ms
              OsScheduleTableEventSetting_012: OsScheduleTableSetEventRef=/ActiveEcuC/Os/Rte_Ev_Cyclic_Core0_ActuatorOUT_Task_10ms_0_10ms, OsScheduleTableSetEventTaskRef=/ActiveEcuC/Os/Core0_ActuatorOUT_Task_10ms
              OsScheduleTableEventSetting_013: OsScheduleTableSetEventRef=/ActiveEcuC/Os/Rte_Ev_Cyclic_Core0_BSW_Task_10ms_LowPriority_0_10ms, OsScheduleTableSetEventTaskRef=/ActiveEcuC/Os/Core0_BSW_Task_10ms_LowPriority
          ExpiryPoint_41: OsScheduleTblExpPointOffset=41
            OsScheduleTableEventSetting_000 (OsScheduleTableEventSetting):
              OsScheduleTableSetEventRef = /ActiveEcuC/Os/Rte_Ev_Cyclic_Core0_Demo_Task_1ms_0_1ms
              OsScheduleTableSetEventTaskRef = /ActiveEcuC/Os/Core0_Demo_Task_1ms
            OsScheduleTableEventSetting_001 (OsScheduleTableEventSetting):
              OsScheduleTableSetEventRef = /ActiveEcuC/Os/Rte_Ev_Cyclic_Core0_BSWApp_Task_1ms_0_1ms
              OsScheduleTableSetEventTaskRef = /ActiveEcuC/Os/Core0_BSWApp_Task_1ms
          ExpiryPoint_42: OsScheduleTblExpPointOffset=42
            OsScheduleTableEventSetting_000 (OsScheduleTableEventSetting):
              OsScheduleTableSetEventRef = /ActiveEcuC/Os/Rte_Ev_Cyclic_Core0_Demo_Task_1ms_0_1ms
              OsScheduleTableSetEventTaskRef = /ActiveEcuC/Os/Core0_Demo_Task_1ms
            OsScheduleTableEventSetting_001 (OsScheduleTableEventSetting):
              OsScheduleTableSetEventRef = /ActiveEcuC/Os/Rte_Ev_Cyclic_Core0_BSWApp_Task_1ms_0_1ms
              OsScheduleTableSetEventTaskRef = /ActiveEcuC/Os/Core0_BSWApp_Task_1ms
          ExpiryPoint_43: OsScheduleTblExpPointOffset=43
            OsScheduleTableEventSetting_000 (OsScheduleTableEventSetting):
              OsScheduleTableSetEventRef = /ActiveEcuC/Os/Rte_Ev_Cyclic_Core0_Demo_Task_1ms_0_1ms
              OsScheduleTableSetEventTaskRef = /ActiveEcuC/Os/Core0_Demo_Task_1ms
            OsScheduleTableEventSetting_001 (OsScheduleTableEventSetting):
              OsScheduleTableSetEventRef = /ActiveEcuC/Os/Rte_Ev_Cyclic_Core0_BSWApp_Task_1ms_0_1ms
              OsScheduleTableSetEventTaskRef = /ActiveEcuC/Os/Core0_BSWApp_Task_1ms
          ExpiryPoint_44: OsScheduleTblExpPointOffset=44
            OsScheduleTableEventSetting_000 (OsScheduleTableEventSetting):
              OsScheduleTableSetEventRef = /ActiveEcuC/Os/Rte_Ev_Cyclic_Core0_Demo_Task_1ms_0_1ms
              OsScheduleTableSetEventTaskRef = /ActiveEcuC/Os/Core0_Demo_Task_1ms
            OsScheduleTableEventSetting_001 (OsScheduleTableEventSetting):
              OsScheduleTableSetEventRef = /ActiveEcuC/Os/Rte_Ev_Cyclic_Core0_BSWApp_Task_1ms_0_1ms
              OsScheduleTableSetEventTaskRef = /ActiveEcuC/Os/Core0_BSWApp_Task_1ms
          ExpiryPoint_45: OsScheduleTblExpPointOffset=45
            7 x OsScheduleTableEventSetting:
              OsScheduleTableEventSetting_000: OsScheduleTableSetEventRef=/ActiveEcuC/Os/Rte_Ev_Cyclic_Core0_Demo_Task_1ms_0_1ms, OsScheduleTableSetEventTaskRef=/ActiveEcuC/Os/Core0_Demo_Task_1ms
              OsScheduleTableEventSetting_001: OsScheduleTableSetEventRef=/ActiveEcuC/Os/Rte_Ev_Cyclic_Core0_BSWApp_Task_1ms_0_1ms, OsScheduleTableSetEventTaskRef=/ActiveEcuC/Os/Core0_BSWApp_Task_1ms
              OsScheduleTableEventSetting_002: OsScheduleTableSetEventRef=/ActiveEcuC/Os/Rte_Ev_Cyclic_Core0_BSW_Task_5ms_0_5ms, OsScheduleTableSetEventTaskRef=/ActiveEcuC/Os/Core0_BSW_Task_5ms
              OsScheduleTableEventSetting_003: OsScheduleTableSetEventRef=/ActiveEcuC/Os/Rte_Ev_Cyclic2_Core0_BSW_Task_5ms_0_5ms, OsScheduleTableSetEventTaskRef=/ActiveEcuC/Os/Core0_BSW_Task_5ms
              OsScheduleTableEventSetting_004: OsScheduleTableSetEventRef=/ActiveEcuC/Os/Rte_Ev_Cyclic_Core0_Demo_Task_5ms_0_5ms, OsScheduleTableSetEventTaskRef=/ActiveEcuC/Os/Core0_Demo_Task_5ms
              OsScheduleTableEventSetting_005: OsScheduleTableSetEventRef=/ActiveEcuC/Os/Rte_Ev_Cyclic_Core0_BSWApp_Task_5ms_0_5ms, OsScheduleTableSetEventTaskRef=/ActiveEcuC/Os/Core0_BSWApp_Task_5ms
              OsScheduleTableEventSetting_006: OsScheduleTableSetEventRef=/ActiveEcuC/Os/Rte_Ev_Cyclic_Core0_ASIL_BSW_Task_5ms_0_5ms, OsScheduleTableSetEventTaskRef=/ActiveEcuC/Os/Core0_ASIL_BSW_Task_5ms
          ExpiryPoint_46: OsScheduleTblExpPointOffset=46
            OsScheduleTableEventSetting_000 (OsScheduleTableEventSetting):
              OsScheduleTableSetEventRef = /ActiveEcuC/Os/Rte_Ev_Cyclic_Core0_Demo_Task_1ms_0_1ms
              OsScheduleTableSetEventTaskRef = /ActiveEcuC/Os/Core0_Demo_Task_1ms
            OsScheduleTableEventSetting_001 (OsScheduleTableEventSetting):
              OsScheduleTableSetEventRef = /ActiveEcuC/Os/Rte_Ev_Cyclic_Core0_BSWApp_Task_1ms_0_1ms
              OsScheduleTableSetEventTaskRef = /ActiveEcuC/Os/Core0_BSWApp_Task_1ms
          ExpiryPoint_47: OsScheduleTblExpPointOffset=47
            OsScheduleTableEventSetting_000 (OsScheduleTableEventSetting):
              OsScheduleTableSetEventRef = /ActiveEcuC/Os/Rte_Ev_Cyclic_Core0_Demo_Task_1ms_0_1ms
              OsScheduleTableSetEventTaskRef = /ActiveEcuC/Os/Core0_Demo_Task_1ms
            OsScheduleTableEventSetting_001 (OsScheduleTableEventSetting):
              OsScheduleTableSetEventRef = /ActiveEcuC/Os/Rte_Ev_Cyclic_Core0_BSWApp_Task_1ms_0_1ms
              OsScheduleTableSetEventTaskRef = /ActiveEcuC/Os/Core0_BSWApp_Task_1ms
          ExpiryPoint_48: OsScheduleTblExpPointOffset=48
            OsScheduleTableEventSetting_000 (OsScheduleTableEventSetting):
              OsScheduleTableSetEventRef = /ActiveEcuC/Os/Rte_Ev_Cyclic_Core0_Demo_Task_1ms_0_1ms
              OsScheduleTableSetEventTaskRef = /ActiveEcuC/Os/Core0_Demo_Task_1ms
            OsScheduleTableEventSetting_001 (OsScheduleTableEventSetting):
              OsScheduleTableSetEventRef = /ActiveEcuC/Os/Rte_Ev_Cyclic_Core0_BSWApp_Task_1ms_0_1ms
              OsScheduleTableSetEventTaskRef = /ActiveEcuC/Os/Core0_BSWApp_Task_1ms
          ExpiryPoint_49: OsScheduleTblExpPointOffset=49
            OsScheduleTableEventSetting_000 (OsScheduleTableEventSetting):
              OsScheduleTableSetEventRef = /ActiveEcuC/Os/Rte_Ev_Cyclic_Core0_Demo_Task_1ms_0_1ms
              OsScheduleTableSetEventTaskRef = /ActiveEcuC/Os/Core0_Demo_Task_1ms
            OsScheduleTableEventSetting_001 (OsScheduleTableEventSetting):
              OsScheduleTableSetEventRef = /ActiveEcuC/Os/Rte_Ev_Cyclic_Core0_BSWApp_Task_1ms_0_1ms
              OsScheduleTableSetEventTaskRef = /ActiveEcuC/Os/Core0_BSWApp_Task_1ms
          ExpiryPoint_50: OsScheduleTblExpPointOffset=50
            15 x OsScheduleTableEventSetting:
              OsScheduleTableEventSetting_000: OsScheduleTableSetEventRef=/ActiveEcuC/Os/Rte_Ev_Cyclic_Core0_Demo_Task_1ms_0_1ms, OsScheduleTableSetEventTaskRef=/ActiveEcuC/Os/Core0_Demo_Task_1ms
              OsScheduleTableEventSetting_001: OsScheduleTableSetEventRef=/ActiveEcuC/Os/Rte_Ev_Cyclic_Core0_BSWApp_Task_1ms_0_1ms, OsScheduleTableSetEventTaskRef=/ActiveEcuC/Os/Core0_BSWApp_Task_1ms
              OsScheduleTableEventSetting_002: OsScheduleTableSetEventRef=/ActiveEcuC/Os/Rte_Ev_Cyclic_Core0_BSW_Task_5ms_0_5ms, OsScheduleTableSetEventTaskRef=/ActiveEcuC/Os/Core0_BSW_Task_5ms
              OsScheduleTableEventSetting_003: OsScheduleTableSetEventRef=/ActiveEcuC/Os/Rte_Ev_Cyclic2_Core0_BSW_Task_5ms_0_50ms, OsScheduleTableSetEventTaskRef=/ActiveEcuC/Os/Core0_BSW_Task_5ms
              OsScheduleTableEventSetting_004: OsScheduleTableSetEventRef=/ActiveEcuC/Os/Rte_Ev_Cyclic2_Core0_BSW_Task_5ms_0_5ms, OsScheduleTableSetEventTaskRef=/ActiveEcuC/Os/Core0_BSW_Task_5ms
              OsScheduleTableEventSetting_005: OsScheduleTableSetEventRef=/ActiveEcuC/Os/Rte_Ev_Cyclic_Core0_Demo_Task_5ms_0_5ms, OsScheduleTableSetEventTaskRef=/ActiveEcuC/Os/Core0_Demo_Task_5ms
              OsScheduleTableEventSetting_006: OsScheduleTableSetEventRef=/ActiveEcuC/Os/Rte_Ev_Cyclic_Core0_BSWApp_Task_5ms_0_5ms, OsScheduleTableSetEventTaskRef=/ActiveEcuC/Os/Core0_BSWApp_Task_5ms
              OsScheduleTableEventSetting_007: OsScheduleTableSetEventRef=/ActiveEcuC/Os/Rte_Ev_Cyclic_Core0_ASIL_BSW_Task_5ms_0_5ms, OsScheduleTableSetEventTaskRef=/ActiveEcuC/Os/Core0_ASIL_BSW_Task_5ms
              OsScheduleTableEventSetting_008: OsScheduleTableSetEventRef=/ActiveEcuC/Os/Rte_Ev_Cyclic_Core0_BSW_Task_10ms_0_10ms, OsScheduleTableSetEventTaskRef=/ActiveEcuC/Os/Core0_BSW_Task_10ms
              OsScheduleTableEventSetting_009: OsScheduleTableSetEventRef=/ActiveEcuC/Os/Rte_Ev_Cyclic_Core0_Demo_Task_10ms_0_10ms, OsScheduleTableSetEventTaskRef=/ActiveEcuC/Os/Core0_Demo_Task_10ms
              OsScheduleTableEventSetting_010: OsScheduleTableSetEventRef=/ActiveEcuC/Os/Rte_Ev_Cyclic_Core0_BSWApp_Task_10ms_0_10ms, OsScheduleTableSetEventTaskRef=/ActiveEcuC/Os/Core0_BSWApp_Task_10ms
              OsScheduleTableEventSetting_011: OsScheduleTableSetEventRef=/ActiveEcuC/Os/Rte_Ev_Cyclic_Core0_ASIL_BSW_Task_10ms_0_10ms, OsScheduleTableSetEventTaskRef=/ActiveEcuC/Os/Core0_ASIL_BSW_Task_10ms
              OsScheduleTableEventSetting_012: OsScheduleTableSetEventRef=/ActiveEcuC/Os/Rte_Ev_Cyclic_Core0_ActuatorIN_Task_10ms_0_10ms, OsScheduleTableSetEventTaskRef=/ActiveEcuC/Os/Core0_ActuatorIN_Task_10ms
              OsScheduleTableEventSetting_013: OsScheduleTableSetEventRef=/ActiveEcuC/Os/Rte_Ev_Cyclic_Core0_ActuatorOUT_Task_10ms_0_10ms, OsScheduleTableSetEventTaskRef=/ActiveEcuC/Os/Core0_ActuatorOUT_Task_10ms
              OsScheduleTableEventSetting_014: OsScheduleTableSetEventRef=/ActiveEcuC/Os/Rte_Ev_Cyclic_Core0_BSW_Task_10ms_LowPriority_0_10ms, OsScheduleTableSetEventTaskRef=/ActiveEcuC/Os/Core0_BSW_Task_10ms_LowPriority
          ExpiryPoint_51: OsScheduleTblExpPointOffset=51
            OsScheduleTableEventSetting_000 (OsScheduleTableEventSetting):
              OsScheduleTableSetEventRef = /ActiveEcuC/Os/Rte_Ev_Cyclic_Core0_Demo_Task_1ms_0_1ms
              OsScheduleTableSetEventTaskRef = /ActiveEcuC/Os/Core0_Demo_Task_1ms
            OsScheduleTableEventSetting_001 (OsScheduleTableEventSetting):
              OsScheduleTableSetEventRef = /ActiveEcuC/Os/Rte_Ev_Cyclic_Core0_BSWApp_Task_1ms_0_1ms
              OsScheduleTableSetEventTaskRef = /ActiveEcuC/Os/Core0_BSWApp_Task_1ms
          ExpiryPoint_52: OsScheduleTblExpPointOffset=52
            OsScheduleTableEventSetting_000 (OsScheduleTableEventSetting):
              OsScheduleTableSetEventRef = /ActiveEcuC/Os/Rte_Ev_Cyclic_Core0_Demo_Task_1ms_0_1ms
              OsScheduleTableSetEventTaskRef = /ActiveEcuC/Os/Core0_Demo_Task_1ms
            OsScheduleTableEventSetting_001 (OsScheduleTableEventSetting):
              OsScheduleTableSetEventRef = /ActiveEcuC/Os/Rte_Ev_Cyclic_Core0_BSWApp_Task_1ms_0_1ms
              OsScheduleTableSetEventTaskRef = /ActiveEcuC/Os/Core0_BSWApp_Task_1ms
          ExpiryPoint_53: OsScheduleTblExpPointOffset=53
            OsScheduleTableEventSetting_000 (OsScheduleTableEventSetting):
              OsScheduleTableSetEventRef = /ActiveEcuC/Os/Rte_Ev_Cyclic_Core0_Demo_Task_1ms_0_1ms
              OsScheduleTableSetEventTaskRef = /ActiveEcuC/Os/Core0_Demo_Task_1ms
            OsScheduleTableEventSetting_001 (OsScheduleTableEventSetting):
              OsScheduleTableSetEventRef = /ActiveEcuC/Os/Rte_Ev_Cyclic_Core0_BSWApp_Task_1ms_0_1ms
              OsScheduleTableSetEventTaskRef = /ActiveEcuC/Os/Core0_BSWApp_Task_1ms
          ExpiryPoint_54: OsScheduleTblExpPointOffset=54
            OsScheduleTableEventSetting_000 (OsScheduleTableEventSetting):
              OsScheduleTableSetEventRef = /ActiveEcuC/Os/Rte_Ev_Cyclic_Core0_Demo_Task_1ms_0_1ms
              OsScheduleTableSetEventTaskRef = /ActiveEcuC/Os/Core0_Demo_Task_1ms
            OsScheduleTableEventSetting_001 (OsScheduleTableEventSetting):
              OsScheduleTableSetEventRef = /ActiveEcuC/Os/Rte_Ev_Cyclic_Core0_BSWApp_Task_1ms_0_1ms
              OsScheduleTableSetEventTaskRef = /ActiveEcuC/Os/Core0_BSWApp_Task_1ms
          ExpiryPoint_55: OsScheduleTblExpPointOffset=55
            7 x OsScheduleTableEventSetting:
              OsScheduleTableEventSetting_000: OsScheduleTableSetEventRef=/ActiveEcuC/Os/Rte_Ev_Cyclic_Core0_Demo_Task_1ms_0_1ms, OsScheduleTableSetEventTaskRef=/ActiveEcuC/Os/Core0_Demo_Task_1ms
              OsScheduleTableEventSetting_001: OsScheduleTableSetEventRef=/ActiveEcuC/Os/Rte_Ev_Cyclic_Core0_BSWApp_Task_1ms_0_1ms, OsScheduleTableSetEventTaskRef=/ActiveEcuC/Os/Core0_BSWApp_Task_1ms
              OsScheduleTableEventSetting_002: OsScheduleTableSetEventRef=/ActiveEcuC/Os/Rte_Ev_Cyclic_Core0_BSW_Task_5ms_0_5ms, OsScheduleTableSetEventTaskRef=/ActiveEcuC/Os/Core0_BSW_Task_5ms
              OsScheduleTableEventSetting_003: OsScheduleTableSetEventRef=/ActiveEcuC/Os/Rte_Ev_Cyclic2_Core0_BSW_Task_5ms_0_5ms, OsScheduleTableSetEventTaskRef=/ActiveEcuC/Os/Core0_BSW_Task_5ms
              OsScheduleTableEventSetting_004: OsScheduleTableSetEventRef=/ActiveEcuC/Os/Rte_Ev_Cyclic_Core0_Demo_Task_5ms_0_5ms, OsScheduleTableSetEventTaskRef=/ActiveEcuC/Os/Core0_Demo_Task_5ms
              OsScheduleTableEventSetting_005: OsScheduleTableSetEventRef=/ActiveEcuC/Os/Rte_Ev_Cyclic_Core0_BSWApp_Task_5ms_0_5ms, OsScheduleTableSetEventTaskRef=/ActiveEcuC/Os/Core0_BSWApp_Task_5ms
              OsScheduleTableEventSetting_006: OsScheduleTableSetEventRef=/ActiveEcuC/Os/Rte_Ev_Cyclic_Core0_ASIL_BSW_Task_5ms_0_5ms, OsScheduleTableSetEventTaskRef=/ActiveEcuC/Os/Core0_ASIL_BSW_Task_5ms
          ExpiryPoint_56: OsScheduleTblExpPointOffset=56
            OsScheduleTableEventSetting_000 (OsScheduleTableEventSetting):
              OsScheduleTableSetEventRef = /ActiveEcuC/Os/Rte_Ev_Cyclic_Core0_Demo_Task_1ms_0_1ms
              OsScheduleTableSetEventTaskRef = /ActiveEcuC/Os/Core0_Demo_Task_1ms
            OsScheduleTableEventSetting_001 (OsScheduleTableEventSetting):
              OsScheduleTableSetEventRef = /ActiveEcuC/Os/Rte_Ev_Cyclic_Core0_BSWApp_Task_1ms_0_1ms
              OsScheduleTableSetEventTaskRef = /ActiveEcuC/Os/Core0_BSWApp_Task_1ms
          ExpiryPoint_57: OsScheduleTblExpPointOffset=57
            OsScheduleTableEventSetting_000 (OsScheduleTableEventSetting):
              OsScheduleTableSetEventRef = /ActiveEcuC/Os/Rte_Ev_Cyclic_Core0_Demo_Task_1ms_0_1ms
              OsScheduleTableSetEventTaskRef = /ActiveEcuC/Os/Core0_Demo_Task_1ms
            OsScheduleTableEventSetting_001 (OsScheduleTableEventSetting):
              OsScheduleTableSetEventRef = /ActiveEcuC/Os/Rte_Ev_Cyclic_Core0_BSWApp_Task_1ms_0_1ms
              OsScheduleTableSetEventTaskRef = /ActiveEcuC/Os/Core0_BSWApp_Task_1ms
          ExpiryPoint_58: OsScheduleTblExpPointOffset=58
            OsScheduleTableEventSetting_000 (OsScheduleTableEventSetting):
              OsScheduleTableSetEventRef = /ActiveEcuC/Os/Rte_Ev_Cyclic_Core0_Demo_Task_1ms_0_1ms
              OsScheduleTableSetEventTaskRef = /ActiveEcuC/Os/Core0_Demo_Task_1ms
            OsScheduleTableEventSetting_001 (OsScheduleTableEventSetting):
              OsScheduleTableSetEventRef = /ActiveEcuC/Os/Rte_Ev_Cyclic_Core0_BSWApp_Task_1ms_0_1ms
              OsScheduleTableSetEventTaskRef = /ActiveEcuC/Os/Core0_BSWApp_Task_1ms
          ExpiryPoint_59: OsScheduleTblExpPointOffset=59
            OsScheduleTableEventSetting_000 (OsScheduleTableEventSetting):
              OsScheduleTableSetEventRef = /ActiveEcuC/Os/Rte_Ev_Cyclic_Core0_Demo_Task_1ms_0_1ms
              OsScheduleTableSetEventTaskRef = /ActiveEcuC/Os/Core0_Demo_Task_1ms
            OsScheduleTableEventSetting_001 (OsScheduleTableEventSetting):
              OsScheduleTableSetEventRef = /ActiveEcuC/Os/Rte_Ev_Cyclic_Core0_BSWApp_Task_1ms_0_1ms
              OsScheduleTableSetEventTaskRef = /ActiveEcuC/Os/Core0_BSWApp_Task_1ms
          ExpiryPoint_60: OsScheduleTblExpPointOffset=60
            14 x OsScheduleTableEventSetting:
              OsScheduleTableEventSetting_000: OsScheduleTableSetEventRef=/ActiveEcuC/Os/Rte_Ev_Cyclic_Core0_Demo_Task_1ms_0_1ms, OsScheduleTableSetEventTaskRef=/ActiveEcuC/Os/Core0_Demo_Task_1ms
              OsScheduleTableEventSetting_001: OsScheduleTableSetEventRef=/ActiveEcuC/Os/Rte_Ev_Cyclic_Core0_BSWApp_Task_1ms_0_1ms, OsScheduleTableSetEventTaskRef=/ActiveEcuC/Os/Core0_BSWApp_Task_1ms
              OsScheduleTableEventSetting_002: OsScheduleTableSetEventRef=/ActiveEcuC/Os/Rte_Ev_Cyclic_Core0_BSW_Task_5ms_0_5ms, OsScheduleTableSetEventTaskRef=/ActiveEcuC/Os/Core0_BSW_Task_5ms
              OsScheduleTableEventSetting_003: OsScheduleTableSetEventRef=/ActiveEcuC/Os/Rte_Ev_Cyclic2_Core0_BSW_Task_5ms_0_5ms, OsScheduleTableSetEventTaskRef=/ActiveEcuC/Os/Core0_BSW_Task_5ms
              OsScheduleTableEventSetting_004: OsScheduleTableSetEventRef=/ActiveEcuC/Os/Rte_Ev_Cyclic_Core0_Demo_Task_5ms_0_5ms, OsScheduleTableSetEventTaskRef=/ActiveEcuC/Os/Core0_Demo_Task_5ms
              OsScheduleTableEventSetting_005: OsScheduleTableSetEventRef=/ActiveEcuC/Os/Rte_Ev_Cyclic_Core0_BSWApp_Task_5ms_0_5ms, OsScheduleTableSetEventTaskRef=/ActiveEcuC/Os/Core0_BSWApp_Task_5ms
              OsScheduleTableEventSetting_006: OsScheduleTableSetEventRef=/ActiveEcuC/Os/Rte_Ev_Cyclic_Core0_ASIL_BSW_Task_5ms_0_5ms, OsScheduleTableSetEventTaskRef=/ActiveEcuC/Os/Core0_ASIL_BSW_Task_5ms
              OsScheduleTableEventSetting_007: OsScheduleTableSetEventRef=/ActiveEcuC/Os/Rte_Ev_Cyclic_Core0_BSW_Task_10ms_0_10ms, OsScheduleTableSetEventTaskRef=/ActiveEcuC/Os/Core0_BSW_Task_10ms
              OsScheduleTableEventSetting_008: OsScheduleTableSetEventRef=/ActiveEcuC/Os/Rte_Ev_Cyclic_Core0_Demo_Task_10ms_0_10ms, OsScheduleTableSetEventTaskRef=/ActiveEcuC/Os/Core0_Demo_Task_10ms
              OsScheduleTableEventSetting_009: OsScheduleTableSetEventRef=/ActiveEcuC/Os/Rte_Ev_Cyclic_Core0_BSWApp_Task_10ms_0_10ms, OsScheduleTableSetEventTaskRef=/ActiveEcuC/Os/Core0_BSWApp_Task_10ms
              OsScheduleTableEventSetting_010: OsScheduleTableSetEventRef=/ActiveEcuC/Os/Rte_Ev_Cyclic_Core0_ASIL_BSW_Task_10ms_0_10ms, OsScheduleTableSetEventTaskRef=/ActiveEcuC/Os/Core0_ASIL_BSW_Task_10ms
              OsScheduleTableEventSetting_011: OsScheduleTableSetEventRef=/ActiveEcuC/Os/Rte_Ev_Cyclic_Core0_ActuatorIN_Task_10ms_0_10ms, OsScheduleTableSetEventTaskRef=/ActiveEcuC/Os/Core0_ActuatorIN_Task_10ms
              OsScheduleTableEventSetting_012: OsScheduleTableSetEventRef=/ActiveEcuC/Os/Rte_Ev_Cyclic_Core0_ActuatorOUT_Task_10ms_0_10ms, OsScheduleTableSetEventTaskRef=/ActiveEcuC/Os/Core0_ActuatorOUT_Task_10ms
              OsScheduleTableEventSetting_013: OsScheduleTableSetEventRef=/ActiveEcuC/Os/Rte_Ev_Cyclic_Core0_BSW_Task_10ms_LowPriority_0_10ms, OsScheduleTableSetEventTaskRef=/ActiveEcuC/Os/Core0_BSW_Task_10ms_LowPriority
          ExpiryPoint_61: OsScheduleTblExpPointOffset=61
            OsScheduleTableEventSetting_000 (OsScheduleTableEventSetting):
              OsScheduleTableSetEventRef = /ActiveEcuC/Os/Rte_Ev_Cyclic_Core0_Demo_Task_1ms_0_1ms
              OsScheduleTableSetEventTaskRef = /ActiveEcuC/Os/Core0_Demo_Task_1ms
            OsScheduleTableEventSetting_001 (OsScheduleTableEventSetting):
              OsScheduleTableSetEventRef = /ActiveEcuC/Os/Rte_Ev_Cyclic_Core0_BSWApp_Task_1ms_0_1ms
              OsScheduleTableSetEventTaskRef = /ActiveEcuC/Os/Core0_BSWApp_Task_1ms
          ExpiryPoint_62: OsScheduleTblExpPointOffset=62
            OsScheduleTableEventSetting_000 (OsScheduleTableEventSetting):
              OsScheduleTableSetEventRef = /ActiveEcuC/Os/Rte_Ev_Cyclic_Core0_Demo_Task_1ms_0_1ms
              OsScheduleTableSetEventTaskRef = /ActiveEcuC/Os/Core0_Demo_Task_1ms
            OsScheduleTableEventSetting_001 (OsScheduleTableEventSetting):
              OsScheduleTableSetEventRef = /ActiveEcuC/Os/Rte_Ev_Cyclic_Core0_BSWApp_Task_1ms_0_1ms
              OsScheduleTableSetEventTaskRef = /ActiveEcuC/Os/Core0_BSWApp_Task_1ms
          ExpiryPoint_63: OsScheduleTblExpPointOffset=63
            OsScheduleTableEventSetting_000 (OsScheduleTableEventSetting):
              OsScheduleTableSetEventRef = /ActiveEcuC/Os/Rte_Ev_Cyclic_Core0_Demo_Task_1ms_0_1ms
              OsScheduleTableSetEventTaskRef = /ActiveEcuC/Os/Core0_Demo_Task_1ms
            OsScheduleTableEventSetting_001 (OsScheduleTableEventSetting):
              OsScheduleTableSetEventRef = /ActiveEcuC/Os/Rte_Ev_Cyclic_Core0_BSWApp_Task_1ms_0_1ms
              OsScheduleTableSetEventTaskRef = /ActiveEcuC/Os/Core0_BSWApp_Task_1ms
          ExpiryPoint_64: OsScheduleTblExpPointOffset=64
            OsScheduleTableEventSetting_000 (OsScheduleTableEventSetting):
              OsScheduleTableSetEventRef = /ActiveEcuC/Os/Rte_Ev_Cyclic_Core0_Demo_Task_1ms_0_1ms
              OsScheduleTableSetEventTaskRef = /ActiveEcuC/Os/Core0_Demo_Task_1ms
            OsScheduleTableEventSetting_001 (OsScheduleTableEventSetting):
              OsScheduleTableSetEventRef = /ActiveEcuC/Os/Rte_Ev_Cyclic_Core0_BSWApp_Task_1ms_0_1ms
              OsScheduleTableSetEventTaskRef = /ActiveEcuC/Os/Core0_BSWApp_Task_1ms
          ExpiryPoint_65: OsScheduleTblExpPointOffset=65
            7 x OsScheduleTableEventSetting:
              OsScheduleTableEventSetting_000: OsScheduleTableSetEventRef=/ActiveEcuC/Os/Rte_Ev_Cyclic_Core0_Demo_Task_1ms_0_1ms, OsScheduleTableSetEventTaskRef=/ActiveEcuC/Os/Core0_Demo_Task_1ms
              OsScheduleTableEventSetting_001: OsScheduleTableSetEventRef=/ActiveEcuC/Os/Rte_Ev_Cyclic_Core0_BSWApp_Task_1ms_0_1ms, OsScheduleTableSetEventTaskRef=/ActiveEcuC/Os/Core0_BSWApp_Task_1ms
              OsScheduleTableEventSetting_002: OsScheduleTableSetEventRef=/ActiveEcuC/Os/Rte_Ev_Cyclic_Core0_BSW_Task_5ms_0_5ms, OsScheduleTableSetEventTaskRef=/ActiveEcuC/Os/Core0_BSW_Task_5ms
              OsScheduleTableEventSetting_003: OsScheduleTableSetEventRef=/ActiveEcuC/Os/Rte_Ev_Cyclic2_Core0_BSW_Task_5ms_0_5ms, OsScheduleTableSetEventTaskRef=/ActiveEcuC/Os/Core0_BSW_Task_5ms
              OsScheduleTableEventSetting_004: OsScheduleTableSetEventRef=/ActiveEcuC/Os/Rte_Ev_Cyclic_Core0_Demo_Task_5ms_0_5ms, OsScheduleTableSetEventTaskRef=/ActiveEcuC/Os/Core0_Demo_Task_5ms
              OsScheduleTableEventSetting_005: OsScheduleTableSetEventRef=/ActiveEcuC/Os/Rte_Ev_Cyclic_Core0_BSWApp_Task_5ms_0_5ms, OsScheduleTableSetEventTaskRef=/ActiveEcuC/Os/Core0_BSWApp_Task_5ms
              OsScheduleTableEventSetting_006: OsScheduleTableSetEventRef=/ActiveEcuC/Os/Rte_Ev_Cyclic_Core0_ASIL_BSW_Task_5ms_0_5ms, OsScheduleTableSetEventTaskRef=/ActiveEcuC/Os/Core0_ASIL_BSW_Task_5ms
          ExpiryPoint_66: OsScheduleTblExpPointOffset=66
            OsScheduleTableEventSetting_000 (OsScheduleTableEventSetting):
              OsScheduleTableSetEventRef = /ActiveEcuC/Os/Rte_Ev_Cyclic_Core0_Demo_Task_1ms_0_1ms
              OsScheduleTableSetEventTaskRef = /ActiveEcuC/Os/Core0_Demo_Task_1ms
            OsScheduleTableEventSetting_001 (OsScheduleTableEventSetting):
              OsScheduleTableSetEventRef = /ActiveEcuC/Os/Rte_Ev_Cyclic_Core0_BSWApp_Task_1ms_0_1ms
              OsScheduleTableSetEventTaskRef = /ActiveEcuC/Os/Core0_BSWApp_Task_1ms
          ExpiryPoint_67: OsScheduleTblExpPointOffset=67
            OsScheduleTableEventSetting_000 (OsScheduleTableEventSetting):
              OsScheduleTableSetEventRef = /ActiveEcuC/Os/Rte_Ev_Cyclic_Core0_Demo_Task_1ms_0_1ms
              OsScheduleTableSetEventTaskRef = /ActiveEcuC/Os/Core0_Demo_Task_1ms
            OsScheduleTableEventSetting_001 (OsScheduleTableEventSetting):
              OsScheduleTableSetEventRef = /ActiveEcuC/Os/Rte_Ev_Cyclic_Core0_BSWApp_Task_1ms_0_1ms
              OsScheduleTableSetEventTaskRef = /ActiveEcuC/Os/Core0_BSWApp_Task_1ms
          ExpiryPoint_68: OsScheduleTblExpPointOffset=68
            OsScheduleTableEventSetting_000 (OsScheduleTableEventSetting):
              OsScheduleTableSetEventRef = /ActiveEcuC/Os/Rte_Ev_Cyclic_Core0_Demo_Task_1ms_0_1ms
              OsScheduleTableSetEventTaskRef = /ActiveEcuC/Os/Core0_Demo_Task_1ms
            OsScheduleTableEventSetting_001 (OsScheduleTableEventSetting):
              OsScheduleTableSetEventRef = /ActiveEcuC/Os/Rte_Ev_Cyclic_Core0_BSWApp_Task_1ms_0_1ms
              OsScheduleTableSetEventTaskRef = /ActiveEcuC/Os/Core0_BSWApp_Task_1ms
          ExpiryPoint_69: OsScheduleTblExpPointOffset=69
            OsScheduleTableEventSetting_000 (OsScheduleTableEventSetting):
              OsScheduleTableSetEventRef = /ActiveEcuC/Os/Rte_Ev_Cyclic_Core0_Demo_Task_1ms_0_1ms
              OsScheduleTableSetEventTaskRef = /ActiveEcuC/Os/Core0_Demo_Task_1ms
            OsScheduleTableEventSetting_001 (OsScheduleTableEventSetting):
              OsScheduleTableSetEventRef = /ActiveEcuC/Os/Rte_Ev_Cyclic_Core0_BSWApp_Task_1ms_0_1ms
              OsScheduleTableSetEventTaskRef = /ActiveEcuC/Os/Core0_BSWApp_Task_1ms
          ExpiryPoint_70: OsScheduleTblExpPointOffset=70
            14 x OsScheduleTableEventSetting:
              OsScheduleTableEventSetting_000: OsScheduleTableSetEventRef=/ActiveEcuC/Os/Rte_Ev_Cyclic_Core0_Demo_Task_1ms_0_1ms, OsScheduleTableSetEventTaskRef=/ActiveEcuC/Os/Core0_Demo_Task_1ms
              OsScheduleTableEventSetting_001: OsScheduleTableSetEventRef=/ActiveEcuC/Os/Rte_Ev_Cyclic_Core0_BSWApp_Task_1ms_0_1ms, OsScheduleTableSetEventTaskRef=/ActiveEcuC/Os/Core0_BSWApp_Task_1ms
              OsScheduleTableEventSetting_002: OsScheduleTableSetEventRef=/ActiveEcuC/Os/Rte_Ev_Cyclic_Core0_BSW_Task_5ms_0_5ms, OsScheduleTableSetEventTaskRef=/ActiveEcuC/Os/Core0_BSW_Task_5ms
              OsScheduleTableEventSetting_003: OsScheduleTableSetEventRef=/ActiveEcuC/Os/Rte_Ev_Cyclic2_Core0_BSW_Task_5ms_0_5ms, OsScheduleTableSetEventTaskRef=/ActiveEcuC/Os/Core0_BSW_Task_5ms
              OsScheduleTableEventSetting_004: OsScheduleTableSetEventRef=/ActiveEcuC/Os/Rte_Ev_Cyclic_Core0_Demo_Task_5ms_0_5ms, OsScheduleTableSetEventTaskRef=/ActiveEcuC/Os/Core0_Demo_Task_5ms
              OsScheduleTableEventSetting_005: OsScheduleTableSetEventRef=/ActiveEcuC/Os/Rte_Ev_Cyclic_Core0_BSWApp_Task_5ms_0_5ms, OsScheduleTableSetEventTaskRef=/ActiveEcuC/Os/Core0_BSWApp_Task_5ms
              OsScheduleTableEventSetting_006: OsScheduleTableSetEventRef=/ActiveEcuC/Os/Rte_Ev_Cyclic_Core0_ASIL_BSW_Task_5ms_0_5ms, OsScheduleTableSetEventTaskRef=/ActiveEcuC/Os/Core0_ASIL_BSW_Task_5ms
              OsScheduleTableEventSetting_007: OsScheduleTableSetEventRef=/ActiveEcuC/Os/Rte_Ev_Cyclic_Core0_BSW_Task_10ms_0_10ms, OsScheduleTableSetEventTaskRef=/ActiveEcuC/Os/Core0_BSW_Task_10ms
              OsScheduleTableEventSetting_008: OsScheduleTableSetEventRef=/ActiveEcuC/Os/Rte_Ev_Cyclic_Core0_Demo_Task_10ms_0_10ms, OsScheduleTableSetEventTaskRef=/ActiveEcuC/Os/Core0_Demo_Task_10ms
              OsScheduleTableEventSetting_009: OsScheduleTableSetEventRef=/ActiveEcuC/Os/Rte_Ev_Cyclic_Core0_BSWApp_Task_10ms_0_10ms, OsScheduleTableSetEventTaskRef=/ActiveEcuC/Os/Core0_BSWApp_Task_10ms
              OsScheduleTableEventSetting_010: OsScheduleTableSetEventRef=/ActiveEcuC/Os/Rte_Ev_Cyclic_Core0_ASIL_BSW_Task_10ms_0_10ms, OsScheduleTableSetEventTaskRef=/ActiveEcuC/Os/Core0_ASIL_BSW_Task_10ms
              OsScheduleTableEventSetting_011: OsScheduleTableSetEventRef=/ActiveEcuC/Os/Rte_Ev_Cyclic_Core0_ActuatorIN_Task_10ms_0_10ms, OsScheduleTableSetEventTaskRef=/ActiveEcuC/Os/Core0_ActuatorIN_Task_10ms
              OsScheduleTableEventSetting_012: OsScheduleTableSetEventRef=/ActiveEcuC/Os/Rte_Ev_Cyclic_Core0_ActuatorOUT_Task_10ms_0_10ms, OsScheduleTableSetEventTaskRef=/ActiveEcuC/Os/Core0_ActuatorOUT_Task_10ms
              OsScheduleTableEventSetting_013: OsScheduleTableSetEventRef=/ActiveEcuC/Os/Rte_Ev_Cyclic_Core0_BSW_Task_10ms_LowPriority_0_10ms, OsScheduleTableSetEventTaskRef=/ActiveEcuC/Os/Core0_BSW_Task_10ms_LowPriority
          ExpiryPoint_71: OsScheduleTblExpPointOffset=71
            OsScheduleTableEventSetting_000 (OsScheduleTableEventSetting):
              OsScheduleTableSetEventRef = /ActiveEcuC/Os/Rte_Ev_Cyclic_Core0_Demo_Task_1ms_0_1ms
              OsScheduleTableSetEventTaskRef = /ActiveEcuC/Os/Core0_Demo_Task_1ms
            OsScheduleTableEventSetting_001 (OsScheduleTableEventSetting):
              OsScheduleTableSetEventRef = /ActiveEcuC/Os/Rte_Ev_Cyclic_Core0_BSWApp_Task_1ms_0_1ms
              OsScheduleTableSetEventTaskRef = /ActiveEcuC/Os/Core0_BSWApp_Task_1ms
          ExpiryPoint_72: OsScheduleTblExpPointOffset=72
            OsScheduleTableEventSetting_000 (OsScheduleTableEventSetting):
              OsScheduleTableSetEventRef = /ActiveEcuC/Os/Rte_Ev_Cyclic_Core0_Demo_Task_1ms_0_1ms
              OsScheduleTableSetEventTaskRef = /ActiveEcuC/Os/Core0_Demo_Task_1ms
            OsScheduleTableEventSetting_001 (OsScheduleTableEventSetting):
              OsScheduleTableSetEventRef = /ActiveEcuC/Os/Rte_Ev_Cyclic_Core0_BSWApp_Task_1ms_0_1ms
              OsScheduleTableSetEventTaskRef = /ActiveEcuC/Os/Core0_BSWApp_Task_1ms
          ExpiryPoint_73: OsScheduleTblExpPointOffset=73
            OsScheduleTableEventSetting_000 (OsScheduleTableEventSetting):
              OsScheduleTableSetEventRef = /ActiveEcuC/Os/Rte_Ev_Cyclic_Core0_Demo_Task_1ms_0_1ms
              OsScheduleTableSetEventTaskRef = /ActiveEcuC/Os/Core0_Demo_Task_1ms
            OsScheduleTableEventSetting_001 (OsScheduleTableEventSetting):
              OsScheduleTableSetEventRef = /ActiveEcuC/Os/Rte_Ev_Cyclic_Core0_BSWApp_Task_1ms_0_1ms
              OsScheduleTableSetEventTaskRef = /ActiveEcuC/Os/Core0_BSWApp_Task_1ms
          ExpiryPoint_74: OsScheduleTblExpPointOffset=74
            OsScheduleTableEventSetting_000 (OsScheduleTableEventSetting):
              OsScheduleTableSetEventRef = /ActiveEcuC/Os/Rte_Ev_Cyclic_Core0_Demo_Task_1ms_0_1ms
              OsScheduleTableSetEventTaskRef = /ActiveEcuC/Os/Core0_Demo_Task_1ms
            OsScheduleTableEventSetting_001 (OsScheduleTableEventSetting):
              OsScheduleTableSetEventRef = /ActiveEcuC/Os/Rte_Ev_Cyclic_Core0_BSWApp_Task_1ms_0_1ms
              OsScheduleTableSetEventTaskRef = /ActiveEcuC/Os/Core0_BSWApp_Task_1ms
          ExpiryPoint_75: OsScheduleTblExpPointOffset=75
            7 x OsScheduleTableEventSetting:
              OsScheduleTableEventSetting_000: OsScheduleTableSetEventRef=/ActiveEcuC/Os/Rte_Ev_Cyclic_Core0_Demo_Task_1ms_0_1ms, OsScheduleTableSetEventTaskRef=/ActiveEcuC/Os/Core0_Demo_Task_1ms
              OsScheduleTableEventSetting_001: OsScheduleTableSetEventRef=/ActiveEcuC/Os/Rte_Ev_Cyclic_Core0_BSWApp_Task_1ms_0_1ms, OsScheduleTableSetEventTaskRef=/ActiveEcuC/Os/Core0_BSWApp_Task_1ms
              OsScheduleTableEventSetting_002: OsScheduleTableSetEventRef=/ActiveEcuC/Os/Rte_Ev_Cyclic_Core0_BSW_Task_5ms_0_5ms, OsScheduleTableSetEventTaskRef=/ActiveEcuC/Os/Core0_BSW_Task_5ms
              OsScheduleTableEventSetting_003: OsScheduleTableSetEventRef=/ActiveEcuC/Os/Rte_Ev_Cyclic2_Core0_BSW_Task_5ms_0_5ms, OsScheduleTableSetEventTaskRef=/ActiveEcuC/Os/Core0_BSW_Task_5ms
              OsScheduleTableEventSetting_004: OsScheduleTableSetEventRef=/ActiveEcuC/Os/Rte_Ev_Cyclic_Core0_Demo_Task_5ms_0_5ms, OsScheduleTableSetEventTaskRef=/ActiveEcuC/Os/Core0_Demo_Task_5ms
              OsScheduleTableEventSetting_005: OsScheduleTableSetEventRef=/ActiveEcuC/Os/Rte_Ev_Cyclic_Core0_BSWApp_Task_5ms_0_5ms, OsScheduleTableSetEventTaskRef=/ActiveEcuC/Os/Core0_BSWApp_Task_5ms
              OsScheduleTableEventSetting_006: OsScheduleTableSetEventRef=/ActiveEcuC/Os/Rte_Ev_Cyclic_Core0_ASIL_BSW_Task_5ms_0_5ms, OsScheduleTableSetEventTaskRef=/ActiveEcuC/Os/Core0_ASIL_BSW_Task_5ms
          ExpiryPoint_76: OsScheduleTblExpPointOffset=76
            OsScheduleTableEventSetting_000 (OsScheduleTableEventSetting):
              OsScheduleTableSetEventRef = /ActiveEcuC/Os/Rte_Ev_Cyclic_Core0_Demo_Task_1ms_0_1ms
              OsScheduleTableSetEventTaskRef = /ActiveEcuC/Os/Core0_Demo_Task_1ms
            OsScheduleTableEventSetting_001 (OsScheduleTableEventSetting):
              OsScheduleTableSetEventRef = /ActiveEcuC/Os/Rte_Ev_Cyclic_Core0_BSWApp_Task_1ms_0_1ms
              OsScheduleTableSetEventTaskRef = /ActiveEcuC/Os/Core0_BSWApp_Task_1ms
          ExpiryPoint_77: OsScheduleTblExpPointOffset=77
            OsScheduleTableEventSetting_000 (OsScheduleTableEventSetting):
              OsScheduleTableSetEventRef = /ActiveEcuC/Os/Rte_Ev_Cyclic_Core0_Demo_Task_1ms_0_1ms
              OsScheduleTableSetEventTaskRef = /ActiveEcuC/Os/Core0_Demo_Task_1ms
            OsScheduleTableEventSetting_001 (OsScheduleTableEventSetting):
              OsScheduleTableSetEventRef = /ActiveEcuC/Os/Rte_Ev_Cyclic_Core0_BSWApp_Task_1ms_0_1ms
              OsScheduleTableSetEventTaskRef = /ActiveEcuC/Os/Core0_BSWApp_Task_1ms
          ExpiryPoint_78: OsScheduleTblExpPointOffset=78
            OsScheduleTableEventSetting_000 (OsScheduleTableEventSetting):
              OsScheduleTableSetEventRef = /ActiveEcuC/Os/Rte_Ev_Cyclic_Core0_Demo_Task_1ms_0_1ms
              OsScheduleTableSetEventTaskRef = /ActiveEcuC/Os/Core0_Demo_Task_1ms
            OsScheduleTableEventSetting_001 (OsScheduleTableEventSetting):
              OsScheduleTableSetEventRef = /ActiveEcuC/Os/Rte_Ev_Cyclic_Core0_BSWApp_Task_1ms_0_1ms
              OsScheduleTableSetEventTaskRef = /ActiveEcuC/Os/Core0_BSWApp_Task_1ms
          ExpiryPoint_79: OsScheduleTblExpPointOffset=79
            OsScheduleTableEventSetting_000 (OsScheduleTableEventSetting):
              OsScheduleTableSetEventRef = /ActiveEcuC/Os/Rte_Ev_Cyclic_Core0_Demo_Task_1ms_0_1ms
              OsScheduleTableSetEventTaskRef = /ActiveEcuC/Os/Core0_Demo_Task_1ms
            OsScheduleTableEventSetting_001 (OsScheduleTableEventSetting):
              OsScheduleTableSetEventRef = /ActiveEcuC/Os/Rte_Ev_Cyclic_Core0_BSWApp_Task_1ms_0_1ms
              OsScheduleTableSetEventTaskRef = /ActiveEcuC/Os/Core0_BSWApp_Task_1ms
          ExpiryPoint_80: OsScheduleTblExpPointOffset=80
            14 x OsScheduleTableEventSetting:
              OsScheduleTableEventSetting_000: OsScheduleTableSetEventRef=/ActiveEcuC/Os/Rte_Ev_Cyclic_Core0_Demo_Task_1ms_0_1ms, OsScheduleTableSetEventTaskRef=/ActiveEcuC/Os/Core0_Demo_Task_1ms
              OsScheduleTableEventSetting_001: OsScheduleTableSetEventRef=/ActiveEcuC/Os/Rte_Ev_Cyclic_Core0_BSWApp_Task_1ms_0_1ms, OsScheduleTableSetEventTaskRef=/ActiveEcuC/Os/Core0_BSWApp_Task_1ms
              OsScheduleTableEventSetting_002: OsScheduleTableSetEventRef=/ActiveEcuC/Os/Rte_Ev_Cyclic_Core0_BSW_Task_5ms_0_5ms, OsScheduleTableSetEventTaskRef=/ActiveEcuC/Os/Core0_BSW_Task_5ms
              OsScheduleTableEventSetting_003: OsScheduleTableSetEventRef=/ActiveEcuC/Os/Rte_Ev_Cyclic2_Core0_BSW_Task_5ms_0_5ms, OsScheduleTableSetEventTaskRef=/ActiveEcuC/Os/Core0_BSW_Task_5ms
              OsScheduleTableEventSetting_004: OsScheduleTableSetEventRef=/ActiveEcuC/Os/Rte_Ev_Cyclic_Core0_Demo_Task_5ms_0_5ms, OsScheduleTableSetEventTaskRef=/ActiveEcuC/Os/Core0_Demo_Task_5ms
              OsScheduleTableEventSetting_005: OsScheduleTableSetEventRef=/ActiveEcuC/Os/Rte_Ev_Cyclic_Core0_BSWApp_Task_5ms_0_5ms, OsScheduleTableSetEventTaskRef=/ActiveEcuC/Os/Core0_BSWApp_Task_5ms
              OsScheduleTableEventSetting_006: OsScheduleTableSetEventRef=/ActiveEcuC/Os/Rte_Ev_Cyclic_Core0_ASIL_BSW_Task_5ms_0_5ms, OsScheduleTableSetEventTaskRef=/ActiveEcuC/Os/Core0_ASIL_BSW_Task_5ms
              OsScheduleTableEventSetting_007: OsScheduleTableSetEventRef=/ActiveEcuC/Os/Rte_Ev_Cyclic_Core0_BSW_Task_10ms_0_10ms, OsScheduleTableSetEventTaskRef=/ActiveEcuC/Os/Core0_BSW_Task_10ms
              OsScheduleTableEventSetting_008: OsScheduleTableSetEventRef=/ActiveEcuC/Os/Rte_Ev_Cyclic_Core0_Demo_Task_10ms_0_10ms, OsScheduleTableSetEventTaskRef=/ActiveEcuC/Os/Core0_Demo_Task_10ms
              OsScheduleTableEventSetting_009: OsScheduleTableSetEventRef=/ActiveEcuC/Os/Rte_Ev_Cyclic_Core0_BSWApp_Task_10ms_0_10ms, OsScheduleTableSetEventTaskRef=/ActiveEcuC/Os/Core0_BSWApp_Task_10ms
              OsScheduleTableEventSetting_010: OsScheduleTableSetEventRef=/ActiveEcuC/Os/Rte_Ev_Cyclic_Core0_ASIL_BSW_Task_10ms_0_10ms, OsScheduleTableSetEventTaskRef=/ActiveEcuC/Os/Core0_ASIL_BSW_Task_10ms
              OsScheduleTableEventSetting_011: OsScheduleTableSetEventRef=/ActiveEcuC/Os/Rte_Ev_Cyclic_Core0_ActuatorIN_Task_10ms_0_10ms, OsScheduleTableSetEventTaskRef=/ActiveEcuC/Os/Core0_ActuatorIN_Task_10ms
              OsScheduleTableEventSetting_012: OsScheduleTableSetEventRef=/ActiveEcuC/Os/Rte_Ev_Cyclic_Core0_ActuatorOUT_Task_10ms_0_10ms, OsScheduleTableSetEventTaskRef=/ActiveEcuC/Os/Core0_ActuatorOUT_Task_10ms
              OsScheduleTableEventSetting_013: OsScheduleTableSetEventRef=/ActiveEcuC/Os/Rte_Ev_Cyclic_Core0_BSW_Task_10ms_LowPriority_0_10ms, OsScheduleTableSetEventTaskRef=/ActiveEcuC/Os/Core0_BSW_Task_10ms_LowPriority
          ExpiryPoint_81: OsScheduleTblExpPointOffset=81
            OsScheduleTableEventSetting_000 (OsScheduleTableEventSetting):
              OsScheduleTableSetEventRef = /ActiveEcuC/Os/Rte_Ev_Cyclic_Core0_Demo_Task_1ms_0_1ms
              OsScheduleTableSetEventTaskRef = /ActiveEcuC/Os/Core0_Demo_Task_1ms
            OsScheduleTableEventSetting_001 (OsScheduleTableEventSetting):
              OsScheduleTableSetEventRef = /ActiveEcuC/Os/Rte_Ev_Cyclic_Core0_BSWApp_Task_1ms_0_1ms
              OsScheduleTableSetEventTaskRef = /ActiveEcuC/Os/Core0_BSWApp_Task_1ms
          ExpiryPoint_82: OsScheduleTblExpPointOffset=82
            OsScheduleTableEventSetting_000 (OsScheduleTableEventSetting):
              OsScheduleTableSetEventRef = /ActiveEcuC/Os/Rte_Ev_Cyclic_Core0_Demo_Task_1ms_0_1ms
              OsScheduleTableSetEventTaskRef = /ActiveEcuC/Os/Core0_Demo_Task_1ms
            OsScheduleTableEventSetting_001 (OsScheduleTableEventSetting):
              OsScheduleTableSetEventRef = /ActiveEcuC/Os/Rte_Ev_Cyclic_Core0_BSWApp_Task_1ms_0_1ms
              OsScheduleTableSetEventTaskRef = /ActiveEcuC/Os/Core0_BSWApp_Task_1ms
          ExpiryPoint_83: OsScheduleTblExpPointOffset=83
            OsScheduleTableEventSetting_000 (OsScheduleTableEventSetting):
              OsScheduleTableSetEventRef = /ActiveEcuC/Os/Rte_Ev_Cyclic_Core0_Demo_Task_1ms_0_1ms
              OsScheduleTableSetEventTaskRef = /ActiveEcuC/Os/Core0_Demo_Task_1ms
            OsScheduleTableEventSetting_001 (OsScheduleTableEventSetting):
              OsScheduleTableSetEventRef = /ActiveEcuC/Os/Rte_Ev_Cyclic_Core0_BSWApp_Task_1ms_0_1ms
              OsScheduleTableSetEventTaskRef = /ActiveEcuC/Os/Core0_BSWApp_Task_1ms
          ExpiryPoint_84: OsScheduleTblExpPointOffset=84
            OsScheduleTableEventSetting_000 (OsScheduleTableEventSetting):
              OsScheduleTableSetEventRef = /ActiveEcuC/Os/Rte_Ev_Cyclic_Core0_Demo_Task_1ms_0_1ms
              OsScheduleTableSetEventTaskRef = /ActiveEcuC/Os/Core0_Demo_Task_1ms
            OsScheduleTableEventSetting_001 (OsScheduleTableEventSetting):
              OsScheduleTableSetEventRef = /ActiveEcuC/Os/Rte_Ev_Cyclic_Core0_BSWApp_Task_1ms_0_1ms
              OsScheduleTableSetEventTaskRef = /ActiveEcuC/Os/Core0_BSWApp_Task_1ms
          ExpiryPoint_85: OsScheduleTblExpPointOffset=85
            7 x OsScheduleTableEventSetting:
              OsScheduleTableEventSetting_000: OsScheduleTableSetEventRef=/ActiveEcuC/Os/Rte_Ev_Cyclic_Core0_Demo_Task_1ms_0_1ms, OsScheduleTableSetEventTaskRef=/ActiveEcuC/Os/Core0_Demo_Task_1ms
              OsScheduleTableEventSetting_001: OsScheduleTableSetEventRef=/ActiveEcuC/Os/Rte_Ev_Cyclic_Core0_BSWApp_Task_1ms_0_1ms, OsScheduleTableSetEventTaskRef=/ActiveEcuC/Os/Core0_BSWApp_Task_1ms
              OsScheduleTableEventSetting_002: OsScheduleTableSetEventRef=/ActiveEcuC/Os/Rte_Ev_Cyclic_Core0_BSW_Task_5ms_0_5ms, OsScheduleTableSetEventTaskRef=/ActiveEcuC/Os/Core0_BSW_Task_5ms
              OsScheduleTableEventSetting_003: OsScheduleTableSetEventRef=/ActiveEcuC/Os/Rte_Ev_Cyclic2_Core0_BSW_Task_5ms_0_5ms, OsScheduleTableSetEventTaskRef=/ActiveEcuC/Os/Core0_BSW_Task_5ms
              OsScheduleTableEventSetting_004: OsScheduleTableSetEventRef=/ActiveEcuC/Os/Rte_Ev_Cyclic_Core0_Demo_Task_5ms_0_5ms, OsScheduleTableSetEventTaskRef=/ActiveEcuC/Os/Core0_Demo_Task_5ms
              OsScheduleTableEventSetting_005: OsScheduleTableSetEventRef=/ActiveEcuC/Os/Rte_Ev_Cyclic_Core0_BSWApp_Task_5ms_0_5ms, OsScheduleTableSetEventTaskRef=/ActiveEcuC/Os/Core0_BSWApp_Task_5ms
              OsScheduleTableEventSetting_006: OsScheduleTableSetEventRef=/ActiveEcuC/Os/Rte_Ev_Cyclic_Core0_ASIL_BSW_Task_5ms_0_5ms, OsScheduleTableSetEventTaskRef=/ActiveEcuC/Os/Core0_ASIL_BSW_Task_5ms
          ExpiryPoint_86: OsScheduleTblExpPointOffset=86
            OsScheduleTableEventSetting_000 (OsScheduleTableEventSetting):
              OsScheduleTableSetEventRef = /ActiveEcuC/Os/Rte_Ev_Cyclic_Core0_Demo_Task_1ms_0_1ms
              OsScheduleTableSetEventTaskRef = /ActiveEcuC/Os/Core0_Demo_Task_1ms
            OsScheduleTableEventSetting_001 (OsScheduleTableEventSetting):
              OsScheduleTableSetEventRef = /ActiveEcuC/Os/Rte_Ev_Cyclic_Core0_BSWApp_Task_1ms_0_1ms
              OsScheduleTableSetEventTaskRef = /ActiveEcuC/Os/Core0_BSWApp_Task_1ms
          ExpiryPoint_87: OsScheduleTblExpPointOffset=87
            OsScheduleTableEventSetting_000 (OsScheduleTableEventSetting):
              OsScheduleTableSetEventRef = /ActiveEcuC/Os/Rte_Ev_Cyclic_Core0_Demo_Task_1ms_0_1ms
              OsScheduleTableSetEventTaskRef = /ActiveEcuC/Os/Core0_Demo_Task_1ms
            OsScheduleTableEventSetting_001 (OsScheduleTableEventSetting):
              OsScheduleTableSetEventRef = /ActiveEcuC/Os/Rte_Ev_Cyclic_Core0_BSWApp_Task_1ms_0_1ms
              OsScheduleTableSetEventTaskRef = /ActiveEcuC/Os/Core0_BSWApp_Task_1ms
          ExpiryPoint_88: OsScheduleTblExpPointOffset=88
            OsScheduleTableEventSetting_000 (OsScheduleTableEventSetting):
              OsScheduleTableSetEventRef = /ActiveEcuC/Os/Rte_Ev_Cyclic_Core0_Demo_Task_1ms_0_1ms
              OsScheduleTableSetEventTaskRef = /ActiveEcuC/Os/Core0_Demo_Task_1ms
            OsScheduleTableEventSetting_001 (OsScheduleTableEventSetting):
              OsScheduleTableSetEventRef = /ActiveEcuC/Os/Rte_Ev_Cyclic_Core0_BSWApp_Task_1ms_0_1ms
              OsScheduleTableSetEventTaskRef = /ActiveEcuC/Os/Core0_BSWApp_Task_1ms
          ExpiryPoint_89: OsScheduleTblExpPointOffset=89
            OsScheduleTableEventSetting_000 (OsScheduleTableEventSetting):
              OsScheduleTableSetEventRef = /ActiveEcuC/Os/Rte_Ev_Cyclic_Core0_Demo_Task_1ms_0_1ms
              OsScheduleTableSetEventTaskRef = /ActiveEcuC/Os/Core0_Demo_Task_1ms
            OsScheduleTableEventSetting_001 (OsScheduleTableEventSetting):
              OsScheduleTableSetEventRef = /ActiveEcuC/Os/Rte_Ev_Cyclic_Core0_BSWApp_Task_1ms_0_1ms
              OsScheduleTableSetEventTaskRef = /ActiveEcuC/Os/Core0_BSWApp_Task_1ms
          ExpiryPoint_90: OsScheduleTblExpPointOffset=90
            14 x OsScheduleTableEventSetting:
              OsScheduleTableEventSetting_000: OsScheduleTableSetEventRef=/ActiveEcuC/Os/Rte_Ev_Cyclic_Core0_Demo_Task_1ms_0_1ms, OsScheduleTableSetEventTaskRef=/ActiveEcuC/Os/Core0_Demo_Task_1ms
              OsScheduleTableEventSetting_001: OsScheduleTableSetEventRef=/ActiveEcuC/Os/Rte_Ev_Cyclic_Core0_BSWApp_Task_1ms_0_1ms, OsScheduleTableSetEventTaskRef=/ActiveEcuC/Os/Core0_BSWApp_Task_1ms
              OsScheduleTableEventSetting_002: OsScheduleTableSetEventRef=/ActiveEcuC/Os/Rte_Ev_Cyclic_Core0_BSW_Task_5ms_0_5ms, OsScheduleTableSetEventTaskRef=/ActiveEcuC/Os/Core0_BSW_Task_5ms
              OsScheduleTableEventSetting_003: OsScheduleTableSetEventRef=/ActiveEcuC/Os/Rte_Ev_Cyclic2_Core0_BSW_Task_5ms_0_5ms, OsScheduleTableSetEventTaskRef=/ActiveEcuC/Os/Core0_BSW_Task_5ms
              OsScheduleTableEventSetting_004: OsScheduleTableSetEventRef=/ActiveEcuC/Os/Rte_Ev_Cyclic_Core0_Demo_Task_5ms_0_5ms, OsScheduleTableSetEventTaskRef=/ActiveEcuC/Os/Core0_Demo_Task_5ms
              OsScheduleTableEventSetting_005: OsScheduleTableSetEventRef=/ActiveEcuC/Os/Rte_Ev_Cyclic_Core0_BSWApp_Task_5ms_0_5ms, OsScheduleTableSetEventTaskRef=/ActiveEcuC/Os/Core0_BSWApp_Task_5ms
              OsScheduleTableEventSetting_006: OsScheduleTableSetEventRef=/ActiveEcuC/Os/Rte_Ev_Cyclic_Core0_ASIL_BSW_Task_5ms_0_5ms, OsScheduleTableSetEventTaskRef=/ActiveEcuC/Os/Core0_ASIL_BSW_Task_5ms
              OsScheduleTableEventSetting_007: OsScheduleTableSetEventRef=/ActiveEcuC/Os/Rte_Ev_Cyclic_Core0_BSW_Task_10ms_0_10ms, OsScheduleTableSetEventTaskRef=/ActiveEcuC/Os/Core0_BSW_Task_10ms
              OsScheduleTableEventSetting_008: OsScheduleTableSetEventRef=/ActiveEcuC/Os/Rte_Ev_Cyclic_Core0_Demo_Task_10ms_0_10ms, OsScheduleTableSetEventTaskRef=/ActiveEcuC/Os/Core0_Demo_Task_10ms
              OsScheduleTableEventSetting_009: OsScheduleTableSetEventRef=/ActiveEcuC/Os/Rte_Ev_Cyclic_Core0_BSWApp_Task_10ms_0_10ms, OsScheduleTableSetEventTaskRef=/ActiveEcuC/Os/Core0_BSWApp_Task_10ms
              OsScheduleTableEventSetting_010: OsScheduleTableSetEventRef=/ActiveEcuC/Os/Rte_Ev_Cyclic_Core0_ASIL_BSW_Task_10ms_0_10ms, OsScheduleTableSetEventTaskRef=/ActiveEcuC/Os/Core0_ASIL_BSW_Task_10ms
              OsScheduleTableEventSetting_011: OsScheduleTableSetEventRef=/ActiveEcuC/Os/Rte_Ev_Cyclic_Core0_ActuatorIN_Task_10ms_0_10ms, OsScheduleTableSetEventTaskRef=/ActiveEcuC/Os/Core0_ActuatorIN_Task_10ms
              OsScheduleTableEventSetting_012: OsScheduleTableSetEventRef=/ActiveEcuC/Os/Rte_Ev_Cyclic_Core0_ActuatorOUT_Task_10ms_0_10ms, OsScheduleTableSetEventTaskRef=/ActiveEcuC/Os/Core0_ActuatorOUT_Task_10ms
              OsScheduleTableEventSetting_013: OsScheduleTableSetEventRef=/ActiveEcuC/Os/Rte_Ev_Cyclic_Core0_BSW_Task_10ms_LowPriority_0_10ms, OsScheduleTableSetEventTaskRef=/ActiveEcuC/Os/Core0_BSW_Task_10ms_LowPriority
          ExpiryPoint_91: OsScheduleTblExpPointOffset=91
            OsScheduleTableEventSetting_000 (OsScheduleTableEventSetting):
              OsScheduleTableSetEventRef = /ActiveEcuC/Os/Rte_Ev_Cyclic_Core0_Demo_Task_1ms_0_1ms
              OsScheduleTableSetEventTaskRef = /ActiveEcuC/Os/Core0_Demo_Task_1ms
            OsScheduleTableEventSetting_001 (OsScheduleTableEventSetting):
              OsScheduleTableSetEventRef = /ActiveEcuC/Os/Rte_Ev_Cyclic_Core0_BSWApp_Task_1ms_0_1ms
              OsScheduleTableSetEventTaskRef = /ActiveEcuC/Os/Core0_BSWApp_Task_1ms
          ExpiryPoint_92: OsScheduleTblExpPointOffset=92
            OsScheduleTableEventSetting_000 (OsScheduleTableEventSetting):
              OsScheduleTableSetEventRef = /ActiveEcuC/Os/Rte_Ev_Cyclic_Core0_Demo_Task_1ms_0_1ms
              OsScheduleTableSetEventTaskRef = /ActiveEcuC/Os/Core0_Demo_Task_1ms
            OsScheduleTableEventSetting_001 (OsScheduleTableEventSetting):
              OsScheduleTableSetEventRef = /ActiveEcuC/Os/Rte_Ev_Cyclic_Core0_BSWApp_Task_1ms_0_1ms
              OsScheduleTableSetEventTaskRef = /ActiveEcuC/Os/Core0_BSWApp_Task_1ms
          ExpiryPoint_93: OsScheduleTblExpPointOffset=93
            OsScheduleTableEventSetting_000 (OsScheduleTableEventSetting):
              OsScheduleTableSetEventRef = /ActiveEcuC/Os/Rte_Ev_Cyclic_Core0_Demo_Task_1ms_0_1ms
              OsScheduleTableSetEventTaskRef = /ActiveEcuC/Os/Core0_Demo_Task_1ms
            OsScheduleTableEventSetting_001 (OsScheduleTableEventSetting):
              OsScheduleTableSetEventRef = /ActiveEcuC/Os/Rte_Ev_Cyclic_Core0_BSWApp_Task_1ms_0_1ms
              OsScheduleTableSetEventTaskRef = /ActiveEcuC/Os/Core0_BSWApp_Task_1ms
          ExpiryPoint_94: OsScheduleTblExpPointOffset=94
            OsScheduleTableEventSetting_000 (OsScheduleTableEventSetting):
              OsScheduleTableSetEventRef = /ActiveEcuC/Os/Rte_Ev_Cyclic_Core0_Demo_Task_1ms_0_1ms
              OsScheduleTableSetEventTaskRef = /ActiveEcuC/Os/Core0_Demo_Task_1ms
            OsScheduleTableEventSetting_001 (OsScheduleTableEventSetting):
              OsScheduleTableSetEventRef = /ActiveEcuC/Os/Rte_Ev_Cyclic_Core0_BSWApp_Task_1ms_0_1ms
              OsScheduleTableSetEventTaskRef = /ActiveEcuC/Os/Core0_BSWApp_Task_1ms
          ExpiryPoint_95: OsScheduleTblExpPointOffset=95
            7 x OsScheduleTableEventSetting:
              OsScheduleTableEventSetting_000: OsScheduleTableSetEventRef=/ActiveEcuC/Os/Rte_Ev_Cyclic_Core0_Demo_Task_1ms_0_1ms, OsScheduleTableSetEventTaskRef=/ActiveEcuC/Os/Core0_Demo_Task_1ms
              OsScheduleTableEventSetting_001: OsScheduleTableSetEventRef=/ActiveEcuC/Os/Rte_Ev_Cyclic_Core0_BSWApp_Task_1ms_0_1ms, OsScheduleTableSetEventTaskRef=/ActiveEcuC/Os/Core0_BSWApp_Task_1ms
              OsScheduleTableEventSetting_002: OsScheduleTableSetEventRef=/ActiveEcuC/Os/Rte_Ev_Cyclic_Core0_BSW_Task_5ms_0_5ms, OsScheduleTableSetEventTaskRef=/ActiveEcuC/Os/Core0_BSW_Task_5ms
              OsScheduleTableEventSetting_003: OsScheduleTableSetEventRef=/ActiveEcuC/Os/Rte_Ev_Cyclic2_Core0_BSW_Task_5ms_0_5ms, OsScheduleTableSetEventTaskRef=/ActiveEcuC/Os/Core0_BSW_Task_5ms
              OsScheduleTableEventSetting_004: OsScheduleTableSetEventRef=/ActiveEcuC/Os/Rte_Ev_Cyclic_Core0_Demo_Task_5ms_0_5ms, OsScheduleTableSetEventTaskRef=/ActiveEcuC/Os/Core0_Demo_Task_5ms
              OsScheduleTableEventSetting_005: OsScheduleTableSetEventRef=/ActiveEcuC/Os/Rte_Ev_Cyclic_Core0_BSWApp_Task_5ms_0_5ms, OsScheduleTableSetEventTaskRef=/ActiveEcuC/Os/Core0_BSWApp_Task_5ms
              OsScheduleTableEventSetting_006: OsScheduleTableSetEventRef=/ActiveEcuC/Os/Rte_Ev_Cyclic_Core0_ASIL_BSW_Task_5ms_0_5ms, OsScheduleTableSetEventTaskRef=/ActiveEcuC/Os/Core0_ASIL_BSW_Task_5ms
          ExpiryPoint_96: OsScheduleTblExpPointOffset=96
            OsScheduleTableEventSetting_000 (OsScheduleTableEventSetting):
              OsScheduleTableSetEventRef = /ActiveEcuC/Os/Rte_Ev_Cyclic_Core0_Demo_Task_1ms_0_1ms
              OsScheduleTableSetEventTaskRef = /ActiveEcuC/Os/Core0_Demo_Task_1ms
            OsScheduleTableEventSetting_001 (OsScheduleTableEventSetting):
              OsScheduleTableSetEventRef = /ActiveEcuC/Os/Rte_Ev_Cyclic_Core0_BSWApp_Task_1ms_0_1ms
              OsScheduleTableSetEventTaskRef = /ActiveEcuC/Os/Core0_BSWApp_Task_1ms
          ExpiryPoint_97: OsScheduleTblExpPointOffset=97
            OsScheduleTableEventSetting_000 (OsScheduleTableEventSetting):
              OsScheduleTableSetEventRef = /ActiveEcuC/Os/Rte_Ev_Cyclic_Core0_Demo_Task_1ms_0_1ms
              OsScheduleTableSetEventTaskRef = /ActiveEcuC/Os/Core0_Demo_Task_1ms
            OsScheduleTableEventSetting_001 (OsScheduleTableEventSetting):
              OsScheduleTableSetEventRef = /ActiveEcuC/Os/Rte_Ev_Cyclic_Core0_BSWApp_Task_1ms_0_1ms
              OsScheduleTableSetEventTaskRef = /ActiveEcuC/Os/Core0_BSWApp_Task_1ms
          ExpiryPoint_98: OsScheduleTblExpPointOffset=98
            OsScheduleTableEventSetting_000 (OsScheduleTableEventSetting):
              OsScheduleTableSetEventRef = /ActiveEcuC/Os/Rte_Ev_Cyclic_Core0_Demo_Task_1ms_0_1ms
              OsScheduleTableSetEventTaskRef = /ActiveEcuC/Os/Core0_Demo_Task_1ms
            OsScheduleTableEventSetting_001 (OsScheduleTableEventSetting):
              OsScheduleTableSetEventRef = /ActiveEcuC/Os/Rte_Ev_Cyclic_Core0_BSWApp_Task_1ms_0_1ms
              OsScheduleTableSetEventTaskRef = /ActiveEcuC/Os/Core0_BSWApp_Task_1ms
          ExpiryPoint_99: OsScheduleTblExpPointOffset=99
            OsScheduleTableEventSetting_000 (OsScheduleTableEventSetting):
              OsScheduleTableSetEventRef = /ActiveEcuC/Os/Rte_Ev_Cyclic_Core0_Demo_Task_1ms_0_1ms
              OsScheduleTableSetEventTaskRef = /ActiveEcuC/Os/Core0_Demo_Task_1ms
            OsScheduleTableEventSetting_001 (OsScheduleTableEventSetting):
              OsScheduleTableSetEventRef = /ActiveEcuC/Os/Rte_Ev_Cyclic_Core0_BSWApp_Task_1ms_0_1ms
              OsScheduleTableSetEventTaskRef = /ActiveEcuC/Os/Core0_BSWApp_Task_1ms
      OsScheduleTable_Core1: OsScheduleTableDuration=10, OsScheduleTableCounterRef=/ActiveEcuC/Os/systemtimer1
        10 x OsScheduleTableExpiryPoint:
          ExpiryPoint_0: OsScheduleTblExpPointOffset=0
            12 x OsScheduleTableEventSetting:
              OsScheduleTableEventSetting_000: OsScheduleTableSetEventRef=/ActiveEcuC/Os/Rte_Ev_Cyclic_Core1_ASILB_Task_1ms_0_1ms, OsScheduleTableSetEventTaskRef=/ActiveEcuC/Os/Core1_ASILB_Task_1ms
              OsScheduleTableEventSetting_001: OsScheduleTableSetEventRef=/ActiveEcuC/Os/Rte_Ev_Cyclic_Core1_BSWApp_Task_1ms_0_1ms, OsScheduleTableSetEventTaskRef=/ActiveEcuC/Os/Core1_BSWApp_Task_1ms
              OsScheduleTableEventSetting_002: OsScheduleTableSetEventRef=/ActiveEcuC/Os/Rte_Ev_Cyclic_Core1_ActuatorIN_Task_1ms_0_1ms, OsScheduleTableSetEventTaskRef=/ActiveEcuC/Os/Core1_ActuatorIN_Task_1ms
              OsScheduleTableEventSetting_003: OsScheduleTableSetEventRef=/ActiveEcuC/Os/Rte_Ev_Cyclic_Core1_ActuatorOUT_Task_1ms_0_1ms, OsScheduleTableSetEventTaskRef=/ActiveEcuC/Os/Core1_ActuatorOUT_Task_1ms
              OsScheduleTableEventSetting_004: OsScheduleTableSetEventRef=/ActiveEcuC/Os/Rte_Ev_Cyclic_Core1_BSWApp_Task_5ms_0_5ms, OsScheduleTableSetEventTaskRef=/ActiveEcuC/Os/Core1_BSWApp_Task_5ms
              OsScheduleTableEventSetting_005: OsScheduleTableSetEventRef=/ActiveEcuC/Os/Rte_Ev_Cyclic_Core1_BSW_Task_10ms_0_10ms, OsScheduleTableSetEventTaskRef=/ActiveEcuC/Os/Core1_BSW_Task_10ms
              OsScheduleTableEventSetting_006: OsScheduleTableSetEventRef=/ActiveEcuC/Os/Rte_Ev_Cyclic_Core1_NMM_Task_10ms_0_10ms, OsScheduleTableSetEventTaskRef=/ActiveEcuC/Os/Core1_NMM_Task_10ms
              OsScheduleTableEventSetting_007: OsScheduleTableSetEventRef=/ActiveEcuC/Os/Rte_Ev_Cyclic_Core1_ASILB_Task_10ms_0_10ms, OsScheduleTableSetEventTaskRef=/ActiveEcuC/Os/Core1_ASILB_Task_10ms
              OsScheduleTableEventSetting_008: OsScheduleTableSetEventRef=/ActiveEcuC/Os/Rte_Ev_Cyclic_Core1_ASILD_Task_10ms_0_10ms, OsScheduleTableSetEventTaskRef=/ActiveEcuC/Os/Core1_ASILD_Task_10ms
              OsScheduleTableEventSetting_009: OsScheduleTableSetEventRef=/ActiveEcuC/Os/Rte_Ev_Cyclic_Core1_BSWApp_Task_10ms_0_10ms, OsScheduleTableSetEventTaskRef=/ActiveEcuC/Os/Core1_BSWApp_Task_10ms
              OsScheduleTableEventSetting_010: OsScheduleTableSetEventRef=/ActiveEcuC/Os/Rte_Ev_Cyclic_Core1_ActuatorIN_Task_10ms_0_10ms, OsScheduleTableSetEventTaskRef=/ActiveEcuC/Os/Core1_ActuatorIN_Task_10ms
              OsScheduleTableEventSetting_011: OsScheduleTableSetEventRef=/ActiveEcuC/Os/Rte_Ev_Cyclic_Core1_ActuatorOUT_Task_10ms_0_10ms, OsScheduleTableSetEventTaskRef=/ActiveEcuC/Os/Core1_ActuatorOUT_Task_10ms
          ExpiryPoint_1: OsScheduleTblExpPointOffset=1
            4 x OsScheduleTableEventSetting:
              OsScheduleTableEventSetting_000: OsScheduleTableSetEventRef=/ActiveEcuC/Os/Rte_Ev_Cyclic_Core1_ASILB_Task_1ms_0_1ms, OsScheduleTableSetEventTaskRef=/ActiveEcuC/Os/Core1_ASILB_Task_1ms
              OsScheduleTableEventSetting_001: OsScheduleTableSetEventRef=/ActiveEcuC/Os/Rte_Ev_Cyclic_Core1_BSWApp_Task_1ms_0_1ms, OsScheduleTableSetEventTaskRef=/ActiveEcuC/Os/Core1_BSWApp_Task_1ms
              OsScheduleTableEventSetting_002: OsScheduleTableSetEventRef=/ActiveEcuC/Os/Rte_Ev_Cyclic_Core1_ActuatorIN_Task_1ms_0_1ms, OsScheduleTableSetEventTaskRef=/ActiveEcuC/Os/Core1_ActuatorIN_Task_1ms
              OsScheduleTableEventSetting_003: OsScheduleTableSetEventRef=/ActiveEcuC/Os/Rte_Ev_Cyclic_Core1_ActuatorOUT_Task_1ms_0_1ms, OsScheduleTableSetEventTaskRef=/ActiveEcuC/Os/Core1_ActuatorOUT_Task_1ms
          ExpiryPoint_2: OsScheduleTblExpPointOffset=2
            4 x OsScheduleTableEventSetting:
              OsScheduleTableEventSetting_000: OsScheduleTableSetEventRef=/ActiveEcuC/Os/Rte_Ev_Cyclic_Core1_ASILB_Task_1ms_0_1ms, OsScheduleTableSetEventTaskRef=/ActiveEcuC/Os/Core1_ASILB_Task_1ms
              OsScheduleTableEventSetting_001: OsScheduleTableSetEventRef=/ActiveEcuC/Os/Rte_Ev_Cyclic_Core1_BSWApp_Task_1ms_0_1ms, OsScheduleTableSetEventTaskRef=/ActiveEcuC/Os/Core1_BSWApp_Task_1ms
              OsScheduleTableEventSetting_002: OsScheduleTableSetEventRef=/ActiveEcuC/Os/Rte_Ev_Cyclic_Core1_ActuatorIN_Task_1ms_0_1ms, OsScheduleTableSetEventTaskRef=/ActiveEcuC/Os/Core1_ActuatorIN_Task_1ms
              OsScheduleTableEventSetting_003: OsScheduleTableSetEventRef=/ActiveEcuC/Os/Rte_Ev_Cyclic_Core1_ActuatorOUT_Task_1ms_0_1ms, OsScheduleTableSetEventTaskRef=/ActiveEcuC/Os/Core1_ActuatorOUT_Task_1ms
          ExpiryPoint_3: OsScheduleTblExpPointOffset=3
            4 x OsScheduleTableEventSetting:
              OsScheduleTableEventSetting_000: OsScheduleTableSetEventRef=/ActiveEcuC/Os/Rte_Ev_Cyclic_Core1_ASILB_Task_1ms_0_1ms, OsScheduleTableSetEventTaskRef=/ActiveEcuC/Os/Core1_ASILB_Task_1ms
              OsScheduleTableEventSetting_001: OsScheduleTableSetEventRef=/ActiveEcuC/Os/Rte_Ev_Cyclic_Core1_BSWApp_Task_1ms_0_1ms, OsScheduleTableSetEventTaskRef=/ActiveEcuC/Os/Core1_BSWApp_Task_1ms
              OsScheduleTableEventSetting_002: OsScheduleTableSetEventRef=/ActiveEcuC/Os/Rte_Ev_Cyclic_Core1_ActuatorIN_Task_1ms_0_1ms, OsScheduleTableSetEventTaskRef=/ActiveEcuC/Os/Core1_ActuatorIN_Task_1ms
              OsScheduleTableEventSetting_003: OsScheduleTableSetEventRef=/ActiveEcuC/Os/Rte_Ev_Cyclic_Core1_ActuatorOUT_Task_1ms_0_1ms, OsScheduleTableSetEventTaskRef=/ActiveEcuC/Os/Core1_ActuatorOUT_Task_1ms
          ExpiryPoint_4: OsScheduleTblExpPointOffset=4
            4 x OsScheduleTableEventSetting:
              OsScheduleTableEventSetting_000: OsScheduleTableSetEventRef=/ActiveEcuC/Os/Rte_Ev_Cyclic_Core1_ASILB_Task_1ms_0_1ms, OsScheduleTableSetEventTaskRef=/ActiveEcuC/Os/Core1_ASILB_Task_1ms
              OsScheduleTableEventSetting_001: OsScheduleTableSetEventRef=/ActiveEcuC/Os/Rte_Ev_Cyclic_Core1_BSWApp_Task_1ms_0_1ms, OsScheduleTableSetEventTaskRef=/ActiveEcuC/Os/Core1_BSWApp_Task_1ms
              OsScheduleTableEventSetting_002: OsScheduleTableSetEventRef=/ActiveEcuC/Os/Rte_Ev_Cyclic_Core1_ActuatorIN_Task_1ms_0_1ms, OsScheduleTableSetEventTaskRef=/ActiveEcuC/Os/Core1_ActuatorIN_Task_1ms
              OsScheduleTableEventSetting_003: OsScheduleTableSetEventRef=/ActiveEcuC/Os/Rte_Ev_Cyclic_Core1_ActuatorOUT_Task_1ms_0_1ms, OsScheduleTableSetEventTaskRef=/ActiveEcuC/Os/Core1_ActuatorOUT_Task_1ms
          ExpiryPoint_5: OsScheduleTblExpPointOffset=5
            5 x OsScheduleTableEventSetting:
              OsScheduleTableEventSetting_000: OsScheduleTableSetEventRef=/ActiveEcuC/Os/Rte_Ev_Cyclic_Core1_ASILB_Task_1ms_0_1ms, OsScheduleTableSetEventTaskRef=/ActiveEcuC/Os/Core1_ASILB_Task_1ms
              OsScheduleTableEventSetting_001: OsScheduleTableSetEventRef=/ActiveEcuC/Os/Rte_Ev_Cyclic_Core1_BSWApp_Task_1ms_0_1ms, OsScheduleTableSetEventTaskRef=/ActiveEcuC/Os/Core1_BSWApp_Task_1ms
              OsScheduleTableEventSetting_002: OsScheduleTableSetEventRef=/ActiveEcuC/Os/Rte_Ev_Cyclic_Core1_ActuatorIN_Task_1ms_0_1ms, OsScheduleTableSetEventTaskRef=/ActiveEcuC/Os/Core1_ActuatorIN_Task_1ms
              OsScheduleTableEventSetting_003: OsScheduleTableSetEventRef=/ActiveEcuC/Os/Rte_Ev_Cyclic_Core1_ActuatorOUT_Task_1ms_0_1ms, OsScheduleTableSetEventTaskRef=/ActiveEcuC/Os/Core1_ActuatorOUT_Task_1ms
              OsScheduleTableEventSetting_004: OsScheduleTableSetEventRef=/ActiveEcuC/Os/Rte_Ev_Cyclic_Core1_BSWApp_Task_5ms_0_5ms, OsScheduleTableSetEventTaskRef=/ActiveEcuC/Os/Core1_BSWApp_Task_5ms
          ExpiryPoint_6: OsScheduleTblExpPointOffset=6
            4 x OsScheduleTableEventSetting:
              OsScheduleTableEventSetting_000: OsScheduleTableSetEventRef=/ActiveEcuC/Os/Rte_Ev_Cyclic_Core1_ASILB_Task_1ms_0_1ms, OsScheduleTableSetEventTaskRef=/ActiveEcuC/Os/Core1_ASILB_Task_1ms
              OsScheduleTableEventSetting_001: OsScheduleTableSetEventRef=/ActiveEcuC/Os/Rte_Ev_Cyclic_Core1_BSWApp_Task_1ms_0_1ms, OsScheduleTableSetEventTaskRef=/ActiveEcuC/Os/Core1_BSWApp_Task_1ms
              OsScheduleTableEventSetting_002: OsScheduleTableSetEventRef=/ActiveEcuC/Os/Rte_Ev_Cyclic_Core1_ActuatorIN_Task_1ms_0_1ms, OsScheduleTableSetEventTaskRef=/ActiveEcuC/Os/Core1_ActuatorIN_Task_1ms
              OsScheduleTableEventSetting_003: OsScheduleTableSetEventRef=/ActiveEcuC/Os/Rte_Ev_Cyclic_Core1_ActuatorOUT_Task_1ms_0_1ms, OsScheduleTableSetEventTaskRef=/ActiveEcuC/Os/Core1_ActuatorOUT_Task_1ms
          ExpiryPoint_7: OsScheduleTblExpPointOffset=7
            4 x OsScheduleTableEventSetting:
              OsScheduleTableEventSetting_000: OsScheduleTableSetEventRef=/ActiveEcuC/Os/Rte_Ev_Cyclic_Core1_ASILB_Task_1ms_0_1ms, OsScheduleTableSetEventTaskRef=/ActiveEcuC/Os/Core1_ASILB_Task_1ms
              OsScheduleTableEventSetting_001: OsScheduleTableSetEventRef=/ActiveEcuC/Os/Rte_Ev_Cyclic_Core1_BSWApp_Task_1ms_0_1ms, OsScheduleTableSetEventTaskRef=/ActiveEcuC/Os/Core1_BSWApp_Task_1ms
              OsScheduleTableEventSetting_002: OsScheduleTableSetEventRef=/ActiveEcuC/Os/Rte_Ev_Cyclic_Core1_ActuatorIN_Task_1ms_0_1ms, OsScheduleTableSetEventTaskRef=/ActiveEcuC/Os/Core1_ActuatorIN_Task_1ms
              OsScheduleTableEventSetting_003: OsScheduleTableSetEventRef=/ActiveEcuC/Os/Rte_Ev_Cyclic_Core1_ActuatorOUT_Task_1ms_0_1ms, OsScheduleTableSetEventTaskRef=/ActiveEcuC/Os/Core1_ActuatorOUT_Task_1ms
          ExpiryPoint_8: OsScheduleTblExpPointOffset=8
            4 x OsScheduleTableEventSetting:
              OsScheduleTableEventSetting_000: OsScheduleTableSetEventRef=/ActiveEcuC/Os/Rte_Ev_Cyclic_Core1_ASILB_Task_1ms_0_1ms, OsScheduleTableSetEventTaskRef=/ActiveEcuC/Os/Core1_ASILB_Task_1ms
              OsScheduleTableEventSetting_001: OsScheduleTableSetEventRef=/ActiveEcuC/Os/Rte_Ev_Cyclic_Core1_BSWApp_Task_1ms_0_1ms, OsScheduleTableSetEventTaskRef=/ActiveEcuC/Os/Core1_BSWApp_Task_1ms
              OsScheduleTableEventSetting_002: OsScheduleTableSetEventRef=/ActiveEcuC/Os/Rte_Ev_Cyclic_Core1_ActuatorIN_Task_1ms_0_1ms, OsScheduleTableSetEventTaskRef=/ActiveEcuC/Os/Core1_ActuatorIN_Task_1ms
              OsScheduleTableEventSetting_003: OsScheduleTableSetEventRef=/ActiveEcuC/Os/Rte_Ev_Cyclic_Core1_ActuatorOUT_Task_1ms_0_1ms, OsScheduleTableSetEventTaskRef=/ActiveEcuC/Os/Core1_ActuatorOUT_Task_1ms
          ExpiryPoint_9: OsScheduleTblExpPointOffset=9
            4 x OsScheduleTableEventSetting:
              OsScheduleTableEventSetting_000: OsScheduleTableSetEventRef=/ActiveEcuC/Os/Rte_Ev_Cyclic_Core1_ASILB_Task_1ms_0_1ms, OsScheduleTableSetEventTaskRef=/ActiveEcuC/Os/Core1_ASILB_Task_1ms
              OsScheduleTableEventSetting_001: OsScheduleTableSetEventRef=/ActiveEcuC/Os/Rte_Ev_Cyclic_Core1_BSWApp_Task_1ms_0_1ms, OsScheduleTableSetEventTaskRef=/ActiveEcuC/Os/Core1_BSWApp_Task_1ms
              OsScheduleTableEventSetting_002: OsScheduleTableSetEventRef=/ActiveEcuC/Os/Rte_Ev_Cyclic_Core1_ActuatorIN_Task_1ms_0_1ms, OsScheduleTableSetEventTaskRef=/ActiveEcuC/Os/Core1_ActuatorIN_Task_1ms
              OsScheduleTableEventSetting_003: OsScheduleTableSetEventRef=/ActiveEcuC/Os/Rte_Ev_Cyclic_Core1_ActuatorOUT_Task_1ms_0_1ms, OsScheduleTableSetEventTaskRef=/ActiveEcuC/Os/Core1_ActuatorOUT_Task_1ms
      OsScheduleTable_Core2: OsScheduleTableDuration=10, OsScheduleTableCounterRef=/ActiveEcuC/Os/systemtimer2
        10 x OsScheduleTableExpiryPoint:
          ExpiryPoint_0: OsScheduleTblExpPointOffset=0
            3 x OsScheduleTableEventSetting:
              OsScheduleTableEventSetting_000: OsScheduleTableSetEventRef=/ActiveEcuC/Os/Rte_Ev_Cyclic_Core2_BSW_Task_1ms_0_1ms, OsScheduleTableSetEventTaskRef=/ActiveEcuC/Os/Core2_BSW_Task_1ms
              OsScheduleTableEventSetting_001: OsScheduleTableSetEventRef=/ActiveEcuC/Os/Rte_Ev_Cyclic_Core2_BSW_Task_5ms_0_5ms, OsScheduleTableSetEventTaskRef=/ActiveEcuC/Os/Core2_BSW_Task_5ms
              OsScheduleTableEventSetting_002: OsScheduleTableSetEventRef=/ActiveEcuC/Os/Rte_Ev_Cyclic_Core2_BSW_Task_10ms_0_10ms, OsScheduleTableSetEventTaskRef=/ActiveEcuC/Os/Core2_BSW_Task_10ms
          ExpiryPoint_1: OsScheduleTblExpPointOffset=1
            OsScheduleTableEventSetting_000 (OsScheduleTableEventSetting):
              OsScheduleTableSetEventRef = /ActiveEcuC/Os/Rte_Ev_Cyclic_Core2_BSW_Task_1ms_0_1ms
              OsScheduleTableSetEventTaskRef = /ActiveEcuC/Os/Core2_BSW_Task_1ms
          ExpiryPoint_2: OsScheduleTblExpPointOffset=2
            OsScheduleTableEventSetting_000 (OsScheduleTableEventSetting):
              OsScheduleTableSetEventRef = /ActiveEcuC/Os/Rte_Ev_Cyclic_Core2_BSW_Task_1ms_0_1ms
              OsScheduleTableSetEventTaskRef = /ActiveEcuC/Os/Core2_BSW_Task_1ms
          ExpiryPoint_3: OsScheduleTblExpPointOffset=3
            OsScheduleTableEventSetting_000 (OsScheduleTableEventSetting):
              OsScheduleTableSetEventRef = /ActiveEcuC/Os/Rte_Ev_Cyclic_Core2_BSW_Task_1ms_0_1ms
              OsScheduleTableSetEventTaskRef = /ActiveEcuC/Os/Core2_BSW_Task_1ms
          ExpiryPoint_4: OsScheduleTblExpPointOffset=4
            OsScheduleTableEventSetting_000 (OsScheduleTableEventSetting):
              OsScheduleTableSetEventRef = /ActiveEcuC/Os/Rte_Ev_Cyclic_Core2_BSW_Task_1ms_0_1ms
              OsScheduleTableSetEventTaskRef = /ActiveEcuC/Os/Core2_BSW_Task_1ms
          ExpiryPoint_5: OsScheduleTblExpPointOffset=5
            OsScheduleTableEventSetting_000 (OsScheduleTableEventSetting):
              OsScheduleTableSetEventRef = /ActiveEcuC/Os/Rte_Ev_Cyclic_Core2_BSW_Task_1ms_0_1ms
              OsScheduleTableSetEventTaskRef = /ActiveEcuC/Os/Core2_BSW_Task_1ms
            OsScheduleTableEventSetting_001 (OsScheduleTableEventSetting):
              OsScheduleTableSetEventRef = /ActiveEcuC/Os/Rte_Ev_Cyclic_Core2_BSW_Task_5ms_0_5ms
              OsScheduleTableSetEventTaskRef = /ActiveEcuC/Os/Core2_BSW_Task_5ms
          ExpiryPoint_6: OsScheduleTblExpPointOffset=6
            OsScheduleTableEventSetting_000 (OsScheduleTableEventSetting):
              OsScheduleTableSetEventRef = /ActiveEcuC/Os/Rte_Ev_Cyclic_Core2_BSW_Task_1ms_0_1ms
              OsScheduleTableSetEventTaskRef = /ActiveEcuC/Os/Core2_BSW_Task_1ms
          ExpiryPoint_7: OsScheduleTblExpPointOffset=7
            OsScheduleTableEventSetting_000 (OsScheduleTableEventSetting):
              OsScheduleTableSetEventRef = /ActiveEcuC/Os/Rte_Ev_Cyclic_Core2_BSW_Task_1ms_0_1ms
              OsScheduleTableSetEventTaskRef = /ActiveEcuC/Os/Core2_BSW_Task_1ms
          ExpiryPoint_8: OsScheduleTblExpPointOffset=8
            OsScheduleTableEventSetting_000 (OsScheduleTableEventSetting):
              OsScheduleTableSetEventRef = /ActiveEcuC/Os/Rte_Ev_Cyclic_Core2_BSW_Task_1ms_0_1ms
              OsScheduleTableSetEventTaskRef = /ActiveEcuC/Os/Core2_BSW_Task_1ms
          ExpiryPoint_9: OsScheduleTblExpPointOffset=9
            OsScheduleTableEventSetting_000 (OsScheduleTableEventSetting):
              OsScheduleTableSetEventRef = /ActiveEcuC/Os/Rte_Ev_Cyclic_Core2_BSW_Task_1ms_0_1ms
              OsScheduleTableSetEventTaskRef = /ActiveEcuC/Os/Core2_BSW_Task_1ms
      OsScheduleTable_Core3: OsScheduleTableDuration=10, OsScheduleTableCounterRef=/ActiveEcuC/Os/systemtimer3
        10 x OsScheduleTableExpiryPoint:
          ExpiryPoint_0: OsScheduleTblExpPointOffset=0
            3 x OsScheduleTableEventSetting:
              OsScheduleTableEventSetting_000: OsScheduleTableSetEventRef=/ActiveEcuC/Os/Rte_Ev_Cyclic_Core3_BSW_Task_1ms_0_1ms, OsScheduleTableSetEventTaskRef=/ActiveEcuC/Os/Core3_BSW_Task_1ms
              OsScheduleTableEventSetting_001: OsScheduleTableSetEventRef=/ActiveEcuC/Os/Rte_Ev_Cyclic_Core3_BSW_Task_5ms_0_5ms, OsScheduleTableSetEventTaskRef=/ActiveEcuC/Os/Core3_BSW_Task_5ms
              OsScheduleTableEventSetting_002: OsScheduleTableSetEventRef=/ActiveEcuC/Os/Rte_Ev_Cyclic_Core3_BSW_Task_10ms_0_10ms, OsScheduleTableSetEventTaskRef=/ActiveEcuC/Os/Core3_BSW_Task_10ms
          ExpiryPoint_1: OsScheduleTblExpPointOffset=1
            OsScheduleTableEventSetting_000 (OsScheduleTableEventSetting):
              OsScheduleTableSetEventRef = /ActiveEcuC/Os/Rte_Ev_Cyclic_Core3_BSW_Task_1ms_0_1ms
              OsScheduleTableSetEventTaskRef = /ActiveEcuC/Os/Core3_BSW_Task_1ms
          ExpiryPoint_2: OsScheduleTblExpPointOffset=2
            OsScheduleTableEventSetting_000 (OsScheduleTableEventSetting):
              OsScheduleTableSetEventRef = /ActiveEcuC/Os/Rte_Ev_Cyclic_Core3_BSW_Task_1ms_0_1ms
              OsScheduleTableSetEventTaskRef = /ActiveEcuC/Os/Core3_BSW_Task_1ms
          ExpiryPoint_3: OsScheduleTblExpPointOffset=3
            OsScheduleTableEventSetting_000 (OsScheduleTableEventSetting):
              OsScheduleTableSetEventRef = /ActiveEcuC/Os/Rte_Ev_Cyclic_Core3_BSW_Task_1ms_0_1ms
              OsScheduleTableSetEventTaskRef = /ActiveEcuC/Os/Core3_BSW_Task_1ms
          ExpiryPoint_4: OsScheduleTblExpPointOffset=4
            OsScheduleTableEventSetting_000 (OsScheduleTableEventSetting):
              OsScheduleTableSetEventRef = /ActiveEcuC/Os/Rte_Ev_Cyclic_Core3_BSW_Task_1ms_0_1ms
              OsScheduleTableSetEventTaskRef = /ActiveEcuC/Os/Core3_BSW_Task_1ms
          ExpiryPoint_5: OsScheduleTblExpPointOffset=5
            OsScheduleTableEventSetting_000 (OsScheduleTableEventSetting):
              OsScheduleTableSetEventRef = /ActiveEcuC/Os/Rte_Ev_Cyclic_Core3_BSW_Task_1ms_0_1ms
              OsScheduleTableSetEventTaskRef = /ActiveEcuC/Os/Core3_BSW_Task_1ms
            OsScheduleTableEventSetting_001 (OsScheduleTableEventSetting):
              OsScheduleTableSetEventRef = /ActiveEcuC/Os/Rte_Ev_Cyclic_Core3_BSW_Task_5ms_0_5ms
              OsScheduleTableSetEventTaskRef = /ActiveEcuC/Os/Core3_BSW_Task_5ms
          ExpiryPoint_6: OsScheduleTblExpPointOffset=6
            OsScheduleTableEventSetting_000 (OsScheduleTableEventSetting):
              OsScheduleTableSetEventRef = /ActiveEcuC/Os/Rte_Ev_Cyclic_Core3_BSW_Task_1ms_0_1ms
              OsScheduleTableSetEventTaskRef = /ActiveEcuC/Os/Core3_BSW_Task_1ms
          ExpiryPoint_7: OsScheduleTblExpPointOffset=7
            OsScheduleTableEventSetting_000 (OsScheduleTableEventSetting):
              OsScheduleTableSetEventRef = /ActiveEcuC/Os/Rte_Ev_Cyclic_Core3_BSW_Task_1ms_0_1ms
              OsScheduleTableSetEventTaskRef = /ActiveEcuC/Os/Core3_BSW_Task_1ms
          ExpiryPoint_8: OsScheduleTblExpPointOffset=8
            OsScheduleTableEventSetting_000 (OsScheduleTableEventSetting):
              OsScheduleTableSetEventRef = /ActiveEcuC/Os/Rte_Ev_Cyclic_Core3_BSW_Task_1ms_0_1ms
              OsScheduleTableSetEventTaskRef = /ActiveEcuC/Os/Core3_BSW_Task_1ms
          ExpiryPoint_9: OsScheduleTblExpPointOffset=9
            OsScheduleTableEventSetting_000 (OsScheduleTableEventSetting):
              OsScheduleTableSetEventRef = /ActiveEcuC/Os/Rte_Ev_Cyclic_Core3_BSW_Task_1ms_0_1ms
              OsScheduleTableSetEventTaskRef = /ActiveEcuC/Os/Core3_BSW_Task_1ms
    4 x OsCounter, all with OsSecondsPerTick=0.001, OsCounterMaxAllowedValue=1073741823, OsCounterMinCycle=1, OsCounterTicksPerBase=(unset), OsCounterType=SOFTWARE:
      systemtimer{0..3}: OsCounterAccessingApplication=/ActiveEcuC/Os/SystemApplication_Core{0..3}
    34 x OsEvent, all with OsEventMask=(unset):
      Rte_Ev_Cyclic_Core0_BSW_Task_5ms_0_5ms
      Rte_Ev_Cyclic_Core0_BSW_Task_10ms_0_10ms
      Rte_Ev_Cyclic_Core0_Demo_Task_5ms_0_5ms
      Rte_Ev_Cyclic_Core0_Demo_Task_10ms_0_10ms
      Rte_Ev_Cyclic_Core0_BSWApp_Task_1ms_0_1ms
      Rte_Ev_Cyclic_Core0_BSWApp_Task_5ms_0_5ms
      Rte_Ev_Cyclic_Core0_BSWApp_Task_10ms_0_10ms
      Rte_Ev_Cyclic_Core0_ASIL_BSW_Task_5ms_0_5ms
      Rte_Ev_Cyclic_Core0_ASIL_BSW_Task_10ms_0_10ms
      Rte_Ev_Cyclic_Core0_ActuatorIN_Task_10ms_0_10ms
      Rte_Ev_Cyclic_Core0_ActuatorOUT_Task_10ms_0_10ms
      Rte_Ev_Cyclic_Core0_BSW_Task_10ms_LowPriority_0_10ms
      Rte_Ev_Cyclic_Core1_BSW_Task_10ms_0_10ms
      Rte_Ev_Cyclic_Core1_NMM_Task_10ms_0_10ms
      Rte_Ev_Cyclic_Core1_ASILB_Task_10ms_0_10ms
      Rte_Ev_Cyclic_Core1_ASILD_Task_10ms_0_10ms
      Rte_Ev_Cyclic_Core1_BSWApp_Task_1ms_0_1ms
      Rte_Ev_Cyclic_Core1_BSWApp_Task_5ms_0_5ms
      Rte_Ev_Cyclic_Core1_BSWApp_Task_10ms_0_10ms
      Rte_Ev_Cyclic_Core1_ActuatorIN_Task_1ms_0_1ms
      Rte_Ev_Cyclic_Core1_ActuatorIN_Task_10ms_0_10ms
      Rte_Ev_Cyclic_Core1_ActuatorOUT_Task_1ms_0_1ms
      Rte_Ev_Cyclic_Core1_ActuatorOUT_Task_10ms_0_10ms
      Rte_Ev_Cyclic_Core2_BSW_Task_5ms_0_5ms
      Rte_Ev_Cyclic_Core2_BSW_Task_10ms_0_10ms
      Rte_Ev_Cyclic_Core3_BSW_Task_5ms_0_5ms
      Rte_Ev_Cyclic_Core3_BSW_Task_10ms_0_10ms
      Rte_Ev_Cyclic_Core0_Demo_Task_1ms_0_1ms
      Rte_Ev_Cyclic_Core1_ASILB_Task_1ms_0_1ms
      Rte_Ev_Cyclic_Core2_BSW_Task_1ms_0_1ms
      Rte_Ev_Cyclic_Core3_BSW_Task_1ms_0_1ms
      Rte_Ev_Cyclic2_Core0_BSW_Task_5ms_0_50ms
      Rte_Ev_Cyclic2_Core0_BSW_Task_5ms_0_5ms
      Rte_Ev_Cyclic2_Core0_BSW_Task_5ms_0_100ms
    13 x OsIsr, all with OsIsrCategory=CATEGORY_2:
      core{0..3}_systick_isr: OsIsrInitialEnableInterruptSource=false, OsIsrInterruptPriority=12, OsIsrInterruptSource=30, OsIsrEntryFunctionName=rt_fwk_tick_handler
      core0_uart_isr: OsIsrInitialEnableInterruptSource=true, OsIsrInterruptPriority=14, OsIsrInterruptSource=114, OsIsrEntryFunctionName=up_uart_rx_handler
      core{1..3}_uart_isr: OsIsrInitialEnableInterruptSource=false, OsIsrInterruptPriority=14, OsIsrInterruptSource=114, OsIsrEntryFunctionName=up_uart_rx_handler
      core{0..3}_ipicall_isr: OsIsrInitialEnableInterruptSource=true, OsIsrInterruptPriority=10, OsIsrInterruptSource=0, OsIsrEntryFunctionName=up_ipicall_isr_handler
      core0_eth_isr: OsIsrInitialEnableInterruptSource=true, OsIsrInterruptPriority=10, OsIsrInterruptSource=140, OsIsrEntryFunctionName=eth0_handle
    40 x OsTask, all with OsTaskUsesFpu=true, OsTaskActivation=1, OsTaskSchedule=FULL, OsTaskAccessingApplication=/ActiveEcuC/Os/SystemApplication_Core0, OsTaskAccessingApplication=/ActiveEcuC/Os/SystemApplication_Core1, OsTaskAccessingApplication=/ActiveEcuC/Os/SystemApplication_Core2, OsTaskAccessingApplication=/ActiveEcuC/Os/SystemApplication_Core3, OsTaskResourceRef=(unset):
      core0_shell: OsTaskPriority=10, OsTaskStackSize=8192, OsTaskType=EXTENDED, OsTaskEventRef=(unset)
        OsTaskAutostart: OsTaskAppModeRef=/ActiveEcuC/Os/OSAUTOSTARTMODE
      core1_shell: OsTaskPriority=10, OsTaskStackSize=8192, OsTaskType=EXTENDED, OsTaskEventRef=(unset)
        OsTaskAutostart: OsTaskAppModeRef=/ActiveEcuC/Os/OSAUTOSTARTMODE
      core2_shell: OsTaskPriority=10, OsTaskStackSize=8192, OsTaskType=EXTENDED, OsTaskEventRef=(unset)
        OsTaskAutostart: OsTaskAppModeRef=/ActiveEcuC/Os/OSAUTOSTARTMODE
      core3_shell: OsTaskPriority=10, OsTaskStackSize=8192, OsTaskType=EXTENDED, OsTaskEventRef=(unset)
        OsTaskAutostart: OsTaskAppModeRef=/ActiveEcuC/Os/OSAUTOSTARTMODE
      core0_init: OsTaskPriority=255, OsTaskStackSize=4096, OsTaskType=BASIC, OsTaskEventRef=(unset)
        OsTaskAutostart: OsTaskAppModeRef=/ActiveEcuC/Os/OSAUTOSTARTMODE
      core1_init: OsTaskPriority=255, OsTaskStackSize=4096, OsTaskType=BASIC, OsTaskEventRef=(unset)
        OsTaskAutostart: OsTaskAppModeRef=/ActiveEcuC/Os/OSAUTOSTARTMODE
      core2_init: OsTaskPriority=255, OsTaskStackSize=4096, OsTaskType=BASIC, OsTaskEventRef=(unset)
        OsTaskAutostart: OsTaskAppModeRef=/ActiveEcuC/Os/OSAUTOSTARTMODE
      core3_init: OsTaskPriority=255, OsTaskStackSize=4096, OsTaskType=BASIC, OsTaskEventRef=(unset)
        OsTaskAutostart: OsTaskAppModeRef=/ActiveEcuC/Os/OSAUTOSTARTMODE
      Core0_Demo_Task_1ms: OsTaskPriority=245, OsTaskStackSize=4096, OsTaskType=EXTENDED, OsTaskEventRef=/ActiveEcuC/Os/Rte_Ev_Cyclic_Core0_Demo_Task_1ms_0_1ms
      Core0_Demo_Task_5ms: OsTaskPriority=235, OsTaskStackSize=1024, OsTaskType=EXTENDED, OsTaskEventRef=/ActiveEcuC/Os/Rte_Ev_Cyclic_Core0_Demo_Task_5ms_0_5ms
      Core0_Demo_Task_10ms: OsTaskPriority=225, OsTaskStackSize=1024, OsTaskType=EXTENDED, OsTaskEventRef=/ActiveEcuC/Os/Rte_Ev_Cyclic_Core0_Demo_Task_10ms_0_10ms
      Core0_BSWApp_Task_1ms: OsTaskPriority=244, OsTaskStackSize=1024, OsTaskType=EXTENDED, OsTaskEventRef=/ActiveEcuC/Os/Rte_Ev_Cyclic_Core0_BSWApp_Task_1ms_0_1ms
      Core0_ASIL_BSW_Task_5ms: OsTaskPriority=234, OsTaskStackSize=1024, OsTaskType=EXTENDED, OsTaskEventRef=/ActiveEcuC/Os/Rte_Ev_Cyclic_Core0_ASIL_BSW_Task_5ms_0_5ms
      Core0_BSWApp_Task_5ms: OsTaskPriority=233, OsTaskStackSize=1024, OsTaskType=EXTENDED, OsTaskEventRef=/ActiveEcuC/Os/Rte_Ev_Cyclic_Core0_BSWApp_Task_5ms_0_5ms
      Core0_BSW_Task_5ms: OsTaskPriority=232, OsTaskStackSize=1024, OsTaskType=EXTENDED, OsTaskEventRef=/ActiveEcuC/Os/Rte_Ev_Cyclic_Core0_BSW_Task_5ms_0_5ms, OsTaskEventRef=/ActiveEcuC/Os/Rte_Ev_Cyclic2_Core0_BSW_Task_5ms_0_50ms, OsTaskEventRef=/ActiveEcuC/Os/Rte_Ev_Cyclic2_Core0_BSW_Task_5ms_0_5ms, OsTaskEventRef=/ActiveEcuC/Os/Rte_Ev_Cyclic2_Core0_BSW_Task_5ms_0_100ms
      Core0_ASIL_BSW_Task_10ms: OsTaskPriority=224, OsTaskStackSize=1024, OsTaskType=EXTENDED, OsTaskEventRef=/ActiveEcuC/Os/Rte_Ev_Cyclic_Core0_ASIL_BSW_Task_10ms_0_10ms
      Core0_ActuatorIN_Task_10ms: OsTaskPriority=223, OsTaskStackSize=1024, OsTaskType=EXTENDED, OsTaskEventRef=/ActiveEcuC/Os/Rte_Ev_Cyclic_Core0_ActuatorIN_Task_10ms_0_10ms
      Core0_ActuatorOUT_Task_10ms: OsTaskPriority=222, OsTaskStackSize=1024, OsTaskType=EXTENDED, OsTaskEventRef=/ActiveEcuC/Os/Rte_Ev_Cyclic_Core0_ActuatorOUT_Task_10ms_0_10ms
      Core0_BSWApp_Task_10ms: OsTaskPriority=221, OsTaskStackSize=1024, OsTaskType=EXTENDED, OsTaskEventRef=/ActiveEcuC/Os/Rte_Ev_Cyclic_Core0_BSWApp_Task_10ms_0_10ms
      Core0_BSW_Task_10ms: OsTaskPriority=220, OsTaskStackSize=1024, OsTaskType=EXTENDED, OsTaskEventRef=/ActiveEcuC/Os/Rte_Ev_Cyclic_Core0_BSW_Task_10ms_0_10ms
      Core0_BSW_Task_10ms_LowPriority: OsTaskPriority=219, OsTaskStackSize=1024, OsTaskType=EXTENDED, OsTaskEventRef=/ActiveEcuC/Os/Rte_Ev_Cyclic_Core0_BSW_Task_10ms_LowPriority_0_10ms
      Core1_ASILB_Task_1ms: OsTaskPriority=245, OsTaskStackSize=4096, OsTaskType=EXTENDED, OsTaskEventRef=/ActiveEcuC/Os/Rte_Ev_Cyclic_Core1_ASILB_Task_1ms_0_1ms
      Core1_ActuatorIN_Task_1ms: OsTaskPriority=244, OsTaskStackSize=1024, OsTaskType=EXTENDED, OsTaskEventRef=/ActiveEcuC/Os/Rte_Ev_Cyclic_Core1_ActuatorIN_Task_1ms_0_1ms
      Core1_ActuatorOUT_Task_1ms: OsTaskPriority=243, OsTaskStackSize=1024, OsTaskType=EXTENDED, OsTaskEventRef=/ActiveEcuC/Os/Rte_Ev_Cyclic_Core1_ActuatorOUT_Task_1ms_0_1ms
      Core1_BSWApp_Task_1ms: OsTaskPriority=242, OsTaskStackSize=1024, OsTaskType=EXTENDED, OsTaskEventRef=/ActiveEcuC/Os/Rte_Ev_Cyclic_Core1_BSWApp_Task_1ms_0_1ms
      Core1_BSWApp_Task_5ms: OsTaskPriority=235, OsTaskStackSize=1024, OsTaskType=EXTENDED, OsTaskEventRef=/ActiveEcuC/Os/Rte_Ev_Cyclic_Core1_BSWApp_Task_5ms_0_5ms
      Core1_ASILB_Task_10ms: OsTaskPriority=225, OsTaskStackSize=1024, OsTaskType=EXTENDED, OsTaskEventRef=/ActiveEcuC/Os/Rte_Ev_Cyclic_Core1_ASILB_Task_10ms_0_10ms
      Core1_ASILD_Task_10ms: OsTaskPriority=224, OsTaskStackSize=1024, OsTaskType=EXTENDED, OsTaskEventRef=/ActiveEcuC/Os/Rte_Ev_Cyclic_Core1_ASILD_Task_10ms_0_10ms
      Core1_ActuatorIN_Task_10ms: OsTaskPriority=223, OsTaskStackSize=1024, OsTaskType=EXTENDED, OsTaskEventRef=/ActiveEcuC/Os/Rte_Ev_Cyclic_Core1_ActuatorIN_Task_10ms_0_10ms
      Core1_ActuatorOUT_Task_10ms: OsTaskPriority=222, OsTaskStackSize=1024, OsTaskType=EXTENDED, OsTaskEventRef=/ActiveEcuC/Os/Rte_Ev_Cyclic_Core1_ActuatorOUT_Task_10ms_0_10ms
      Core1_BSWApp_Task_10ms: OsTaskPriority=221, OsTaskStackSize=1024, OsTaskType=EXTENDED, OsTaskEventRef=/ActiveEcuC/Os/Rte_Ev_Cyclic_Core1_BSWApp_Task_10ms_0_10ms
      Core1_BSW_Task_10ms: OsTaskPriority=220, OsTaskStackSize=1024, OsTaskType=EXTENDED, OsTaskEventRef=/ActiveEcuC/Os/Rte_Ev_Cyclic_Core1_BSW_Task_10ms_0_10ms
      Core1_NMM_Task_10ms: OsTaskPriority=219, OsTaskStackSize=1024, OsTaskType=EXTENDED, OsTaskEventRef=/ActiveEcuC/Os/Rte_Ev_Cyclic_Core1_NMM_Task_10ms_0_10ms
      Core2_BSW_Task_1ms: OsTaskPriority=245, OsTaskStackSize=4096, OsTaskType=EXTENDED, OsTaskEventRef=/ActiveEcuC/Os/Rte_Ev_Cyclic_Core2_BSW_Task_1ms_0_1ms
      Core2_BSW_Task_5ms: OsTaskPriority=235, OsTaskStackSize=1024, OsTaskType=EXTENDED, OsTaskEventRef=/ActiveEcuC/Os/Rte_Ev_Cyclic_Core2_BSW_Task_5ms_0_5ms
      Core2_BSW_Task_10ms: OsTaskPriority=225, OsTaskStackSize=1024, OsTaskType=EXTENDED, OsTaskEventRef=/ActiveEcuC/Os/Rte_Ev_Cyclic_Core2_BSW_Task_10ms_0_10ms
      Core3_BSW_Task_1ms: OsTaskPriority=245, OsTaskStackSize=4096, OsTaskType=EXTENDED, OsTaskEventRef=/ActiveEcuC/Os/Rte_Ev_Cyclic_Core3_BSW_Task_1ms_0_1ms
      Core3_BSW_Task_5ms: OsTaskPriority=235, OsTaskStackSize=1024, OsTaskType=EXTENDED, OsTaskEventRef=/ActiveEcuC/Os/Rte_Ev_Cyclic_Core3_BSW_Task_5ms_0_5ms
      Core3_BSW_Task_10ms: OsTaskPriority=225, OsTaskStackSize=1024, OsTaskType=EXTENDED, OsTaskEventRef=/ActiveEcuC/Os/Rte_Ev_Cyclic_Core3_BSW_Task_10ms_0_10ms
      Default_TcpIp_Task: OsTaskPriority=240, OsTaskStackSize=1024, OsTaskType=EXTENDED, OsTaskEventRef=(unset)
        OsTaskAutostart: OsTaskAppModeRef=/ActiveEcuC/Os/OSAUTOSTARTMODE
    4 x OsApplication, all with OsIsPrivileged=true, OsAppMemoryProtectionIdentifier=0:
      SystemApplication_Core0: OsAppEcucPartitionRef=/ActiveEcuC/EcuC/EcucPartitionCollection/EcucPartition_0, OsApplicationCoreRef=/ActiveEcuC/EcuC/EcucHardware/EcucCoreDefinition0, OsAppCounterRef=/ActiveEcuC/Os/systemtimer0, OsAppTaskRef=/ActiveEcuC/Os/core0_shell, OsAppTaskRef=/ActiveEcuC/Os/core0_init, OsAppTaskRef=/ActiveEcuC/Os/Core0_BSW_Task_10ms_LowPriority, OsAppTaskRef=/ActiveEcuC/Os/Core0_BSW_Task_10ms, OsAppTaskRef=/ActiveEcuC/Os/Core0_BSWApp_Task_10ms, OsAppTaskRef=/ActiveEcuC/Os/Core0_ActuatorOUT_Task_10ms, OsAppTaskRef=/ActiveEcuC/Os/Core0_ActuatorIN_Task_10ms, OsAppTaskRef=/ActiveEcuC/Os/Core0_ASIL_BSW_Task_10ms, OsAppTaskRef=/ActiveEcuC/Os/Core0_BSW_Task_5ms, OsAppTaskRef=/ActiveEcuC/Os/Core0_BSWApp_Task_5ms, OsAppTaskRef=/ActiveEcuC/Os/Core0_ASIL_BSW_Task_5ms, OsAppTaskRef=/ActiveEcuC/Os/Core0_BSWApp_Task_1ms, OsAppTaskRef=/ActiveEcuC/Os/Core0_Demo_Task_10ms, OsAppTaskRef=/ActiveEcuC/Os/Core0_Demo_Task_5ms, OsAppTaskRef=/ActiveEcuC/Os/Core0_Demo_Task_1ms, OsAppTaskRef=/ActiveEcuC/Os/Default_TcpIp_Task, OsAppScheduleTableRef=/ActiveEcuC/Os/OsScheduleTable_Core0, OsAppIsrRef=/ActiveEcuC/Os/core0_systick_isr, OsAppIsrRef=/ActiveEcuC/Os/core0_uart_isr, OsAppIsrRef=/ActiveEcuC/Os/core0_ipicall_isr, OsAppIsrRef=/ActiveEcuC/Os/core0_eth_isr, OsAppIsrRef=/ActiveEcuC/Os/core0_cat1_test_isr
      SystemApplication_Core1: OsAppEcucPartitionRef=/ActiveEcuC/EcuC/EcucPartitionCollection/EcucPartition_1, OsApplicationCoreRef=/ActiveEcuC/EcuC/EcucHardware/EcucCoreDefinition1, OsAppCounterRef=/ActiveEcuC/Os/systemtimer1, OsAppTaskRef=/ActiveEcuC/Os/core1_shell, OsAppTaskRef=/ActiveEcuC/Os/core1_init, OsAppTaskRef=/ActiveEcuC/Os/Core1_NMM_Task_10ms, OsAppTaskRef=/ActiveEcuC/Os/Core1_BSW_Task_10ms, OsAppTaskRef=/ActiveEcuC/Os/Core1_BSWApp_Task_10ms, OsAppTaskRef=/ActiveEcuC/Os/Core1_ActuatorOUT_Task_10ms, OsAppTaskRef=/ActiveEcuC/Os/Core1_ActuatorIN_Task_10ms, OsAppTaskRef=/ActiveEcuC/Os/Core1_ASILD_Task_10ms, OsAppTaskRef=/ActiveEcuC/Os/Core1_ASILB_Task_10ms, OsAppTaskRef=/ActiveEcuC/Os/Core1_BSWApp_Task_5ms, OsAppTaskRef=/ActiveEcuC/Os/Core1_BSWApp_Task_1ms, OsAppTaskRef=/ActiveEcuC/Os/Core1_ActuatorOUT_Task_1ms, OsAppTaskRef=/ActiveEcuC/Os/Core1_ActuatorIN_Task_1ms, OsAppTaskRef=/ActiveEcuC/Os/Core1_ASILB_Task_1ms, OsAppScheduleTableRef=/ActiveEcuC/Os/OsScheduleTable_Core1, OsAppIsrRef=/ActiveEcuC/Os/core1_systick_isr, OsAppIsrRef=/ActiveEcuC/Os/core1_uart_isr, OsAppIsrRef=/ActiveEcuC/Os/core1_ipicall_isr
      SystemApplication_Core2: OsAppEcucPartitionRef=/ActiveEcuC/EcuC/EcucPartitionCollection/EcucPartition_2, OsApplicationCoreRef=/ActiveEcuC/EcuC/EcucHardware/EcucCoreDefinition2, OsAppCounterRef=/ActiveEcuC/Os/systemtimer2, OsAppTaskRef=/ActiveEcuC/Os/core2_shell, OsAppTaskRef=/ActiveEcuC/Os/core2_init, OsAppTaskRef=/ActiveEcuC/Os/Core2_BSW_Task_10ms, OsAppTaskRef=/ActiveEcuC/Os/Core2_BSW_Task_5ms, OsAppTaskRef=/ActiveEcuC/Os/Core2_BSW_Task_1ms, OsAppScheduleTableRef=/ActiveEcuC/Os/OsScheduleTable_Core2, OsAppIsrRef=/ActiveEcuC/Os/core2_systick_isr, OsAppIsrRef=/ActiveEcuC/Os/core2_uart_isr, OsAppIsrRef=/ActiveEcuC/Os/core2_ipicall_isr
      SystemApplication_Core3: OsAppEcucPartitionRef=/ActiveEcuC/EcuC/EcucPartitionCollection/EcucPartition_3, OsApplicationCoreRef=/ActiveEcuC/EcuC/EcucHardware/EcucCoreDefinition3, OsAppCounterRef=/ActiveEcuC/Os/systemtimer3, OsAppTaskRef=/ActiveEcuC/Os/core3_shell, OsAppTaskRef=/ActiveEcuC/Os/core3_init, OsAppTaskRef=/ActiveEcuC/Os/Core3_BSW_Task_10ms, OsAppTaskRef=/ActiveEcuC/Os/Core3_BSW_Task_5ms, OsAppTaskRef=/ActiveEcuC/Os/Core3_BSW_Task_1ms, OsAppScheduleTableRef=/ActiveEcuC/Os/OsScheduleTable_Core3, OsAppIsrRef=/ActiveEcuC/Os/core3_uart_isr, OsAppIsrRef=/ActiveEcuC/Os/core3_ipicall_isr, OsAppIsrRef=/ActiveEcuC/Os/core3_systick_isr
    OsOS: OsUsePreStartTask=false, OsScalabilityClass=SC3
      OsHooks:
        OsErrorHook = true
        OsProtectionHook = true
        OsShutdownHook = true
        OsStartupHook = true
        OsErrorHookStackSize = 1024
        OsProtectionHookStackSize = 1024
        OsShutdownHookStackSize = 1024
        OsStartupHookStackSize = 1024
        OsEnableSharingHookStack = false
        OsPostTaskHook = false
        OsPreTaskHook = false
        OsPanicHook = false
    OsMemoryProtection
      46 x OsMemoryRegion, all with OsMemoryRegionIndex=(unset):
        OsMemoryRegion_Core{0..3}_Flash: OsMemoryRegionStartAddress=IRAM_TEXT_START, OsMemoryRegionEndAddress=IRAM_CONST_END, OsMemoryRegionOwner=(unset), OsMemoryRegionProtectionUnit=/ActiveEcuC/Os/Armv8rE3650/OsDerivativeInformation/OsPhysicalCore{0..3}, OsMemoryRegionAccessRights=/ActiveEcuC/Os/Armv8rE3650/OsDerivativeInformation/OsMemoryRegionSpecifics/USER_RX_SUPERVISOR_RX, OsMemoryRegionFlags=/ActiveEcuC/Os/Armv8rE3650/OsDerivativeInformation/OsMemoryRegionSpecifics/MEMATTR_TYPE_01_WRITE_THROUGH_CACHEABLE
        OsMemoryRegion_Core{0..3}_Semishared: OsMemoryRegionStartAddress=__default_app_semishared_core{0..3}_begin, OsMemoryRegionEndAddress=__default_app_semishared_core{0..3}_end, OsMemoryRegionOwner=(unset), OsMemoryRegionProtectionUnit=/ActiveEcuC/Os/Armv8rE3650/OsDerivativeInformation/OsPhysicalCore{0..3}, OsMemoryRegionAccessRights=/ActiveEcuC/Os/Armv8rE3650/OsDerivativeInformation/OsMemoryRegionSpecifics/USER_NON_SUPERVISOR_R, OsMemoryRegionFlags=/ActiveEcuC/Os/Armv8rE3650/OsDerivativeInformation/OsMemoryRegionSpecifics/MEMATTR_TYPE_01_WRITE_THROUGH_CACHEABLE
        OsMemoryRegion_Core{0..3}_Global: OsMemoryRegionStartAddress=__default_all_apps_multi_app_share_begin, OsMemoryRegionEndAddress=__default_all_apps_multi_app_share_end, OsMemoryRegionOwner=(unset), OsMemoryRegionProtectionUnit=/ActiveEcuC/Os/Armv8rE3650/OsDerivativeInformation/OsPhysicalCore{0..3}, OsMemoryRegionAccessRights=/ActiveEcuC/Os/Armv8rE3650/OsDerivativeInformation/OsMemoryRegionSpecifics/USER_NON_SUPERVISOR_RW, OsMemoryRegionFlags=/ActiveEcuC/Os/Armv8rE3650/OsDerivativeInformation/OsMemoryRegionSpecifics/MEMATTR_TYPE_01_WRITE_THROUGH_CACHEABLE
        OsMemoryRegion_Core{0..3}_Bmp: OsMemoryRegionStartAddress=__PERCPU{0..3}_START, OsMemoryRegionEndAddress=__PERCPU{0..3}_END, OsMemoryRegionOwner=/ActiveEcuC/Os/SystemApplication_Core{0..3}, OsMemoryRegionProtectionUnit=/ActiveEcuC/Os/Armv8rE3650/OsDerivativeInformation/OsPhysicalCore{0..3}, OsMemoryRegionAccessRights=/ActiveEcuC/Os/Armv8rE3650/OsDerivativeInformation/OsMemoryRegionSpecifics/USER_NON_SUPERVISOR_RW, OsMemoryRegionFlags=/ActiveEcuC/Os/Armv8rE3650/OsDerivativeInformation/OsMemoryRegionSpecifics/MEMATTR_TYPE_01_WRITE_THROUGH_CACHEABLE
        OsMemoryRegion_Core{0..3}_Heap: OsMemoryRegionStartAddress=__HEAP{0..3}_START, OsMemoryRegionEndAddress=__HEAP{0..3}_END, OsMemoryRegionOwner=/ActiveEcuC/Os/SystemApplication_Core{0..3}, OsMemoryRegionProtectionUnit=/ActiveEcuC/Os/Armv8rE3650/OsDerivativeInformation/OsPhysicalCore{0..3}, OsMemoryRegionAccessRights=/ActiveEcuC/Os/Armv8rE3650/OsDerivativeInformation/OsMemoryRegionSpecifics/USER_NON_SUPERVISOR_RW, OsMemoryRegionFlags=/ActiveEcuC/Os/Armv8rE3650/OsDerivativeInformation/OsMemoryRegionSpecifics/MEMATTR_TYPE_01_WRITE_THROUGH_CACHEABLE
        OsMemoryRegion_Core{0..3}_Default: OsMemoryRegionStartAddress=__default_var_begin, OsMemoryRegionEndAddress=__default_var_end, OsMemoryRegionOwner=(unset), OsMemoryRegionProtectionUnit=/ActiveEcuC/Os/Armv8rE3650/OsDerivativeInformation/OsPhysicalCore{0..3}, OsMemoryRegionAccessRights=/ActiveEcuC/Os/Armv8rE3650/OsDerivativeInformation/OsMemoryRegionSpecifics/USER_NON_SUPERVISOR_RW, OsMemoryRegionFlags=/ActiveEcuC/Os/Armv8rE3650/OsDerivativeInformation/OsMemoryRegionSpecifics/MEMATTR_TYPE_01_WRITE_THROUGH_CACHEABLE
        OsMemoryRegion_Core{0..3}_NoCache: OsMemoryRegionStartAddress=IRAM_NOCACHE_START, OsMemoryRegionEndAddress=IRAM_NOCACHE_END, OsMemoryRegionOwner=(unset), OsMemoryRegionProtectionUnit=/ActiveEcuC/Os/Armv8rE3650/OsDerivativeInformation/OsPhysicalCore{0..3}, OsMemoryRegionAccessRights=/ActiveEcuC/Os/Armv8rE3650/OsDerivativeInformation/OsMemoryRegionSpecifics/USER_NON_SUPERVISOR_RW, OsMemoryRegionFlags=/ActiveEcuC/Os/Armv8rE3650/OsDerivativeInformation/OsMemoryRegionSpecifics/MEMATTR_TYPE_02_NO_CACHEABLE
        OsMemoryRegion_Core{0..3}_Peripheral: OsMemoryRegionStartAddress=0xF0000000, OsMemoryRegionEndAddress=0xFFFFFFFF, OsMemoryRegionOwner=/ActiveEcuC/Os/SystemApplication_Core{0..3}, OsMemoryRegionProtectionUnit=/ActiveEcuC/Os/Armv8rE3650/OsDerivativeInformation/OsPhysicalCore{0..3}, OsMemoryRegionAccessRights=/ActiveEcuC/Os/Armv8rE3650/OsDerivativeInformation/OsMemoryRegionSpecifics/USER_NON_SUPERVISOR_RW, OsMemoryRegionFlags=/ActiveEcuC/Os/Armv8rE3650/OsDerivativeInformation/OsMemoryRegionSpecifics/MEMATTR_TYPE_03_DEVICE_NGNRNE
        OsMemoryRegion_Core{0..3}_Bsw_App_Share: OsMemoryRegionStartAddress=__default_bsw_apps_multi_app_share_begin, OsMemoryRegionEndAddress=__default_bsw_apps_multi_app_share_end, OsMemoryRegionOwner=/ActiveEcuC/Os/SystemApplication_Core{0..3}, OsMemoryRegionProtectionUnit=/ActiveEcuC/Os/Armv8rE3650/OsDerivativeInformation/OsPhysicalCore{0..3}, OsMemoryRegionAccessRights=/ActiveEcuC/Os/Armv8rE3650/OsDerivativeInformation/OsMemoryRegionSpecifics/USER_NON_SUPERVISOR_RW, OsMemoryRegionFlags=/ActiveEcuC/Os/Armv8rE3650/OsDerivativeInformation/OsMemoryRegionSpecifics/MEMATTR_TYPE_01_WRITE_THROUGH_CACHEABLE
        OsMemoryRegion_Core0_SystemApplication_Semishared: OsMemoryRegionStartAddress=__systemapplication_core0_semishared_begin, OsMemoryRegionEndAddress=__systemapplication_core0_semishared_end, OsMemoryRegionOwner=/ActiveEcuC/Os/SystemApplication_Core0, OsMemoryRegionProtectionUnit=/ActiveEcuC/Os/Armv8rE3650/OsDerivativeInformation/OsPhysicalCore0, OsMemoryRegionAccessRights=/ActiveEcuC/Os/Armv8rE3650/OsDerivativeInformation/OsMemoryRegionSpecifics/USER_NON_SUPERVISOR_RW, OsMemoryRegionFlags=/ActiveEcuC/Os/Armv8rE3650/OsDerivativeInformation/OsMemoryRegionSpecifics/MEMATTR_TYPE_01_WRITE_THROUGH_CACHEABLE
        OsMemoryRegion_Core0_SystemApplication_Private: OsMemoryRegionStartAddress=__systemapplication_core0_private_begin, OsMemoryRegionEndAddress=__systemapplication_core0_private_end, OsMemoryRegionOwner=/ActiveEcuC/Os/SystemApplication_Core0, OsMemoryRegionProtectionUnit=/ActiveEcuC/Os/Armv8rE3650/OsDerivativeInformation/OsPhysicalCore0, OsMemoryRegionAccessRights=/ActiveEcuC/Os/Armv8rE3650/OsDerivativeInformation/OsMemoryRegionSpecifics/USER_NON_SUPERVISOR_RW, OsMemoryRegionFlags=/ActiveEcuC/Os/Armv8rE3650/OsDerivativeInformation/OsMemoryRegionSpecifics/MEMATTR_TYPE_01_WRITE_THROUGH_CACHEABLE
        OsMemoryRegion_Core1_SystemApplication_Semishared: OsMemoryRegionStartAddress=__systemapplication_core1_semishared_begin, OsMemoryRegionEndAddress=__systemapplication_core1_semishared_end, OsMemoryRegionOwner=/ActiveEcuC/Os/SystemApplication_Core1, OsMemoryRegionProtectionUnit=/ActiveEcuC/Os/Armv8rE3650/OsDerivativeInformation/OsPhysicalCore1, OsMemoryRegionAccessRights=/ActiveEcuC/Os/Armv8rE3650/OsDerivativeInformation/OsMemoryRegionSpecifics/USER_NON_SUPERVISOR_RW, OsMemoryRegionFlags=/ActiveEcuC/Os/Armv8rE3650/OsDerivativeInformation/OsMemoryRegionSpecifics/MEMATTR_TYPE_01_WRITE_THROUGH_CACHEABLE
        OsMemoryRegion_Core1_SystemApplication_Private: OsMemoryRegionStartAddress=__systemapplication_core1_private_begin, OsMemoryRegionEndAddress=__systemapplication_core1_private_end, OsMemoryRegionOwner=/ActiveEcuC/Os/SystemApplication_Core1, OsMemoryRegionProtectionUnit=/ActiveEcuC/Os/Armv8rE3650/OsDerivativeInformation/OsPhysicalCore1, OsMemoryRegionAccessRights=/ActiveEcuC/Os/Armv8rE3650/OsDerivativeInformation/OsMemoryRegionSpecifics/USER_NON_SUPERVISOR_RW, OsMemoryRegionFlags=/ActiveEcuC/Os/Armv8rE3650/OsDerivativeInformation/OsMemoryRegionSpecifics/MEMATTR_TYPE_01_WRITE_THROUGH_CACHEABLE
        OsMemoryRegion_Core2_SystemApplication_Semishared: OsMemoryRegionStartAddress=__systemapplication_core2_semishared_begin, OsMemoryRegionEndAddress=__systemapplication_core2_semishared_end, OsMemoryRegionOwner=/ActiveEcuC/Os/SystemApplication_Core2, OsMemoryRegionProtectionUnit=/ActiveEcuC/Os/Armv8rE3650/OsDerivativeInformation/OsPhysicalCore2, OsMemoryRegionAccessRights=/ActiveEcuC/Os/Armv8rE3650/OsDerivativeInformation/OsMemoryRegionSpecifics/USER_NON_SUPERVISOR_RW, OsMemoryRegionFlags=/ActiveEcuC/Os/Armv8rE3650/OsDerivativeInformation/OsMemoryRegionSpecifics/MEMATTR_TYPE_01_WRITE_THROUGH_CACHEABLE
        OsMemoryRegion_Core2_SystemApplication_Private: OsMemoryRegionStartAddress=__systemapplication_core2_private_begin, OsMemoryRegionEndAddress=__systemapplication_core2_private_end, OsMemoryRegionOwner=/ActiveEcuC/Os/SystemApplication_Core2, OsMemoryRegionProtectionUnit=/ActiveEcuC/Os/Armv8rE3650/OsDerivativeInformation/OsPhysicalCore2, OsMemoryRegionAccessRights=/ActiveEcuC/Os/Armv8rE3650/OsDerivativeInformation/OsMemoryRegionSpecifics/USER_NON_SUPERVISOR_RW, OsMemoryRegionFlags=/ActiveEcuC/Os/Armv8rE3650/OsDerivativeInformation/OsMemoryRegionSpecifics/MEMATTR_TYPE_01_WRITE_THROUGH_CACHEABLE
        OsMemoryRegion_Core3_SystemApplication_Semishared: OsMemoryRegionStartAddress=__systemapplication_core3_semishared_begin, OsMemoryRegionEndAddress=__systemapplication_core3_semishared_end, OsMemoryRegionOwner=/ActiveEcuC/Os/SystemApplication_Core3, OsMemoryRegionProtectionUnit=/ActiveEcuC/Os/Armv8rE3650/OsDerivativeInformation/OsPhysicalCore3, OsMemoryRegionAccessRights=/ActiveEcuC/Os/Armv8rE3650/OsDerivativeInformation/OsMemoryRegionSpecifics/USER_NON_SUPERVISOR_RW, OsMemoryRegionFlags=/ActiveEcuC/Os/Armv8rE3650/OsDerivativeInformation/OsMemoryRegionSpecifics/MEMATTR_TYPE_01_WRITE_THROUGH_CACHEABLE
        OsMemoryRegion_Core3_SystemApplication_Private: OsMemoryRegionStartAddress=__systemapplication_core3_private_begin, OsMemoryRegionEndAddress=__systemapplication_core3_private_end, OsMemoryRegionOwner=/ActiveEcuC/Os/SystemApplication_Core3, OsMemoryRegionProtectionUnit=/ActiveEcuC/Os/Armv8rE3650/OsDerivativeInformation/OsPhysicalCore3, OsMemoryRegionAccessRights=/ActiveEcuC/Os/Armv8rE3650/OsDerivativeInformation/OsMemoryRegionSpecifics/USER_NON_SUPERVISOR_RW, OsMemoryRegionFlags=/ActiveEcuC/Os/Armv8rE3650/OsDerivativeInformation/OsMemoryRegionSpecifics/MEMATTR_TYPE_01_WRITE_THROUGH_CACHEABLE
        OsMemoryRegion_Core0_Eep_Read: OsMemoryRegionStartAddress=0x9000000, OsMemoryRegionEndAddress=0x907FFFF, OsMemoryRegionOwner=/ActiveEcuC/Os/SystemApplication_Core0, OsMemoryRegionProtectionUnit=/ActiveEcuC/Os/Armv8rE3650/OsDerivativeInformation/OsPhysicalCore0, OsMemoryRegionAccessRights=/ActiveEcuC/Os/Armv8rE3650/OsDerivativeInformation/OsMemoryRegionSpecifics/USER_NON_SUPERVISOR_R, OsMemoryRegionFlags=/ActiveEcuC/Os/Armv8rE3650/OsDerivativeInformation/OsMemoryRegionSpecifics/MEMATTR_TYPE_01_WRITE_THROUGH_CACHEABLE
        OsMemoryRegion_Core0_Eep_Write: OsMemoryRegionStartAddress=0x2000000, OsMemoryRegionEndAddress=0x207FFFF, OsMemoryRegionOwner=/ActiveEcuC/Os/SystemApplication_Core0, OsMemoryRegionProtectionUnit=/ActiveEcuC/Os/Armv8rE3650/OsDerivativeInformation/OsPhysicalCore0, OsMemoryRegionAccessRights=/ActiveEcuC/Os/Armv8rE3650/OsDerivativeInformation/OsMemoryRegionSpecifics/USER_NON_SUPERVISOR_RW, OsMemoryRegionFlags=/ActiveEcuC/Os/Armv8rE3650/OsDerivativeInformation/OsMemoryRegionSpecifics/MEMATTR_TYPE_01_WRITE_THROUGH_CACHEABLE
    core0_cat1_test_isr (OsIsr):
      OsIsrInitialEnableInterruptSource = false
      OsIsrInterruptPriority = 8
      OsIsrInterruptSource = 8
      OsIsrCategory = CATEGORY_1
      OsIsrEntryFunctionName = core0_cat1_test_isr_entry
