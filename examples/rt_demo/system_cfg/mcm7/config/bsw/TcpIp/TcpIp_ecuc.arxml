AUTOSAR XML (schema 00046)
package /ActiveEcuC
  module config TcpIp: implementation-config-variant=VARIANT-PRE-COMPILE
    TcpIpConfig
      TcpIpSocketOwnerConfig
        DDS (TcpIpSocketOwner):
          TcpIpSocketOwnerUpperLayerType = CDD
          TcpIpSocketOwnerTcpIpEventName = (unset)
          TcpIpSocketOwnerCopyTxDataName = (unset)
          TcpIpSocketOwnerHeaderFileName = (unset)
          TcpIpSocketOwnerLocalIpAddrAssignmentChgName = (unset)
          TcpIpSocketOwnerRxIndicationName = NETIO_Autosar_TcpIp_udp_rx_indication
          TcpIpSocketOwnerTcpAcceptedName = (unset)
          TcpIpSocketOwnerTcpConnectedName = (unset)
          TcpIpSocketOwnerTxConfirmationName = (unset)
      TcpIpTcpConfig:
        TcpIpTcpCongestionAvoidanceEnabled = true
        TcpIpTcpFastRecoveryEnabled = true
        TcpIpTcpFastRetransmitEnabled = true
        TcpIpTcpKeepAliveEnabled = true
        TcpIpTcpNagleEnabled = true
        TcpIpTcpSlowStartEnabled = true
        TcpIpTcpFinWait2Timeout = 120
        TcpIpTcpKeepAliveInterval = 1
        TcpIpTcpKeepAliveTime = 7200
        TcpIpTcpMsl = 120
        TcpIpTcpRetransmissionTimeout = 10
        TcpIpTcpSynReceivedTimeout = 20
        TcpIpTcpKeepAliveProbesMax = 3
        TcpIpTcpMaxRtx = 12
        TcpIpTcpReceiveWindowMax = 14600
        TcpIpTcpSynMaxRtx = 12
        TcpIpTcpTtl = 64
        TcpIpTcpSendBufferMax = 12
      TcpIpUdpConfig: TcpIpUdpTtl=64
      TcpIpIpConfig
        TcpIpIpV4Config
          TcpIpIcmpConfig: TcpIpIcmpEchoReplyEnabled=true, TcpIpIcmpTtl=64, TcpIpIcmpUnreachReplyEnabled=true
          TcpIpIpFragmentationConfig: TcpIpIpFragmentationRxEnabled=false, TcpIpIpReassTimeout=0, TcpIpIpNumFragments=0, TcpIpIpNumReassDgrams=0, TcpIpIpFragmentationTxEnabled=true
          TcpIpArpConfig:
            TcpIpArpPacketQueueEnabled = true
            TcpIpArpRequestTimeout = 1
            TcpIpArpTableEntryTimeout = 3600
            TcpIpArpNumGratuitousARPonStartup = 1
            TcpIpArpTableSizeMax = 10
            TcpIpArpPacketQueueLength = (unset)
      TcpIpCtrl_Vlan (TcpIpCtrl): TcpIpIpFramePrioDefault=5, TcpIpDhcpServerConfigRef=(unset), TcpIpEthIfCtrlRef=/ActiveEcuC/EthIf/EthIfConfigSet/EthIfController_Vlan3
      TcpIpLocalAddr_Vlan_Unicast (TcpIpLocalAddr):
        TcpIpAddrId = 0
        TcpIpAddressType = TCPIP_UNICAST
        TcpIpDomainType = TCPIP_AF_INET
        TcpIpCtrlRef = /ActiveEcuC/TcpIp/TcpIpConfig/TcpIpCtrl_Vlan
        TcpIpLocalAddrIPv6ExtHeaderFilterRef = (unset)
        TcpIpAddrAssignment: TcpIpAssignmentPriority=1, TcpIpAssignmentLifetime=TCPIP_FORGET, TcpIpAssignmentMethod=TCPIP_STATIC, TcpIpAssignmentTrigger=TCPIP_MANUAL
        TcpIpStaticIpAddressConfig: TcpIpNetmask=24, TcpIpDefaultRouter=192.168.3.1, TcpIpStaticIpAddress=192.168.3.71
      4 x TcpIpBufferMemoryConfig:
        TcpIpBufferMemoryConfig: TcpIpBufferMemoryLen=128, TcpIpBufferMemoryNum=50
        TcpIpBufferMemoryConfig_1: TcpIpBufferMemoryLen=256, TcpIpBufferMemoryNum=15
        TcpIpBufferMemoryConfig_2: TcpIpBufferMemoryLen=512, TcpIpBufferMemoryNum=10
        TcpIpBufferMemoryConfig_3: TcpIpBufferMemoryLen=1540, TcpIpBufferMemoryNum=6
      4 x TcpIpLocalAddr, all with TcpIpDomainType=TCPIP_AF_INET, TcpIpLocalAddrIPv6ExtHeaderFilterRef=(unset):
        TcpIpLocalAddr_Vlan_Multicast: TcpIpAddrId=1, TcpIpAddressType=TCPIP_MULTICAST, TcpIpCtrlRef=/ActiveEcuC/TcpIp/TcpIpConfig/TcpIpCtrl_Vlan
          TcpIpAddrAssignment: TcpIpAssignmentPriority=1, TcpIpAssignmentLifetime=TCPIP_FORGET, TcpIpAssignmentMethod=TCPIP_STATIC, TcpIpAssignmentTrigger=TCPIP_MANUAL
          TcpIpStaticIpAddressConfig: TcpIpNetmask=24, TcpIpDefaultRouter=192.168.3.1, TcpIpStaticIpAddress=239.255.0.1
        TcpIpLocalAddr_Vlan_Broadcast: TcpIpAddrId=2, TcpIpAddressType=TCPIP_ANYCAST, TcpIpCtrlRef=/ActiveEcuC/TcpIp/TcpIpConfig/TcpIpCtrl_Vlan
          TcpIpAddrAssignment: TcpIpAssignmentPriority=1, TcpIpAssignmentLifetime=TCPIP_FORGET, TcpIpAssignmentMethod=TCPIP_STATIC, TcpIpAssignmentTrigger=TCPIP_MANUAL
          TcpIpStaticIpAddressConfig: TcpIpNetmask=24, TcpIpDefaultRouter=192.168.3.1, TcpIpStaticIpAddress=255.255.255.255
        TcpIpLocalAddr_Non_Vlan_Unicast: TcpIpAddrId=3, TcpIpAddressType=TCPIP_UNICAST, TcpIpCtrlRef=/ActiveEcuC/TcpIp/TcpIpConfig/TcpIpCtrl_Non_Vlan
          TcpIpAddrAssignment: TcpIpAssignmentPriority=1, TcpIpAssignmentLifetime=TCPIP_FORGET, TcpIpAssignmentMethod=TCPIP_STATIC, TcpIpAssignmentTrigger=TCPIP_MANUAL
          TcpIpStaticIpAddressConfig: TcpIpNetmask=24, TcpIpDefaultRouter=192.168.10.1, TcpIpStaticIpAddress=192.168.10.71
        TcpIpLocalAddr_Non_Vlan_Multicast: TcpIpAddrId=4, TcpIpAddressType=TCPIP_MULTICAST, TcpIpCtrlRef=/ActiveEcuC/TcpIp/TcpIpConfig/TcpIpCtrl_Non_Vlan
          TcpIpAddrAssignment: TcpIpAssignmentPriority=1, TcpIpAssignmentLifetime=TCPIP_FORGET, TcpIpAssignmentMethod=TCPIP_STATIC, TcpIpAssignmentTrigger=TCPIP_MANUAL
          TcpIpStaticIpAddressConfig: TcpIpNetmask=24, TcpIpDefaultRouter=192.168.10.1, TcpIpStaticIpAddress=239.255.0.1
      TcpIpCtrl_Non_Vlan (TcpIpCtrl): TcpIpIpFramePrioDefault=5, TcpIpDhcpServerConfigRef=(unset), TcpIpEthIfCtrlRef=/ActiveEcuC/EthIf/EthIfConfigSet/EthIfController_Non_Vlan
    TcpIpGeneral:
      TcpIpGetAndResetMeasurementDataApi = false
      TcpIpBufferMemory = 0
      TcpIpDevErrorDetect = true
      TcpIpDhcpServerEnabled = false
      TcpIpMainFunctionPeriod = 0.005
      TcpIpResetIpAssignmentApi = false
      TcpIpTcpEnabled = true
      TcpIpTcpSocketMax = 14
      TcpIpUdpEnabled = true
      TcpIpUdpSocketMax = 30
      TcpIpVersionInfoApi = true
      TcpIpScalabilityClass = SC1
      TcpIpIpV4General:
        TcpIpArpEnabled = true
        TcpIpAutoIpEnabled = false
        TcpIpDhcpClientEnabled = false
        TcpIpIcmpEnabled = true
        TcpIpIpV4Enabled = true
        TcpIpLocalAddrIpv4EntriesMax = 5
        TcpIpPathMtuDiscoveryEnabled = false
