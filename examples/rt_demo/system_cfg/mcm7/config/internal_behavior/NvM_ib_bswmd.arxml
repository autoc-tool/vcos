AUTOSAR XML (schema 00046)
package /AUTOSAR/NvM_ib_bswmd/BswModuleDescriptions
  bsw module description NvM: provided-entrys=nvm_mainfunction
    bsw internal behavior NvMBehavior
      exclusive area NVM_EXCLUSIVE_AREA_0
      bsw schedulable entity nvm_mainfunction: implemented-entry=nvm_mainfunction
      bsw timing event NvM_MainFunctionTimingEvent0: starts-on-event=nvm_mainfunction, period=0.05
  bsw module entry nvm_mainfunction: call-type=SCHEDULED, execution-context=TASK
