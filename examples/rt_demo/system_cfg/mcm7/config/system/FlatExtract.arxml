AUTOSAR XML (schema 00046)
package /COM/VCOS2/CFG/WORKFLOW/SYSDESC/SYNC
  composition sw component type COMPOSITIONTYPE  # UB:Derived from original system description
  end to end protection set E2EPROTECTIONSET
  port interface mapping set PORTINTERFACEMAPPINGSET
  system SYSTEM: category=ECU_EXTRACT
    system mapping MAPPINGS
    root-software-compositions:
      root sw composition prototype COMPOSITIONTYPE: flat-map=FLATMAP, software-composition=COMPOSITIONTYPE
