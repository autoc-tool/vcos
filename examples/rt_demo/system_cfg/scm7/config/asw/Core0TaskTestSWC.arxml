AUTOSAR XML (schema 00046)
package /ComponentTypes
  application sw component type Core0TaskTestSWC
    behavior Core0TaskTestSWC_InternalBehavior
      13 x timing event:
        TMT_core0_actuatorin_runnable_10ms: start-on-event=core0_actuatorin_runnable_10ms, period=0.01
        TMT_core0_actuatorout_runnable_10ms: start-on-event=core0_actuatorout_runnable_10ms, period=0.01
        TMT_core0_asil_bsw_runnable_10ms: start-on-event=core0_asil_bsw_runnable_10ms, period=0.01
        TMT_core0_asil_bsw_runnable_5ms: start-on-event=core0_asil_bsw_runnable_5ms, period=0.005
        TMT_core0_bsw_runnable_10ms: start-on-event=core0_bsw_runnable_10ms, period=0.01
        TMT_core0_bsw_runnable_10ms_lowpriority: start-on-event=core0_bsw_runnable_10ms_lowpriority, period=0.01
        TMT_core0_bsw_runnable_5ms: start-on-event=core0_bsw_runnable_5ms, period=0.005
        TMT_core0_bswapp_runnable_10ms: start-on-event=core0_bswapp_runnable_10ms, period=0.01
        TMT_core0_bswapp_runnable_1ms: start-on-event=core0_bswapp_runnable_1ms, period=0.001
        TMT_core0_bswapp_runnable_5ms: start-on-event=core0_bswapp_runnable_5ms, period=0.005
        TMT_Core0_Demo_Runnable_10ms: start-on-event=core0_demo_runnable_10ms, period=0.01
        TMT_Core0_Demo_Runnable_1ms: start-on-event=core0_demo_runnable_1ms, period=0.001
        TMT_Core0_Demo_Runnable_5ms: start-on-event=core0_demo_runnable_5ms, period=0.005
      13 x runnable:
        core0_actuatorin_runnable_10ms
        core0_actuatorout_runnable_10ms
        core0_asil_bsw_runnable_10ms
        core0_asil_bsw_runnable_5ms
        core0_bsw_runnable_10ms
        core0_bsw_runnable_10ms_lowpriority
        core0_bsw_runnable_5ms
        core0_bswapp_runnable_10ms
        core0_bswapp_runnable_1ms
        core0_bswapp_runnable_5ms
        core0_demo_runnable_10ms
        core0_demo_runnable_1ms
        core0_demo_runnable_5ms
  swc implementation Core0TaskTestSWC_Implementation: behavior=Core0TaskTestSWC_InternalBehavior
    code-descriptors:
      code Default: artifact-descriptors=autosar-engineering-object={short-label=Default, category=SWSRC}
