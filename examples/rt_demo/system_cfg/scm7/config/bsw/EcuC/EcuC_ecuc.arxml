AUTOSAR XML (schema 00046)
package /ActiveEcuC
  module config EcuC: implementation-config-variant=VARIANT-PRE-COMPILE, module-description=Com_Impl
    EcucConfigSet
      EcucPduCollection: PduIdTypeEnum=UINT8, PduLengthTypeEnum=UINT8
        MetaDataType
          MetaDataItem: MetaDataItemLength=1, MetaDataItemType=CAN_ID_32
    EcucHardware
      EcucCoreDefinition0 (EcucCoreDefinition): EcucCoreId=0, EcucCoreHwRef=/ActiveEcuC/Os/Armv8rE3650/OsDerivativeInformation/OsPhysicalCore0
    EcucPartitionCollection
      4 x EcucPartition, all with EcucPartitionBswModuleExecution=false, EcucPartitionQmBswModuleExecution=false, PartitionCanBeRestarted=false, ASIL=QM, EcucPartitionSoftwareComponentInstanceRef=(unset), EcucPartitionBswModuleDistinguishedPartition=(unset):
        EcucPartition_{0..3}
