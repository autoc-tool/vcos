AUTOSAR XML (schema 00046)
package /ActiveEcuC
  module config EthIf: implementation-config-variant=VARIANT-PRE-COMPILE
    EthIfConfigSet
      EthIfTxConfirmationConfig: EthIfTxConfirmationFunction=IpV4_Ip_TxConfirmation, FrameOwnerRef=/ActiveEcuC/EthIf/EthIfConfigSet/TcpIp_IPv4
      TcpIp_IPv4 (EthIfFrameOwnerConfig): EthIfFrameType=2048, EthIfOwner=0
      TcpIp_IPv4_RxIndication (EthIfRxIndicationConfig): EthIfRxIndicationFunction=IpV4_Ip_RxIndication, FrameOwnerRef=/ActiveEcuC/EthIf/EthIfConfigSet/TcpIp_IPv4
      EthIfPhysController: EthIfPhysControllerIdx=0, EthIfEthCtrlRef=, EthIfWEthCtrlRef=
      EthIfTransceiver: EthIfTransceiverIdx=0, EthIfEthTrcvRef=, EthIfWEthTrcvRef=
      EthIfController_Vlan3 (EthIfController):
        EthIfCtrlIdx = 0
        EthIfCtrlMtu = 1500
        EthIfMaxTxBufsTotal = 20
        EthIfVlanId = 3
        EthIfLinkAggrThreshold = 1
        EthIfSwitchRefOrPortGroupRef = 
        EthIfEthTrcvRef = /ActiveEcuC/EthIf/EthIfConfigSet/EthIfTransceiver
        EthIfPhysControllerRef = /ActiveEcuC/EthIf/EthIfConfigSet/EthIfPhysController
      TcpIp_ARP (EthIfFrameOwnerConfig): EthIfFrameType=2054, EthIfOwner=1
      TcpIp_ARP_RxIndication (EthIfRxIndicationConfig): EthIfRxIndicationFunction=IpV4_Arp_RxIndication, FrameOwnerRef=/ActiveEcuC/EthIf/EthIfConfigSet/TcpIp_ARP
      EthIfController_Non_Vlan (EthIfController):
        EthIfCtrlIdx = 1
        EthIfCtrlMtu = 1500
        EthIfMaxTxBufsTotal = 20
        EthIfVlanId = 0
        EthIfLinkAggrThreshold = 1
        EthIfSwitchRefOrPortGroupRef = 
        EthIfEthTrcvRef = /ActiveEcuC/EthIf/EthIfConfigSet/EthIfTransceiver
        EthIfPhysControllerRef = /ActiveEcuC/EthIf/EthIfConfigSet/EthIfPhysController
    EthIfGeneral:
      EthIfDevErrorDetect = false
      EthIfEnableRxInterrupt = true
      EthIfEnableTxInterrupt = true
      EthIfGetBaudRate = (unset)
      EthIfGetCounterState = (unset)
      EthIfMainFunctionPeriod = 0.005
      EthIfMaxTrcvsTotal = 1
      EthIfRxIndicationIterations = 5
      EthIfStartAutoNegotiation = (unset)
      EthIfTrcvLinkStateChgMainReload = 5
      EthIfVersionInfoApi = false
      EthIfVersionInfoApiMacro = false
      EthIfEnableSignalQualityApi = (unset)
      EthIfEnableWEthApi = false
      EthIfGetAndResetMeasurementDataApi = false
      EthIfGetCtrlIdxList = false
      EthIfGetTransceiverWakeupModeApi = false
      EthIfGetVlanIdSupport = false
      EthIfGlobalTimeSupport = false
      EthIfSetForwardingModeApi = false
      EthIfSwitchManagementSupport = (unset)
      EthIfVerifyConfigApi = false
      EthIfWakeUpSupport = false
      EthIfMainFunctionStatePeriod = 0.1
      EthIfPortStartupActiveTime = (unset)
      EthIfSignalQualityCheckPeriod = (unset)
      EthIfSwitchOffPortTimeDelay = (unset)
      EthIfMapMcalApiPrefix = Eth
      EthIfPublicCddHeaderFile = (unset)
      EthIfEthSetCorrectionTimeApi = 
      EthIfEthSetGlobalTimeApi = 
      EthIfTrcvGetLinkStateApi = (unset)
      EthIfSwtGetLinkStateApi = (unset)
