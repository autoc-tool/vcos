AUTOSAR XML (schema 00046)
package /ActiveEcuC
  module config MemIf: implementation-config-variant=VARIANT-PRE-COMPILE, module-description=MemIf_Impl
    MemIfGeneral: MemIfDevErrorDetect=false, MemIfVersionInfoApi=false, MemIfNumberOfDevices=1, MemIfUseEepromStore=true, MemIfUseFlashStore=false
