AUTOSAR XML (schema 00046)
package /ActiveEcuC
  module config Rte: implementation-config-variant=VARIANT-PRE-COMPILE, module-description=Rte_Impl
    RteGeneration:
      RteDevErrorDetect = false
      RteVfbTraceEnabled = false
      RteSystemSignalCompuMethodEnabled = false
      RteIsrSimplification = false
      RteEaOptimization = false
      DataMappingGenerationOptimization1To1Rport = false
      DataMappingGenerationOptimizationNTo1Rport = false
      DataMappingGenerationOptimizationPport = false
      RteVfbTraceFunction = (unset)
    RteBswGeneral
    Core0TaskTestSWC_EcuSwComposition (RteSwComponentInstance): RteSoftwareComponentInstanceRef=(unset)
      13 x RteEventToTaskMapping, all with RteActivationOffset=(unset), RteUsedOsAlarmRef=(unset):
        TMT_core0_bsw_runnable_5ms: RtePositionInTask=0, RteEventRef=/ComponentTypes/Core0TaskTestSWC/Core0TaskTestSWC_InternalBehavior/TMT_core0_bsw_runnable_5ms, RteMappedToTaskRef=/ActiveEcuC/Os/Core0_BSW_Task_5ms, RteUsedOsEventRef=/ActiveEcuC/Os/Rte_Ev_Cyclic_Core0_BSW_Task_5ms_0_5ms
        TMT_core0_bsw_runnable_10ms: RtePositionInTask=0, RteEventRef=/ComponentTypes/Core0TaskTestSWC/Core0TaskTestSWC_InternalBehavior/TMT_core0_bsw_runnable_10ms, RteMappedToTaskRef=/ActiveEcuC/Os/Core0_BSW_Task_10ms, RteUsedOsEventRef=/ActiveEcuC/Os/Rte_Ev_Cyclic_Core0_BSW_Task_10ms_0_10ms
        TMT_Core0_Demo_Runnable_5ms: RtePositionInTask=0, RteEventRef=/ComponentTypes/Core0TaskTestSWC/Core0TaskTestSWC_InternalBehavior/TMT_Core0_Demo_Runnable_5ms, RteMappedToTaskRef=/ActiveEcuC/Os/Core0_Demo_Task_5ms, RteUsedOsEventRef=/ActiveEcuC/Os/Rte_Ev_Cyclic_Core0_Demo_Task_5ms_0_5ms
        TMT_Core0_Demo_Runnable_10ms: RtePositionInTask=0, RteEventRef=/ComponentTypes/Core0TaskTestSWC/Core0TaskTestSWC_InternalBehavior/TMT_Core0_Demo_Runnable_10ms, RteMappedToTaskRef=/ActiveEcuC/Os/Core0_Demo_Task_10ms, RteUsedOsEventRef=/ActiveEcuC/Os/Rte_Ev_Cyclic_Core0_Demo_Task_10ms_0_10ms
        TMT_core0_bswapp_runnable_1ms: RtePositionInTask=0, RteEventRef=/ComponentTypes/Core0TaskTestSWC/Core0TaskTestSWC_InternalBehavior/TMT_core0_bswapp_runnable_1ms, RteMappedToTaskRef=/ActiveEcuC/Os/Core0_BSWApp_Task_1ms, RteUsedOsEventRef=/ActiveEcuC/Os/Rte_Ev_Cyclic_Core0_BSWApp_Task_1ms_0_1ms
        TMT_core0_bswapp_runnable_5ms: RtePositionInTask=0, RteEventRef=/ComponentTypes/Core0TaskTestSWC/Core0TaskTestSWC_InternalBehavior/TMT_core0_bswapp_runnable_5ms, RteMappedToTaskRef=/ActiveEcuC/Os/Core0_BSWApp_Task_5ms, RteUsedOsEventRef=/ActiveEcuC/Os/Rte_Ev_Cyclic_Core0_BSWApp_Task_5ms_0_5ms
        TMT_core0_bswapp_runnable_10ms: RtePositionInTask=0, RteEventRef=/ComponentTypes/Core0TaskTestSWC/Core0TaskTestSWC_InternalBehavior/TMT_core0_bswapp_runnable_10ms, RteMappedToTaskRef=/ActiveEcuC/Os/Core0_BSWApp_Task_10ms, RteUsedOsEventRef=/ActiveEcuC/Os/Rte_Ev_Cyclic_Core0_BSWApp_Task_10ms_0_10ms
        TMT_core0_asil_bsw_runnable_5ms: RtePositionInTask=0, RteEventRef=/ComponentTypes/Core0TaskTestSWC/Core0TaskTestSWC_InternalBehavior/TMT_core0_asil_bsw_runnable_5ms, RteMappedToTaskRef=/ActiveEcuC/Os/Core0_ASIL_BSW_Task_5ms, RteUsedOsEventRef=/ActiveEcuC/Os/Rte_Ev_Cyclic_Core0_ASIL_BSW_Task_5ms_0_5ms
        TMT_core0_asil_bsw_runnable_10ms: RtePositionInTask=0, RteEventRef=/ComponentTypes/Core0TaskTestSWC/Core0TaskTestSWC_InternalBehavior/TMT_core0_asil_bsw_runnable_10ms, RteMappedToTaskRef=/ActiveEcuC/Os/Core0_ASIL_BSW_Task_10ms, RteUsedOsEventRef=/ActiveEcuC/Os/Rte_Ev_Cyclic_Core0_ASIL_BSW_Task_10ms_0_10ms
        TMT_core0_actuatorin_runnable_10ms: RtePositionInTask=0, RteEventRef=/ComponentTypes/Core0TaskTestSWC/Core0TaskTestSWC_InternalBehavior/TMT_core0_actuatorin_runnable_10ms, RteMappedToTaskRef=/ActiveEcuC/Os/Core0_ActuatorIN_Task_10ms, RteUsedOsEventRef=/ActiveEcuC/Os/Rte_Ev_Cyclic_Core0_ActuatorIN_Task_10ms_0_10ms
        TMT_core0_actuatorout_runnable_10ms: RtePositionInTask=0, RteEventRef=/ComponentTypes/Core0TaskTestSWC/Core0TaskTestSWC_InternalBehavior/TMT_core0_actuatorout_runnable_10ms, RteMappedToTaskRef=/ActiveEcuC/Os/Core0_ActuatorOUT_Task_10ms, RteUsedOsEventRef=/ActiveEcuC/Os/Rte_Ev_Cyclic_Core0_ActuatorOUT_Task_10ms_0_10ms
        TMT_core0_bsw_runnable_10ms_lowpriority: RtePositionInTask=0, RteEventRef=/ComponentTypes/Core0TaskTestSWC/Core0TaskTestSWC_InternalBehavior/TMT_core0_bsw_runnable_10ms_lowpriority, RteMappedToTaskRef=/ActiveEcuC/Os/Core0_BSW_Task_10ms_LowPriority, RteUsedOsEventRef=/ActiveEcuC/Os/Rte_Ev_Cyclic_Core0_BSW_Task_10ms_LowPriority_0_10ms
        TMT_Core0_Demo_Runnable_1ms: RtePositionInTask=2, RteEventRef=/ComponentTypes/Core0TaskTestSWC/Core0TaskTestSWC_InternalBehavior/TMT_Core0_Demo_Runnable_1ms, RteMappedToTaskRef=/ActiveEcuC/Os/Core0_Demo_Task_1ms, RteUsedOsEventRef=/ActiveEcuC/Os/Rte_Ev_Cyclic_Core0_Demo_Task_1ms_0_1ms
    Core0_Trace_SWC_EcuSwComposition (RteSwComponentInstance): RteSoftwareComponentInstanceRef=(unset)
      TMT_handshake_main_func (RteEventToTaskMapping):
        RteActivationOffset = (unset)
        RtePositionInTask = 0
        RteEventRef = /ComponentTypes/Core0_Trace_SWC/Core0_Trace_SWC_InternalBehavior/TMT_handshake_main_func
        RteMappedToTaskRef = /ActiveEcuC/Os/Core0_Demo_Task_1ms
        RteUsedOsAlarmRef = (unset)
        RteUsedOsEventRef = /ActiveEcuC/Os/Rte_Ev_Cyclic_Core0_Demo_Task_1ms_0_1ms
      TMT_trace_dumpudp_main_func (RteEventToTaskMapping):
        RteActivationOffset = (unset)
        RtePositionInTask = 1
        RteEventRef = /ComponentTypes/Core0_Trace_SWC/Core0_Trace_SWC_InternalBehavior/TMT_trace_dumpudp_main_func
        RteMappedToTaskRef = /ActiveEcuC/Os/Core0_Demo_Task_1ms
        RteUsedOsAlarmRef = (unset)
        RteUsedOsEventRef = /ActiveEcuC/Os/Rte_Ev_Cyclic_Core0_Demo_Task_1ms_0_1ms
    4 x RteBswModuleInstance, all with RteBswImplementationRef=(unset):
      NvM: RteBswModuleConfigurationRef=/ActiveEcuC/NvM
        NVM_EXCLUSIVE_AREA_0 (RteBswExclusiveAreaImpl):
          RteExclusiveAreaImplMechanism = OS_INTERRUPT_BLOCKING
          RteBswExclusiveAreaRef = /AUTOSAR/NvM_ib_bswmd/BswModuleDescriptions/NvM/NvMBehavior/NVM_EXCLUSIVE_AREA_0
          RteBswExclusiveAreaOsResourceRef = (unset)
          RteBswExclusiveAreaOsSpinlockRef = (unset)
        NvM_MainFunctionTimingEvent0 (RteBswEventToTaskMapping):
          RteBswActivationOffset = (unset)
          RteBswPositionInTask = 1
          RteBswEventRef = /AUTOSAR/NvM_ib_bswmd/BswModuleDescriptions/NvM/NvMBehavior/NvM_MainFunctionTimingEvent0
          RteBswMappedToTaskRef = /ActiveEcuC/Os/Core0_BSW_Task_5ms
          RteBswUsedOsAlarmRef = (unset)
          RteBswUsedOsEventRef = /ActiveEcuC/Os/Rte_Ev_Cyclic2_Core0_BSW_Task_5ms_0_50ms
      EthIf: RteBswModuleConfigurationRef=/ActiveEcuC/EthIf
        EthIf_MainFunctionStateTimingEvent0 (RteBswEventToTaskMapping):
          RteBswActivationOffset = (unset)
          RteBswPositionInTask = 3
          RteBswEventRef = /AUTOSAR/EthIf_ib_bswmd/BswModuleDescriptions/EthIf/EthIfBehavior/EthIf_MainFunctionStateTimingEvent0
          RteBswMappedToTaskRef = /ActiveEcuC/Os/Core0_BSW_Task_5ms
          RteBswUsedOsAlarmRef = (unset)
          RteBswUsedOsEventRef = /ActiveEcuC/Os/Rte_Ev_Cyclic2_Core0_BSW_Task_5ms_0_100ms
      TcpIp: RteBswModuleConfigurationRef=/ActiveEcuC/TcpIp
        TcpIp_MainFunctionTimingEvent0 (RteBswEventToTaskMapping):
          RteBswActivationOffset = (unset)
          RteBswPositionInTask = 2
          RteBswEventRef = /AUTOSAR/TcpIp_ib_bswmd/BswModuleDescriptions/TcpIp/TcpIpBehavior/TcpIp_MainFunctionTimingEvent0
          RteBswMappedToTaskRef = /ActiveEcuC/Os/Core0_BSW_Task_5ms
          RteBswUsedOsAlarmRef = (unset)
          RteBswUsedOsEventRef = /ActiveEcuC/Os/Rte_Ev_Cyclic2_Core0_BSW_Task_5ms_0_5ms
      Rte: RteBswModuleConfigurationRef=(unset)
