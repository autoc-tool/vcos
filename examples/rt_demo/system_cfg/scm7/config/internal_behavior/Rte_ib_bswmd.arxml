AUTOSAR XML (schema 00046)
package /AUTOSAR
  bsw implementation Rte_Impl: programming-language=C
    resource consumption ResourceConsumption
package /AUTOSAR/Rte_ib_bswmd/BswModuleDescriptions
  bsw module description Rte
    bsw internal behavior RteBehavior
