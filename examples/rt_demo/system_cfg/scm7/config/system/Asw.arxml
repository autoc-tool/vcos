AUTOSAR XML (schema 00046)
standard types defined: dtRef_const_VOID, dtRef_VOID, boolean, float32, float64, sint16, sint16_least, sint32, sint32_least, sint64, sint8, sint8_least, uint16, uint16_least, uint32, uint32_least, uint64, uint8, uint8_least, boolean_CompuMethod, boolean_DataConstr, float32_DataConstr, float64_DataConstr, sint16_DataConstr, sint16_least_DataConstr, sint32_DataConstr, sint32_least_DataConstr, sint64_DataConstr, sint8_DataConstr, sint8_least_DataConstr, uint16_DataConstr, uint16_least_DataConstr, uint32_DataConstr, uint32_least_DataConstr, uint64_DataConstr, uint8_DataConstr, uint8_least_DataConstr
package /ComponentTypes
  application sw component type Core0TaskTestSWC
    behavior Core0TaskTestSWC_InternalBehavior
      13 x timing event:
        TMT_core0_actuatorin_runnable_10ms: start-on-event=core0_actuatorin_runnable_10ms, period=0.01
        TMT_core0_actuatorout_runnable_10ms: start-on-event=core0_actuatorout_runnable_10ms, period=0.01
        TMT_core0_asil_bsw_runnable_10ms: start-on-event=core0_asil_bsw_runnable_10ms, period=0.01
        TMT_core0_asil_bsw_runnable_5ms: start-on-event=core0_asil_bsw_runnable_5ms, period=0.005
        TMT_core0_bsw_runnable_10ms: start-on-event=core0_bsw_runnable_10ms, period=0.01
        TMT_core0_bsw_runnable_10ms_lowpriority: start-on-event=core0_bsw_runnable_10ms_lowpriority, period=0.01
        TMT_core0_bsw_runnable_5ms: start-on-event=core0_bsw_runnable_5ms, period=0.005
        TMT_core0_bswapp_runnable_10ms: start-on-event=core0_bswapp_runnable_10ms, period=0.01
        TMT_core0_bswapp_runnable_1ms: start-on-event=core0_bswapp_runnable_1ms, period=0.001
        TMT_core0_bswapp_runnable_5ms: start-on-event=core0_bswapp_runnable_5ms, period=0.005
        TMT_Core0_Demo_Runnable_10ms: start-on-event=core0_demo_runnable_10ms, period=0.01
        TMT_Core0_Demo_Runnable_1ms: start-on-event=core0_demo_runnable_1ms, period=0.001
        TMT_Core0_Demo_Runnable_5ms: start-on-event=core0_demo_runnable_5ms, period=0.005
      13 x runnable:
        core0_actuatorin_runnable_10ms
        core0_actuatorout_runnable_10ms
        core0_asil_bsw_runnable_10ms
        core0_asil_bsw_runnable_5ms
        core0_bsw_runnable_10ms
        core0_bsw_runnable_10ms_lowpriority
        core0_bsw_runnable_5ms
        core0_bswapp_runnable_10ms
        core0_bswapp_runnable_1ms
        core0_bswapp_runnable_5ms
        core0_demo_runnable_10ms
        core0_demo_runnable_1ms
        core0_demo_runnable_5ms
  application sw component type Core0_Trace_SWC
    behavior Core0_Trace_SWC_InternalBehavior
      timing event TMT_handshake_main_func: start-on-event=handshake_main_func, period=0.001
      timing event TMT_trace_dumpudp_main_func: start-on-event=trace_dumpudp_main_func, period=0.001
      runnable handshake_main_func
      runnable trace_dumpudp_main_func
  swc implementation Core0TaskTestSWC_Implementation: behavior=Core0TaskTestSWC_InternalBehavior
    code-descriptors:
      code Default: artifact-descriptors=autosar-engineering-object={short-label=Default, category=SWSRC}
  swc implementation Core0_Trace_SWC_Implementation: behavior=Core0_Trace_SWC_InternalBehavior
    code-descriptors:
      code Default: artifact-descriptors=autosar-engineering-object={short-label=Default, category=SWSRC}
