AUTOSAR XML (schema 00046)
package /VehicleProject
  system System
